ASAP2_VERSION 1 51
/begin PROJECT Project ""
/begin MODULE niihil14_037 ""
/begin MOD_COMMON /* MOD_COMMON Comment */ "" BYTE_ORDER MSB_FIRST ALIGNMENT_BYTE 1 ALIGNMENT_FLOAT32_IEEE 1 ALIGNMENT_FLOAT64_IEEE 1 ALIGNMENT_LONG 1 ALIGNMENT_WORD 1 /end MOD_COMMON
/begin MEASUREMENT FaultMarquees.FaultMarquees.Current_Suspected "Displays a rolling marquee for suspected, active and occurred faults." UBYTE CompuMethod_154 1 0 0 255 ECU_ADDRESS 0x400002E9 /end MEASUREMENT
/begin MEASUREMENT FaultMarquees.FaultMarquees.Current_Active "Displays a rolling marquee for suspected, active and occurred faults." UBYTE CompuMethod_154 1 0 0 255 ECU_ADDRESS 0x400002EA /end MEASUREMENT
/begin MEASUREMENT FaultMarquees.FaultMarquees.Current_Occurred "Displays a rolling marquee for suspected, active and occurred faults." UBYTE CompuMethod_154 1 0 0 255 ECU_ADDRESS 0x400002EB /end MEASUREMENT
/begin CHARACTERISTIC FaultCommand "Select a command to control the fault manager." VALUE 0x800004A6 RecordLayout_3 0 CompuMethod_155 0 255 /end CHARACTERISTIC
/begin CHARACTERISTIC FaultManager.APP_RangeHigh.Mode "Fault manager configuration.  Select up to 4 actions for each fault." VALUE 0x800004A7 RecordLayout_3 0 CompuMethod_156 0 255 /end CHARACTERISTIC
/begin CHARACTERISTIC FaultManager.APP_RangeHigh.ID "Fault manager configuration.  Select up to 4 actions for each fault." VALUE 0x800004A8 RecordLayout_3 0 CompuMethod_1 0 255 /end CHARACTERISTIC
/begin CHARACTERISTIC FaultManager.APP_RangeHigh.Test "Fault manager configuration.  Select up to 4 actions for each fault." VALUE 0x800004A9 RecordLayout_3 0 CompuMethod_157 0 255 /end CHARACTERISTIC
/begin CHARACTERISTIC FaultManager.APP_RangeHigh.Faulty_Samples__X_ "Fault manager configuration.  Select up to 4 actions for each fault." VALUE 0x800004AA RecordLayout_3 0 CompuMethod_1 0 255 /end CHARACTERISTIC
/begin CHARACTERISTIC FaultManager.APP_RangeHigh.Total_Samples__Y_ "Fault manager configuration.  Select up to 4 actions for each fault." VALUE 0x800004AB RecordLayout_3 0 CompuMethod_1 0 255 /end CHARACTERISTIC
/begin CHARACTERISTIC FaultManager.APP_RangeHigh.Action_1 "Fault manager configuration.  Select up to 4 actions for each fault." VALUE 0x800004AC RecordLayout_3 0 CompuMethod_158 0 255 /end CHARACTERISTIC
/begin CHARACTERISTIC FaultManager.APP_RangeHigh.Action_1_Condition "Fault manager configuration.  Select up to 4 actions for each fault." VALUE 0x800004AD RecordLayout_3 0 CompuMethod_159 0 255 /end CHARACTERISTIC
/begin CHARACTERISTIC FaultManager.APP_RangeHigh.Action_2 "Fault manager configuration.  Select up to 4 actions for each fault." VALUE 0x800004AE RecordLayout_3 0 CompuMethod_158 0 255 /end CHARACTERISTIC
/begin CHARACTERISTIC FaultManager.APP_RangeHigh.Action_2_Condition "Fault manager configuration.  Select up to 4 actions for each fault." VALUE 0x800004AF RecordLayout_3 0 CompuMethod_159 0 255 /end CHARACTERISTIC
/begin CHARACTERISTIC FaultManager.APP_RangeHigh.Action_3 "Fault manager configuration.  Select up to 4 actions for each fault." VALUE 0x800004B0 RecordLayout_3 0 CompuMethod_158 0 255 /end CHARACTERISTIC
/begin CHARACTERISTIC FaultManager.APP_RangeHigh.Action_3_Condition "Fault manager configuration.  Select up to 4 actions for each fault." VALUE 0x800004B1 RecordLayout_3 0 CompuMethod_159 0 255 /end CHARACTERISTIC
/begin CHARACTERISTIC FaultManager.APP_RangeHigh.Action_4 "Fault manager configuration.  Select up to 4 actions for each fault." VALUE 0x800004B2 RecordLayout_3 0 CompuMethod_158 0 255 /end CHARACTERISTIC
/begin CHARACTERISTIC FaultManager.APP_RangeHigh.Action_4_Condition "Fault manager configuration.  Select up to 4 actions for each fault." VALUE 0x800004B3 RecordLayout_3 0 CompuMethod_159 0 255 /end CHARACTERISTIC
/begin CHARACTERISTIC FaultManager.APP_RangeLow.Mode "Fault manager configuration.  Select up to 4 actions for each fault." VALUE 0x800004B4 RecordLayout_3 0 CompuMethod_156 0 255 /end CHARACTERISTIC
/begin CHARACTERISTIC FaultManager.APP_RangeLow.ID "Fault manager configuration.  Select up to 4 actions for each fault." VALUE 0x800004B5 RecordLayout_3 0 CompuMethod_1 0 255 /end CHARACTERISTIC
/begin CHARACTERISTIC FaultManager.APP_RangeLow.Test "Fault manager configuration.  Select up to 4 actions for each fault." VALUE 0x800004B6 RecordLayout_3 0 CompuMethod_157 0 255 /end CHARACTERISTIC
/begin CHARACTERISTIC FaultManager.APP_RangeLow.Faulty_Samples__X_ "Fault manager configuration.  Select up to 4 actions for each fault." VALUE 0x800004B7 RecordLayout_3 0 CompuMethod_1 0 255 /end CHARACTERISTIC
/begin CHARACTERISTIC FaultManager.APP_RangeLow.Total_Samples__Y_ "Fault manager configuration.  Select up to 4 actions for each fault." VALUE 0x800004B8 RecordLayout_3 0 CompuMethod_1 0 255 /end CHARACTERISTIC
/begin CHARACTERISTIC FaultManager.APP_RangeLow.Action_1 "Fault manager configuration.  Select up to 4 actions for each fault." VALUE 0x800004B9 RecordLayout_3 0 CompuMethod_158 0 255 /end CHARACTERISTIC
/begin CHARACTERISTIC FaultManager.APP_RangeLow.Action_1_Condition "Fault manager configuration.  Select up to 4 actions for each fault." VALUE 0x800004BA RecordLayout_3 0 CompuMethod_159 0 255 /end CHARACTERISTIC
/begin CHARACTERISTIC FaultManager.APP_RangeLow.Action_2 "Fault manager configuration.  Select up to 4 actions for each fault." VALUE 0x800004BB RecordLayout_3 0 CompuMethod_158 0 255 /end CHARACTERISTIC
/begin CHARACTERISTIC FaultManager.APP_RangeLow.Action_2_Condition "Fault manager configuration.  Select up to 4 actions for each fault." VALUE 0x800004BC RecordLayout_3 0 CompuMethod_159 0 255 /end CHARACTERISTIC
/begin CHARACTERISTIC FaultManager.APP_RangeLow.Action_3 "Fault manager configuration.  Select up to 4 actions for each fault." VALUE 0x800004BD RecordLayout_3 0 CompuMethod_158 0 255 /end CHARACTERISTIC
/begin CHARACTERISTIC FaultManager.APP_RangeLow.Action_3_Condition "Fault manager configuration.  Select up to 4 actions for each fault." VALUE 0x800004BE RecordLayout_3 0 CompuMethod_159 0 255 /end CHARACTERISTIC
/begin CHARACTERISTIC FaultManager.APP_RangeLow.Action_4 "Fault manager configuration.  Select up to 4 actions for each fault." VALUE 0x800004BF RecordLayout_3 0 CompuMethod_158 0 255 /end CHARACTERISTIC
/begin CHARACTERISTIC FaultManager.APP_RangeLow.Action_4_Condition "Fault manager configuration.  Select up to 4 actions for each fault." VALUE 0x800004C0 RecordLayout_3 0 CompuMethod_159 0 255 /end CHARACTERISTIC
/begin CHARACTERISTIC FaultManager.Airflow2_RangeHigh.Mode "Fault manager configuration.  Select up to 4 actions for each fault." VALUE 0x800004C1 RecordLayout_3 0 CompuMethod_156 0 255 /end CHARACTERISTIC
/begin CHARACTERISTIC FaultManager.Airflow2_RangeHigh.ID "Fault manager configuration.  Select up to 4 actions for each fault." VALUE 0x800004C2 RecordLayout_3 0 CompuMethod_1 0 255 /end CHARACTERISTIC
/begin CHARACTERISTIC FaultManager.Airflow2_RangeHigh.Test "Fault manager configuration.  Select up to 4 actions for each fault." VALUE 0x800004C3 RecordLayout_3 0 CompuMethod_157 0 255 /end CHARACTERISTIC
/begin CHARACTERISTIC FaultManager.Airflow2_RangeHigh.Faulty_Samples__X_ "Fault manager configuration.  Select up to 4 actions for each fault." VALUE 0x800004C4 RecordLayout_3 0 CompuMethod_1 0 255 /end CHARACTERISTIC
/begin CHARACTERISTIC FaultManager.Airflow2_RangeHigh.Total_Samples__Y_ "Fault manager configuration.  Select up to 4 actions for each fault." VALUE 0x800004C5 RecordLayout_3 0 CompuMethod_1 0 255 /end CHARACTERISTIC
/begin CHARACTERISTIC FaultManager.Airflow2_RangeHigh.Action_1 "Fault manager configuration.  Select up to 4 actions for each fault." VALUE 0x800004C6 RecordLayout_3 0 CompuMethod_158 0 255 /end CHARACTERISTIC
/begin CHARACTERISTIC FaultManager.Airflow2_RangeHigh.Action_1_Condition "Fault manager configuration.  Select up to 4 actions for each fault." VALUE 0x800004C7 RecordLayout_3 0 CompuMethod_159 0 255 /end CHARACTERISTIC
/begin CHARACTERISTIC FaultManager.Airflow2_RangeHigh.Action_2 "Fault manager configuration.  Select up to 4 actions for each fault." VALUE 0x800004C8 RecordLayout_3 0 CompuMethod_158 0 255 /end CHARACTERISTIC
/begin CHARACTERISTIC FaultManager.Airflow2_RangeHigh.Action_2_Condition "Fault manager configuration.  Select up to 4 actions for each fault." VALUE 0x800004C9 RecordLayout_3 0 CompuMethod_159 0 255 /end CHARACTERISTIC
/begin CHARACTERISTIC FaultManager.Airflow2_RangeHigh.Action_3 "Fault manager configuration.  Select up to 4 actions for each fault." VALUE 0x800004CA RecordLayout_3 0 CompuMethod_158 0 255 /end CHARACTERISTIC
/begin CHARACTERISTIC FaultManager.Airflow2_RangeHigh.Action_3_Condition "Fault manager configuration.  Select up to 4 actions for each fault." VALUE 0x800004CB RecordLayout_3 0 CompuMethod_159 0 255 /end CHARACTERISTIC
/begin CHARACTERISTIC FaultManager.Airflow2_RangeHigh.Action_4 "Fault manager configuration.  Select up to 4 actions for each fault." VALUE 0x800004CC RecordLayout_3 0 CompuMethod_158 0 255 /end CHARACTERISTIC
/begin CHARACTERISTIC FaultManager.Airflow2_RangeHigh.Action_4_Condition "Fault manager configuration.  Select up to 4 actions for each fault." VALUE 0x800004CD RecordLayout_3 0 CompuMethod_159 0 255 /end CHARACTERISTIC
/begin CHARACTERISTIC FaultManager.Airflow2_RangeLow.Mode "Fault manager configuration.  Select up to 4 actions for each fault." VALUE 0x800004CE RecordLayout_3 0 CompuMethod_156 0 255 /end CHARACTERISTIC
/begin CHARACTERISTIC FaultManager.Airflow2_RangeLow.ID "Fault manager configuration.  Select up to 4 actions for each fault." VALUE 0x800004CF RecordLayout_3 0 CompuMethod_1 0 255 /end CHARACTERISTIC
/begin CHARACTERISTIC FaultManager.Airflow2_RangeLow.Test "Fault manager configuration.  Select up to 4 actions for each fault." VALUE 0x800004D0 RecordLayout_3 0 CompuMethod_157 0 255 /end CHARACTERISTIC
/begin CHARACTERISTIC FaultManager.Airflow2_RangeLow.Faulty_Samples__X_ "Fault manager configuration.  Select up to 4 actions for each fault." VALUE 0x800004D1 RecordLayout_3 0 CompuMethod_1 0 255 /end CHARACTERISTIC
/begin CHARACTERISTIC FaultManager.Airflow2_RangeLow.Total_Samples__Y_ "Fault manager configuration.  Select up to 4 actions for each fault." VALUE 0x800004D2 RecordLayout_3 0 CompuMethod_1 0 255 /end CHARACTERISTIC
/begin CHARACTERISTIC FaultManager.Airflow2_RangeLow.Action_1 "Fault manager configuration.  Select up to 4 actions for each fault." VALUE 0x800004D3 RecordLayout_3 0 CompuMethod_158 0 255 /end CHARACTERISTIC
/begin CHARACTERISTIC FaultManager.Airflow2_RangeLow.Action_1_Condition "Fault manager configuration.  Select up to 4 actions for each fault." VALUE 0x800004D4 RecordLayout_3 0 CompuMethod_159 0 255 /end CHARACTERISTIC
/begin CHARACTERISTIC FaultManager.Airflow2_RangeLow.Action_2 "Fault manager configuration.  Select up to 4 actions for each fault." VALUE 0x800004D5 RecordLayout_3 0 CompuMethod_158 0 255 /end CHARACTERISTIC
/begin CHARACTERISTIC FaultManager.Airflow2_RangeLow.Action_2_Condition "Fault manager configuration.  Select up to 4 actions for each fault." VALUE 0x800004D6 RecordLayout_3 0 CompuMethod_159 0 255 /end CHARACTERISTIC
/begin CHARACTERISTIC FaultManager.Airflow2_RangeLow.Action_3 "Fault manager configuration.  Select up to 4 actions for each fault." VALUE 0x800004D7 RecordLayout_3 0 CompuMethod_158 0 255 /end CHARACTERISTIC
/begin CHARACTERISTIC FaultManager.Airflow2_RangeLow.Action_3_Condition "Fault manager configuration.  Select up to 4 actions for each fault." VALUE 0x800004D8 RecordLayout_3 0 CompuMethod_159 0 255 /end CHARACTERISTIC
/begin CHARACTERISTIC FaultManager.Airflow2_RangeLow.Action_4 "Fault manager configuration.  Select up to 4 actions for each fault." VALUE 0x800004D9 RecordLayout_3 0 CompuMethod_158 0 255 /end CHARACTERISTIC
/begin CHARACTERISTIC FaultManager.Airflow2_RangeLow.Action_4_Condition "Fault manager configuration.  Select up to 4 actions for each fault." VALUE 0x800004DA RecordLayout_3 0 CompuMethod_159 0 255 /end CHARACTERISTIC
/begin CHARACTERISTIC FaultManager.Airflow3_RangeHigh.Mode "Fault manager configuration.  Select up to 4 actions for each fault." VALUE 0x800004DB RecordLayout_3 0 CompuMethod_156 0 255 /end CHARACTERISTIC
/begin CHARACTERISTIC FaultManager.Airflow3_RangeHigh.ID "Fault manager configuration.  Select up to 4 actions for each fault." VALUE 0x800004DC RecordLayout_3 0 CompuMethod_1 0 255 /end CHARACTERISTIC
/begin CHARACTERISTIC FaultManager.Airflow3_RangeHigh.Test "Fault manager configuration.  Select up to 4 actions for each fault." VALUE 0x800004DD RecordLayout_3 0 CompuMethod_157 0 255 /end CHARACTERISTIC
/begin CHARACTERISTIC FaultManager.Airflow3_RangeHigh.Faulty_Samples__X_ "Fault manager configuration.  Select up to 4 actions for each fault." VALUE 0x800004DE RecordLayout_3 0 CompuMethod_1 0 255 /end CHARACTERISTIC
/begin CHARACTERISTIC FaultManager.Airflow3_RangeHigh.Total_Samples__Y_ "Fault manager configuration.  Select up to 4 actions for each fault." VALUE 0x800004DF RecordLayout_3 0 CompuMethod_1 0 255 /end CHARACTERISTIC
/begin CHARACTERISTIC FaultManager.Airflow3_RangeHigh.Action_1 "Fault manager configuration.  Select up to 4 actions for each fault." VALUE 0x800004E0 RecordLayout_3 0 CompuMethod_158 0 255 /end CHARACTERISTIC
/begin CHARACTERISTIC FaultManager.Airflow3_RangeHigh.Action_1_Condition "Fault manager configuration.  Select up to 4 actions for each fault." VALUE 0x800004E1 RecordLayout_3 0 CompuMethod_159 0 255 /end CHARACTERISTIC
/begin CHARACTERISTIC FaultManager.Airflow3_RangeHigh.Action_2 "Fault manager configuration.  Select up to 4 actions for each fault." VALUE 0x800004E2 RecordLayout_3 0 CompuMethod_158 0 255 /end CHARACTERISTIC
/begin CHARACTERISTIC FaultManager.Airflow3_RangeHigh.Action_2_Condition "Fault manager configuration.  Select up to 4 actions for each fault." VALUE 0x800004E3 RecordLayout_3 0 CompuMethod_159 0 255 /end CHARACTERISTIC
/begin CHARACTERISTIC FaultManager.Airflow3_RangeHigh.Action_3 "Fault manager configuration.  Select up to 4 actions for each fault." VALUE 0x800004E4 RecordLayout_3 0 CompuMethod_158 0 255 /end CHARACTERISTIC
/begin CHARACTERISTIC FaultManager.Airflow3_RangeHigh.Action_3_Condition "Fault manager configuration.  Select up to 4 actions for each fault." VALUE 0x800004E5 RecordLayout_3 0 CompuMethod_159 0 255 /end CHARACTERISTIC
/begin CHARACTERISTIC FaultManager.Airflow3_RangeHigh.Action_4 "Fault manager configuration.  Select up to 4 actions for each fault." VALUE 0x800004E6 RecordLayout_3 0 CompuMethod_158 0 255 /end CHARACTERISTIC
/begin CHARACTERISTIC FaultManager.Airflow3_RangeHigh.Action_4_Condition "Fault manager configuration.  Select up to 4 actions for each fault." VALUE 0x800004E7 RecordLayout_3 0 CompuMethod_159 0 255 /end CHARACTERISTIC
/begin CHARACTERISTIC FaultManager.Airflow3_RangeLow.Mode "Fault manager configuration.  Select up to 4 actions for each fault." VALUE 0x800004E8 RecordLayout_3 0 CompuMethod_156 0 255 /end CHARACTERISTIC
/begin CHARACTERISTIC FaultManager.Airflow3_RangeLow.ID "Fault manager configuration.  Select up to 4 actions for each fault." VALUE 0x800004E9 RecordLayout_3 0 CompuMethod_1 0 255 /end CHARACTERISTIC
/begin CHARACTERISTIC FaultManager.Airflow3_RangeLow.Test "Fault manager configuration.  Select up to 4 actions for each fault." VALUE 0x800004EA RecordLayout_3 0 CompuMethod_157 0 255 /end CHARACTERISTIC
/begin CHARACTERISTIC FaultManager.Airflow3_RangeLow.Faulty_Samples__X_ "Fault manager configuration.  Select up to 4 actions for each fault." VALUE 0x800004EB RecordLayout_3 0 CompuMethod_1 0 255 /end CHARACTERISTIC
/begin CHARACTERISTIC FaultManager.Airflow3_RangeLow.Total_Samples__Y_ "Fault manager configuration.  Select up to 4 actions for each fault." VALUE 0x800004EC RecordLayout_3 0 CompuMethod_1 0 255 /end CHARACTERISTIC
/begin CHARACTERISTIC FaultManager.Airflow3_RangeLow.Action_1 "Fault manager configuration.  Select up to 4 actions for each fault." VALUE 0x800004ED RecordLayout_3 0 CompuMethod_158 0 255 /end CHARACTERISTIC
/begin CHARACTERISTIC FaultManager.Airflow3_RangeLow.Action_1_Condition "Fault manager configuration.  Select up to 4 actions for each fault." VALUE 0x800004EE RecordLayout_3 0 CompuMethod_159 0 255 /end CHARACTERISTIC
/begin CHARACTERISTIC FaultManager.Airflow3_RangeLow.Action_2 "Fault manager configuration.  Select up to 4 actions for each fault." VALUE 0x800004EF RecordLayout_3 0 CompuMethod_158 0 255 /end CHARACTERISTIC
/begin CHARACTERISTIC FaultManager.Airflow3_RangeLow.Action_2_Condition "Fault manager configuration.  Select up to 4 actions for each fault." VALUE 0x800004F0 RecordLayout_3 0 CompuMethod_159 0 255 /end CHARACTERISTIC
/begin CHARACTERISTIC FaultManager.Airflow3_RangeLow.Action_3 "Fault manager configuration.  Select up to 4 actions for each fault." VALUE 0x800004F1 RecordLayout_3 0 CompuMethod_158 0 255 /end CHARACTERISTIC
/begin CHARACTERISTIC FaultManager.Airflow3_RangeLow.Action_3_Condition "Fault manager configuration.  Select up to 4 actions for each fault." VALUE 0x800004F2 RecordLayout_3 0 CompuMethod_159 0 255 /end CHARACTERISTIC
/begin CHARACTERISTIC FaultManager.Airflow3_RangeLow.Action_4 "Fault manager configuration.  Select up to 4 actions for each fault." VALUE 0x800004F3 RecordLayout_3 0 CompuMethod_158 0 255 /end CHARACTERISTIC
/begin CHARACTERISTIC FaultManager.Airflow3_RangeLow.Action_4_Condition "Fault manager configuration.  Select up to 4 actions for each fault." VALUE 0x800004F4 RecordLayout_3 0 CompuMethod_159 0 255 /end CHARACTERISTIC
/begin CHARACTERISTIC FaultManager.Airflow_RangeHigh.Mode "Fault manager configuration.  Select up to 4 actions for each fault." VALUE 0x800004F5 RecordLayout_3 0 CompuMethod_156 0 255 /end CHARACTERISTIC
/begin CHARACTERISTIC FaultManager.Airflow_RangeHigh.ID "Fault manager configuration.  Select up to 4 actions for each fault." VALUE 0x800004F6 RecordLayout_3 0 CompuMethod_1 0 255 /end CHARACTERISTIC
/begin CHARACTERISTIC FaultManager.Airflow_RangeHigh.Test "Fault manager configuration.  Select up to 4 actions for each fault." VALUE 0x800004F7 RecordLayout_3 0 CompuMethod_157 0 255 /end CHARACTERISTIC
/begin CHARACTERISTIC FaultManager.Airflow_RangeHigh.Faulty_Samples__X_ "Fault manager configuration.  Select up to 4 actions for each fault." VALUE 0x800004F8 RecordLayout_3 0 CompuMethod_1 0 255 /end CHARACTERISTIC
/begin CHARACTERISTIC FaultManager.Airflow_RangeHigh.Total_Samples__Y_ "Fault manager configuration.  Select up to 4 actions for each fault." VALUE 0x800004F9 RecordLayout_3 0 CompuMethod_1 0 255 /end CHARACTERISTIC
/begin CHARACTERISTIC FaultManager.Airflow_RangeHigh.Action_1 "Fault manager configuration.  Select up to 4 actions for each fault." VALUE 0x800004FA RecordLayout_3 0 CompuMethod_158 0 255 /end CHARACTERISTIC
/begin CHARACTERISTIC FaultManager.Airflow_RangeHigh.Action_1_Condition "Fault manager configuration.  Select up to 4 actions for each fault." VALUE 0x800004FB RecordLayout_3 0 CompuMethod_159 0 255 /end CHARACTERISTIC
/begin CHARACTERISTIC FaultManager.Airflow_RangeHigh.Action_2 "Fault manager configuration.  Select up to 4 actions for each fault." VALUE 0x800004FC RecordLayout_3 0 CompuMethod_158 0 255 /end CHARACTERISTIC
/begin CHARACTERISTIC FaultManager.Airflow_RangeHigh.Action_2_Condition "Fault manager configuration.  Select up to 4 actions for each fault." VALUE 0x800004FD RecordLayout_3 0 CompuMethod_159 0 255 /end CHARACTERISTIC
/begin CHARACTERISTIC FaultManager.Airflow_RangeHigh.Action_3 "Fault manager configuration.  Select up to 4 actions for each fault." VALUE 0x800004FE RecordLayout_3 0 CompuMethod_158 0 255 /end CHARACTERISTIC
/begin CHARACTERISTIC FaultManager.Airflow_RangeHigh.Action_3_Condition "Fault manager configuration.  Select up to 4 actions for each fault." VALUE 0x800004FF RecordLayout_3 0 CompuMethod_159 0 255 /end CHARACTERISTIC
/begin CHARACTERISTIC FaultManager.Airflow_RangeHigh.Action_4 "Fault manager configuration.  Select up to 4 actions for each fault." VALUE 0x80000500 RecordLayout_3 0 CompuMethod_158 0 255 /end CHARACTERISTIC
/begin CHARACTERISTIC FaultManager.Airflow_RangeHigh.Action_4_Condition "Fault manager configuration.  Select up to 4 actions for each fault." VALUE 0x80000501 RecordLayout_3 0 CompuMethod_159 0 255 /end CHARACTERISTIC
/begin CHARACTERISTIC FaultManager.Airflow_RangeLow.Mode "Fault manager configuration.  Select up to 4 actions for each fault." VALUE 0x80000502 RecordLayout_3 0 CompuMethod_156 0 255 /end CHARACTERISTIC
/begin CHARACTERISTIC FaultManager.Airflow_RangeLow.ID "Fault manager configuration.  Select up to 4 actions for each fault." VALUE 0x80000503 RecordLayout_3 0 CompuMethod_1 0 255 /end CHARACTERISTIC
/begin CHARACTERISTIC FaultManager.Airflow_RangeLow.Test "Fault manager configuration.  Select up to 4 actions for each fault." VALUE 0x80000504 RecordLayout_3 0 CompuMethod_157 0 255 /end CHARACTERISTIC
/begin CHARACTERISTIC FaultManager.Airflow_RangeLow.Faulty_Samples__X_ "Fault manager configuration.  Select up to 4 actions for each fault." VALUE 0x80000505 RecordLayout_3 0 CompuMethod_1 0 255 /end CHARACTERISTIC
/begin CHARACTERISTIC FaultManager.Airflow_RangeLow.Total_Samples__Y_ "Fault manager configuration.  Select up to 4 actions for each fault." VALUE 0x80000506 RecordLayout_3 0 CompuMethod_1 0 255 /end CHARACTERISTIC
/begin CHARACTERISTIC FaultManager.Airflow_RangeLow.Action_1 "Fault manager configuration.  Select up to 4 actions for each fault." VALUE 0x80000507 RecordLayout_3 0 CompuMethod_158 0 255 /end CHARACTERISTIC
/begin CHARACTERISTIC FaultManager.Airflow_RangeLow.Action_1_Condition "Fault manager configuration.  Select up to 4 actions for each fault." VALUE 0x80000508 RecordLayout_3 0 CompuMethod_159 0 255 /end CHARACTERISTIC
/begin CHARACTERISTIC FaultManager.Airflow_RangeLow.Action_2 "Fault manager configuration.  Select up to 4 actions for each fault." VALUE 0x80000509 RecordLayout_3 0 CompuMethod_158 0 255 /end CHARACTERISTIC
/begin CHARACTERISTIC FaultManager.Airflow_RangeLow.Action_2_Condition "Fault manager configuration.  Select up to 4 actions for each fault." VALUE 0x8000050A RecordLayout_3 0 CompuMethod_159 0 255 /end CHARACTERISTIC
/begin CHARACTERISTIC FaultManager.Airflow_RangeLow.Action_3 "Fault manager configuration.  Select up to 4 actions for each fault." VALUE 0x8000050B RecordLayout_3 0 CompuMethod_158 0 255 /end CHARACTERISTIC
/begin CHARACTERISTIC FaultManager.Airflow_RangeLow.Action_3_Condition "Fault manager configuration.  Select up to 4 actions for each fault." VALUE 0x8000050C RecordLayout_3 0 CompuMethod_159 0 255 /end CHARACTERISTIC
/begin CHARACTERISTIC FaultManager.Airflow_RangeLow.Action_4 "Fault manager configuration.  Select up to 4 actions for each fault." VALUE 0x8000050D RecordLayout_3 0 CompuMethod_158 0 255 /end CHARACTERISTIC
/begin CHARACTERISTIC FaultManager.Airflow_RangeLow.Action_4_Condition "Fault manager configuration.  Select up to 4 actions for each fault." VALUE 0x8000050E RecordLayout_3 0 CompuMethod_159 0 255 /end CHARACTERISTIC
/begin CHARACTERISTIC FaultManager.CCVS_Stale.Mode "Fault manager configuration.  Select up to 4 actions for each fault." VALUE 0x8000050F RecordLayout_3 0 CompuMethod_156 0 255 /end CHARACTERISTIC
/begin CHARACTERISTIC FaultManager.CCVS_Stale.ID "Fault manager configuration.  Select up to 4 actions for each fault." VALUE 0x80000510 RecordLayout_3 0 CompuMethod_1 0 255 /end CHARACTERISTIC
/begin CHARACTERISTIC FaultManager.CCVS_Stale.Test "Fault manager configuration.  Select up to 4 actions for each fault." VALUE 0x80000511 RecordLayout_3 0 CompuMethod_157 0 255 /end CHARACTERISTIC
/begin CHARACTERISTIC FaultManager.CCVS_Stale.Faulty_Samples__X_ "Fault manager configuration.  Select up to 4 actions for each fault." VALUE 0x80000512 RecordLayout_3 0 CompuMethod_1 0 255 /end CHARACTERISTIC
/begin CHARACTERISTIC FaultManager.CCVS_Stale.Total_Samples__Y_ "Fault manager configuration.  Select up to 4 actions for each fault." VALUE 0x80000513 RecordLayout_3 0 CompuMethod_1 0 255 /end CHARACTERISTIC
/begin CHARACTERISTIC FaultManager.CCVS_Stale.Action_1 "Fault manager configuration.  Select up to 4 actions for each fault." VALUE 0x80000514 RecordLayout_3 0 CompuMethod_158 0 255 /end CHARACTERISTIC
/begin CHARACTERISTIC FaultManager.CCVS_Stale.Action_1_Condition "Fault manager configuration.  Select up to 4 actions for each fault." VALUE 0x80000515 RecordLayout_3 0 CompuMethod_159 0 255 /end CHARACTERISTIC
/begin CHARACTERISTIC FaultManager.CCVS_Stale.Action_2 "Fault manager configuration.  Select up to 4 actions for each fault." VALUE 0x80000516 RecordLayout_3 0 CompuMethod_158 0 255 /end CHARACTERISTIC
/begin CHARACTERISTIC FaultManager.CCVS_Stale.Action_2_Condition "Fault manager configuration.  Select up to 4 actions for each fault." VALUE 0x80000517 RecordLayout_3 0 CompuMethod_159 0 255 /end CHARACTERISTIC
/begin CHARACTERISTIC FaultManager.CCVS_Stale.Action_3 "Fault manager configuration.  Select up to 4 actions for each fault." VALUE 0x80000518 RecordLayout_3 0 CompuMethod_158 0 255 /end CHARACTERISTIC
/begin CHARACTERISTIC FaultManager.CCVS_Stale.Action_3_Condition "Fault manager configuration.  Select up to 4 actions for each fault." VALUE 0x80000519 RecordLayout_3 0 CompuMethod_159 0 255 /end CHARACTERISTIC
/begin CHARACTERISTIC FaultManager.CCVS_Stale.Action_4 "Fault manager configuration.  Select up to 4 actions for each fault." VALUE 0x8000051A RecordLayout_3 0 CompuMethod_158 0 255 /end CHARACTERISTIC
/begin CHARACTERISTIC FaultManager.CCVS_Stale.Action_4_Condition "Fault manager configuration.  Select up to 4 actions for each fault." VALUE 0x8000051B RecordLayout_3 0 CompuMethod_159 0 255 /end CHARACTERISTIC
/begin CHARACTERISTIC FaultManager.COOLT_RangeHigh.Mode "Fault manager configuration.  Select up to 4 actions for each fault." VALUE 0x8000051C RecordLayout_3 0 CompuMethod_156 0 255 /end CHARACTERISTIC
/begin CHARACTERISTIC FaultManager.COOLT_RangeHigh.ID "Fault manager configuration.  Select up to 4 actions for each fault." VALUE 0x8000051D RecordLayout_3 0 CompuMethod_1 0 255 /end CHARACTERISTIC
/begin CHARACTERISTIC FaultManager.COOLT_RangeHigh.Test "Fault manager configuration.  Select up to 4 actions for each fault." VALUE 0x8000051E RecordLayout_3 0 CompuMethod_157 0 255 /end CHARACTERISTIC
/begin CHARACTERISTIC FaultManager.COOLT_RangeHigh.Faulty_Samples__X_ "Fault manager configuration.  Select up to 4 actions for each fault." VALUE 0x8000051F RecordLayout_3 0 CompuMethod_1 0 255 /end CHARACTERISTIC
/begin CHARACTERISTIC FaultManager.COOLT_RangeHigh.Total_Samples__Y_ "Fault manager configuration.  Select up to 4 actions for each fault." VALUE 0x80000520 RecordLayout_3 0 CompuMethod_1 0 255 /end CHARACTERISTIC
/begin CHARACTERISTIC FaultManager.COOLT_RangeHigh.Action_1 "Fault manager configuration.  Select up to 4 actions for each fault." VALUE 0x80000521 RecordLayout_3 0 CompuMethod_158 0 255 /end CHARACTERISTIC
/begin CHARACTERISTIC FaultManager.COOLT_RangeHigh.Action_1_Condition "Fault manager configuration.  Select up to 4 actions for each fault." VALUE 0x80000522 RecordLayout_3 0 CompuMethod_159 0 255 /end CHARACTERISTIC
/begin CHARACTERISTIC FaultManager.COOLT_RangeHigh.Action_2 "Fault manager configuration.  Select up to 4 actions for each fault." VALUE 0x80000523 RecordLayout_3 0 CompuMethod_158 0 255 /end CHARACTERISTIC
/begin CHARACTERISTIC FaultManager.COOLT_RangeHigh.Action_2_Condition "Fault manager configuration.  Select up to 4 actions for each fault." VALUE 0x80000524 RecordLayout_3 0 CompuMethod_159 0 255 /end CHARACTERISTIC
/begin CHARACTERISTIC FaultManager.COOLT_RangeHigh.Action_3 "Fault manager configuration.  Select up to 4 actions for each fault." VALUE 0x80000525 RecordLayout_3 0 CompuMethod_158 0 255 /end CHARACTERISTIC
/begin CHARACTERISTIC FaultManager.COOLT_RangeHigh.Action_3_Condition "Fault manager configuration.  Select up to 4 actions for each fault." VALUE 0x80000526 RecordLayout_3 0 CompuMethod_159 0 255 /end CHARACTERISTIC
/begin CHARACTERISTIC FaultManager.COOLT_RangeHigh.Action_4 "Fault manager configuration.  Select up to 4 actions for each fault." VALUE 0x80000527 RecordLayout_3 0 CompuMethod_158 0 255 /end CHARACTERISTIC
/begin CHARACTERISTIC FaultManager.COOLT_RangeHigh.Action_4_Condition "Fault manager configuration.  Select up to 4 actions for each fault." VALUE 0x80000528 RecordLayout_3 0 CompuMethod_159 0 255 /end CHARACTERISTIC
/begin CHARACTERISTIC FaultManager.COOLT_RangeLow.Mode "Fault manager configuration.  Select up to 4 actions for each fault." VALUE 0x80000529 RecordLayout_3 0 CompuMethod_156 0 255 /end CHARACTERISTIC
/begin CHARACTERISTIC FaultManager.COOLT_RangeLow.ID "Fault manager configuration.  Select up to 4 actions for each fault." VALUE 0x8000052A RecordLayout_3 0 CompuMethod_1 0 255 /end CHARACTERISTIC
/begin CHARACTERISTIC FaultManager.COOLT_RangeLow.Test "Fault manager configuration.  Select up to 4 actions for each fault." VALUE 0x8000052B RecordLayout_3 0 CompuMethod_157 0 255 /end CHARACTERISTIC
/begin CHARACTERISTIC FaultManager.COOLT_RangeLow.Faulty_Samples__X_ "Fault manager configuration.  Select up to 4 actions for each fault." VALUE 0x8000052C RecordLayout_3 0 CompuMethod_1 0 255 /end CHARACTERISTIC
/begin CHARACTERISTIC FaultManager.COOLT_RangeLow.Total_Samples__Y_ "Fault manager configuration.  Select up to 4 actions for each fault." VALUE 0x8000052D RecordLayout_3 0 CompuMethod_1 0 255 /end CHARACTERISTIC
/begin CHARACTERISTIC FaultManager.COOLT_RangeLow.Action_1 "Fault manager configuration.  Select up to 4 actions for each fault." VALUE 0x8000052E RecordLayout_3 0 CompuMethod_158 0 255 /end CHARACTERISTIC
/begin CHARACTERISTIC FaultManager.COOLT_RangeLow.Action_1_Condition "Fault manager configuration.  Select up to 4 actions for each fault." VALUE 0x8000052F RecordLayout_3 0 CompuMethod_159 0 255 /end CHARACTERISTIC
/begin CHARACTERISTIC FaultManager.COOLT_RangeLow.Action_2 "Fault manager configuration.  Select up to 4 actions for each fault." VALUE 0x80000530 RecordLayout_3 0 CompuMethod_158 0 255 /end CHARACTERISTIC
/begin CHARACTERISTIC FaultManager.COOLT_RangeLow.Action_2_Condition "Fault manager configuration.  Select up to 4 actions for each fault." VALUE 0x80000531 RecordLayout_3 0 CompuMethod_159 0 255 /end CHARACTERISTIC
/begin CHARACTERISTIC FaultManager.COOLT_RangeLow.Action_3 "Fault manager configuration.  Select up to 4 actions for each fault." VALUE 0x80000532 RecordLayout_3 0 CompuMethod_158 0 255 /end CHARACTERISTIC
/begin CHARACTERISTIC FaultManager.COOLT_RangeLow.Action_3_Condition "Fault manager configuration.  Select up to 4 actions for each fault." VALUE 0x80000533 RecordLayout_3 0 CompuMethod_159 0 255 /end CHARACTERISTIC
/begin CHARACTERISTIC FaultManager.COOLT_RangeLow.Action_4 "Fault manager configuration.  Select up to 4 actions for each fault." VALUE 0x80000534 RecordLayout_3 0 CompuMethod_158 0 255 /end CHARACTERISTIC
/begin CHARACTERISTIC FaultManager.COOLT_RangeLow.Action_4_Condition "Fault manager configuration.  Select up to 4 actions for each fault." VALUE 0x80000535 RecordLayout_3 0 CompuMethod_159 0 255 /end CHARACTERISTIC
/begin CHARACTERISTIC FaultManager.CoolP_RangeHigh.Mode "Fault manager configuration.  Select up to 4 actions for each fault." VALUE 0x80000536 RecordLayout_3 0 CompuMethod_156 0 255 /end CHARACTERISTIC
/begin CHARACTERISTIC FaultManager.CoolP_RangeHigh.ID "Fault manager configuration.  Select up to 4 actions for each fault." VALUE 0x80000537 RecordLayout_3 0 CompuMethod_1 0 255 /end CHARACTERISTIC
/begin CHARACTERISTIC FaultManager.CoolP_RangeHigh.Test "Fault manager configuration.  Select up to 4 actions for each fault." VALUE 0x80000538 RecordLayout_3 0 CompuMethod_157 0 255 /end CHARACTERISTIC
/begin CHARACTERISTIC FaultManager.CoolP_RangeHigh.Faulty_Samples__X_ "Fault manager configuration.  Select up to 4 actions for each fault." VALUE 0x80000539 RecordLayout_3 0 CompuMethod_1 0 255 /end CHARACTERISTIC
/begin CHARACTERISTIC FaultManager.CoolP_RangeHigh.Total_Samples__Y_ "Fault manager configuration.  Select up to 4 actions for each fault." VALUE 0x8000053A RecordLayout_3 0 CompuMethod_1 0 255 /end CHARACTERISTIC
/begin CHARACTERISTIC FaultManager.CoolP_RangeHigh.Action_1 "Fault manager configuration.  Select up to 4 actions for each fault." VALUE 0x8000053B RecordLayout_3 0 CompuMethod_158 0 255 /end CHARACTERISTIC
/begin CHARACTERISTIC FaultManager.CoolP_RangeHigh.Action_1_Condition "Fault manager configuration.  Select up to 4 actions for each fault." VALUE 0x8000053C RecordLayout_3 0 CompuMethod_159 0 255 /end CHARACTERISTIC
/begin CHARACTERISTIC FaultManager.CoolP_RangeHigh.Action_2 "Fault manager configuration.  Select up to 4 actions for each fault." VALUE 0x8000053D RecordLayout_3 0 CompuMethod_158 0 255 /end CHARACTERISTIC
/begin CHARACTERISTIC FaultManager.CoolP_RangeHigh.Action_2_Condition "Fault manager configuration.  Select up to 4 actions for each fault." VALUE 0x8000053E RecordLayout_3 0 CompuMethod_159 0 255 /end CHARACTERISTIC
/begin CHARACTERISTIC FaultManager.CoolP_RangeHigh.Action_3 "Fault manager configuration.  Select up to 4 actions for each fault." VALUE 0x8000053F RecordLayout_3 0 CompuMethod_158 0 255 /end CHARACTERISTIC
/begin CHARACTERISTIC FaultManager.CoolP_RangeHigh.Action_3_Condition "Fault manager configuration.  Select up to 4 actions for each fault." VALUE 0x80000540 RecordLayout_3 0 CompuMethod_159 0 255 /end CHARACTERISTIC
/begin CHARACTERISTIC FaultManager.CoolP_RangeHigh.Action_4 "Fault manager configuration.  Select up to 4 actions for each fault." VALUE 0x80000541 RecordLayout_3 0 CompuMethod_158 0 255 /end CHARACTERISTIC
/begin CHARACTERISTIC FaultManager.CoolP_RangeHigh.Action_4_Condition "Fault manager configuration.  Select up to 4 actions for each fault." VALUE 0x80000542 RecordLayout_3 0 CompuMethod_159 0 255 /end CHARACTERISTIC
/begin CHARACTERISTIC FaultManager.CoolP_RangeLow.Mode "Fault manager configuration.  Select up to 4 actions for each fault." VALUE 0x80000543 RecordLayout_3 0 CompuMethod_156 0 255 /end CHARACTERISTIC
/begin CHARACTERISTIC FaultManager.CoolP_RangeLow.ID "Fault manager configuration.  Select up to 4 actions for each fault." VALUE 0x80000544 RecordLayout_3 0 CompuMethod_1 0 255 /end CHARACTERISTIC
/begin CHARACTERISTIC FaultManager.CoolP_RangeLow.Test "Fault manager configuration.  Select up to 4 actions for each fault." VALUE 0x80000545 RecordLayout_3 0 CompuMethod_157 0 255 /end CHARACTERISTIC
/begin CHARACTERISTIC FaultManager.CoolP_RangeLow.Faulty_Samples__X_ "Fault manager configuration.  Select up to 4 actions for each fault." VALUE 0x80000546 RecordLayout_3 0 CompuMethod_1 0 255 /end CHARACTERISTIC
/begin CHARACTERISTIC FaultManager.CoolP_RangeLow.Total_Samples__Y_ "Fault manager configuration.  Select up to 4 actions for each fault." VALUE 0x80000547 RecordLayout_3 0 CompuMethod_1 0 255 /end CHARACTERISTIC
/begin CHARACTERISTIC FaultManager.CoolP_RangeLow.Action_1 "Fault manager configuration.  Select up to 4 actions for each fault." VALUE 0x80000548 RecordLayout_3 0 CompuMethod_158 0 255 /end CHARACTERISTIC
/begin CHARACTERISTIC FaultManager.CoolP_RangeLow.Action_1_Condition "Fault manager configuration.  Select up to 4 actions for each fault." VALUE 0x80000549 RecordLayout_3 0 CompuMethod_159 0 255 /end CHARACTERISTIC
/begin CHARACTERISTIC FaultManager.CoolP_RangeLow.Action_2 "Fault manager configuration.  Select up to 4 actions for each fault." VALUE 0x8000054A RecordLayout_3 0 CompuMethod_158 0 255 /end CHARACTERISTIC
/begin CHARACTERISTIC FaultManager.CoolP_RangeLow.Action_2_Condition "Fault manager configuration.  Select up to 4 actions for each fault." VALUE 0x8000054B RecordLayout_3 0 CompuMethod_159 0 255 /end CHARACTERISTIC
/begin CHARACTERISTIC FaultManager.CoolP_RangeLow.Action_3 "Fault manager configuration.  Select up to 4 actions for each fault." VALUE 0x8000054C RecordLayout_3 0 CompuMethod_158 0 255 /end CHARACTERISTIC
/begin CHARACTERISTIC FaultManager.CoolP_RangeLow.Action_3_Condition "Fault manager configuration.  Select up to 4 actions for each fault." VALUE 0x8000054D RecordLayout_3 0 CompuMethod_159 0 255 /end CHARACTERISTIC
/begin CHARACTERISTIC FaultManager.CoolP_RangeLow.Action_4 "Fault manager configuration.  Select up to 4 actions for each fault." VALUE 0x8000054E RecordLayout_3 0 CompuMethod_158 0 255 /end CHARACTERISTIC
/begin CHARACTERISTIC FaultManager.CoolP_RangeLow.Action_4_Condition "Fault manager configuration.  Select up to 4 actions for each fault." VALUE 0x8000054F RecordLayout_3 0 CompuMethod_159 0 255 /end CHARACTERISTIC
/begin CHARACTERISTIC FaultManager.DRVP_RangeHigh.Mode "Fault manager configuration.  Select up to 4 actions for each fault." VALUE 0x80000550 RecordLayout_3 0 CompuMethod_156 0 255 /end CHARACTERISTIC
/begin CHARACTERISTIC FaultManager.DRVP_RangeHigh.ID "Fault manager configuration.  Select up to 4 actions for each fault." VALUE 0x80000551 RecordLayout_3 0 CompuMethod_1 0 255 /end CHARACTERISTIC
/begin CHARACTERISTIC FaultManager.DRVP_RangeHigh.Test "Fault manager configuration.  Select up to 4 actions for each fault." VALUE 0x80000552 RecordLayout_3 0 CompuMethod_157 0 255 /end CHARACTERISTIC
/begin CHARACTERISTIC FaultManager.DRVP_RangeHigh.Faulty_Samples__X_ "Fault manager configuration.  Select up to 4 actions for each fault." VALUE 0x80000553 RecordLayout_3 0 CompuMethod_1 0 255 /end CHARACTERISTIC
/begin CHARACTERISTIC FaultManager.DRVP_RangeHigh.Total_Samples__Y_ "Fault manager configuration.  Select up to 4 actions for each fault." VALUE 0x80000554 RecordLayout_3 0 CompuMethod_1 0 255 /end CHARACTERISTIC
/begin CHARACTERISTIC FaultManager.DRVP_RangeHigh.Action_1 "Fault manager configuration.  Select up to 4 actions for each fault." VALUE 0x80000555 RecordLayout_3 0 CompuMethod_158 0 255 /end CHARACTERISTIC
/begin CHARACTERISTIC FaultManager.DRVP_RangeHigh.Action_1_Condition "Fault manager configuration.  Select up to 4 actions for each fault." VALUE 0x80000556 RecordLayout_3 0 CompuMethod_159 0 255 /end CHARACTERISTIC
/begin CHARACTERISTIC FaultManager.DRVP_RangeHigh.Action_2 "Fault manager configuration.  Select up to 4 actions for each fault." VALUE 0x80000557 RecordLayout_3 0 CompuMethod_158 0 255 /end CHARACTERISTIC
/begin CHARACTERISTIC FaultManager.DRVP_RangeHigh.Action_2_Condition "Fault manager configuration.  Select up to 4 actions for each fault." VALUE 0x80000558 RecordLayout_3 0 CompuMethod_159 0 255 /end CHARACTERISTIC
/begin CHARACTERISTIC FaultManager.DRVP_RangeHigh.Action_3 "Fault manager configuration.  Select up to 4 actions for each fault." VALUE 0x80000559 RecordLayout_3 0 CompuMethod_158 0 255 /end CHARACTERISTIC
/begin CHARACTERISTIC FaultManager.DRVP_RangeHigh.Action_3_Condition "Fault manager configuration.  Select up to 4 actions for each fault." VALUE 0x8000055A RecordLayout_3 0 CompuMethod_159 0 255 /end CHARACTERISTIC
/begin CHARACTERISTIC FaultManager.DRVP_RangeHigh.Action_4 "Fault manager configuration.  Select up to 4 actions for each fault." VALUE 0x8000055B RecordLayout_3 0 CompuMethod_158 0 255 /end CHARACTERISTIC
/begin CHARACTERISTIC FaultManager.DRVP_RangeHigh.Action_4_Condition "Fault manager configuration.  Select up to 4 actions for each fault." VALUE 0x8000055C RecordLayout_3 0 CompuMethod_159 0 255 /end CHARACTERISTIC
/begin CHARACTERISTIC FaultManager.DRVP_RangeLow.Mode "Fault manager configuration.  Select up to 4 actions for each fault." VALUE 0x8000055D RecordLayout_3 0 CompuMethod_156 0 255 /end CHARACTERISTIC
/begin CHARACTERISTIC FaultManager.DRVP_RangeLow.ID "Fault manager configuration.  Select up to 4 actions for each fault." VALUE 0x8000055E RecordLayout_3 0 CompuMethod_1 0 255 /end CHARACTERISTIC
/begin CHARACTERISTIC FaultManager.DRVP_RangeLow.Test "Fault manager configuration.  Select up to 4 actions for each fault." VALUE 0x8000055F RecordLayout_3 0 CompuMethod_157 0 255 /end CHARACTERISTIC
/begin CHARACTERISTIC FaultManager.DRVP_RangeLow.Faulty_Samples__X_ "Fault manager configuration.  Select up to 4 actions for each fault." VALUE 0x80000560 RecordLayout_3 0 CompuMethod_1 0 255 /end CHARACTERISTIC
/begin CHARACTERISTIC FaultManager.DRVP_RangeLow.Total_Samples__Y_ "Fault manager configuration.  Select up to 4 actions for each fault." VALUE 0x80000561 RecordLayout_3 0 CompuMethod_1 0 255 /end CHARACTERISTIC
/begin CHARACTERISTIC FaultManager.DRVP_RangeLow.Action_1 "Fault manager configuration.  Select up to 4 actions for each fault." VALUE 0x80000562 RecordLayout_3 0 CompuMethod_158 0 255 /end CHARACTERISTIC
/begin CHARACTERISTIC FaultManager.DRVP_RangeLow.Action_1_Condition "Fault manager configuration.  Select up to 4 actions for each fault." VALUE 0x80000563 RecordLayout_3 0 CompuMethod_159 0 255 /end CHARACTERISTIC
/begin CHARACTERISTIC FaultManager.DRVP_RangeLow.Action_2 "Fault manager configuration.  Select up to 4 actions for each fault." VALUE 0x80000564 RecordLayout_3 0 CompuMethod_158 0 255 /end CHARACTERISTIC
/begin CHARACTERISTIC FaultManager.DRVP_RangeLow.Action_2_Condition "Fault manager configuration.  Select up to 4 actions for each fault." VALUE 0x80000565 RecordLayout_3 0 CompuMethod_159 0 255 /end CHARACTERISTIC
/begin CHARACTERISTIC FaultManager.DRVP_RangeLow.Action_3 "Fault manager configuration.  Select up to 4 actions for each fault." VALUE 0x80000566 RecordLayout_3 0 CompuMethod_158 0 255 /end CHARACTERISTIC
/begin CHARACTERISTIC FaultManager.DRVP_RangeLow.Action_3_Condition "Fault manager configuration.  Select up to 4 actions for each fault." VALUE 0x80000567 RecordLayout_3 0 CompuMethod_159 0 255 /end CHARACTERISTIC
/begin CHARACTERISTIC FaultManager.DRVP_RangeLow.Action_4 "Fault manager configuration.  Select up to 4 actions for each fault." VALUE 0x80000568 RecordLayout_3 0 CompuMethod_158 0 255 /end CHARACTERISTIC
/begin CHARACTERISTIC FaultManager.DRVP_RangeLow.Action_4_Condition "Fault manager configuration.  Select up to 4 actions for each fault." VALUE 0x80000569 RecordLayout_3 0 CompuMethod_159 0 255 /end CHARACTERISTIC
/begin CHARACTERISTIC FaultManager.ECUP_RangeHigh.Mode "Fault manager configuration.  Select up to 4 actions for each fault." VALUE 0x8000056A RecordLayout_3 0 CompuMethod_156 0 255 /end CHARACTERISTIC
/begin CHARACTERISTIC FaultManager.ECUP_RangeHigh.ID "Fault manager configuration.  Select up to 4 actions for each fault." VALUE 0x8000056B RecordLayout_3 0 CompuMethod_1 0 255 /end CHARACTERISTIC
/begin CHARACTERISTIC FaultManager.ECUP_RangeHigh.Test "Fault manager configuration.  Select up to 4 actions for each fault." VALUE 0x8000056C RecordLayout_3 0 CompuMethod_157 0 255 /end CHARACTERISTIC
/begin CHARACTERISTIC FaultManager.ECUP_RangeHigh.Faulty_Samples__X_ "Fault manager configuration.  Select up to 4 actions for each fault." VALUE 0x8000056D RecordLayout_3 0 CompuMethod_1 0 255 /end CHARACTERISTIC
/begin CHARACTERISTIC FaultManager.ECUP_RangeHigh.Total_Samples__Y_ "Fault manager configuration.  Select up to 4 actions for each fault." VALUE 0x8000056E RecordLayout_3 0 CompuMethod_1 0 255 /end CHARACTERISTIC
/begin CHARACTERISTIC FaultManager.ECUP_RangeHigh.Action_1 "Fault manager configuration.  Select up to 4 actions for each fault." VALUE 0x8000056F RecordLayout_3 0 CompuMethod_158 0 255 /end CHARACTERISTIC
/begin CHARACTERISTIC FaultManager.ECUP_RangeHigh.Action_1_Condition "Fault manager configuration.  Select up to 4 actions for each fault." VALUE 0x80000570 RecordLayout_3 0 CompuMethod_159 0 255 /end CHARACTERISTIC
/begin CHARACTERISTIC FaultManager.ECUP_RangeHigh.Action_2 "Fault manager configuration.  Select up to 4 actions for each fault." VALUE 0x80000571 RecordLayout_3 0 CompuMethod_158 0 255 /end CHARACTERISTIC
/begin CHARACTERISTIC FaultManager.ECUP_RangeHigh.Action_2_Condition "Fault manager configuration.  Select up to 4 actions for each fault." VALUE 0x80000572 RecordLayout_3 0 CompuMethod_159 0 255 /end CHARACTERISTIC
/begin CHARACTERISTIC FaultManager.ECUP_RangeHigh.Action_3 "Fault manager configuration.  Select up to 4 actions for each fault." VALUE 0x80000573 RecordLayout_3 0 CompuMethod_158 0 255 /end CHARACTERISTIC
/begin CHARACTERISTIC FaultManager.ECUP_RangeHigh.Action_3_Condition "Fault manager configuration.  Select up to 4 actions for each fault." VALUE 0x80000574 RecordLayout_3 0 CompuMethod_159 0 255 /end CHARACTERISTIC
/begin CHARACTERISTIC FaultManager.ECUP_RangeHigh.Action_4 "Fault manager configuration.  Select up to 4 actions for each fault." VALUE 0x80000575 RecordLayout_3 0 CompuMethod_158 0 255 /end CHARACTERISTIC
/begin CHARACTERISTIC FaultManager.ECUP_RangeHigh.Action_4_Condition "Fault manager configuration.  Select up to 4 actions for each fault." VALUE 0x80000576 RecordLayout_3 0 CompuMethod_159 0 255 /end CHARACTERISTIC
/begin CHARACTERISTIC FaultManager.ECUP_RangeLow.Mode "Fault manager configuration.  Select up to 4 actions for each fault." VALUE 0x80000577 RecordLayout_3 0 CompuMethod_156 0 255 /end CHARACTERISTIC
/begin CHARACTERISTIC FaultManager.ECUP_RangeLow.ID "Fault manager configuration.  Select up to 4 actions for each fault." VALUE 0x80000578 RecordLayout_3 0 CompuMethod_1 0 255 /end CHARACTERISTIC
/begin CHARACTERISTIC FaultManager.ECUP_RangeLow.Test "Fault manager configuration.  Select up to 4 actions for each fault." VALUE 0x80000579 RecordLayout_3 0 CompuMethod_157 0 255 /end CHARACTERISTIC
/begin CHARACTERISTIC FaultManager.ECUP_RangeLow.Faulty_Samples__X_ "Fault manager configuration.  Select up to 4 actions for each fault." VALUE 0x8000057A RecordLayout_3 0 CompuMethod_1 0 255 /end CHARACTERISTIC
/begin CHARACTERISTIC FaultManager.ECUP_RangeLow.Total_Samples__Y_ "Fault manager configuration.  Select up to 4 actions for each fault." VALUE 0x8000057B RecordLayout_3 0 CompuMethod_1 0 255 /end CHARACTERISTIC
/begin CHARACTERISTIC FaultManager.ECUP_RangeLow.Action_1 "Fault manager configuration.  Select up to 4 actions for each fault." VALUE 0x8000057C RecordLayout_3 0 CompuMethod_158 0 255 /end CHARACTERISTIC
/begin CHARACTERISTIC FaultManager.ECUP_RangeLow.Action_1_Condition "Fault manager configuration.  Select up to 4 actions for each fault." VALUE 0x8000057D RecordLayout_3 0 CompuMethod_159 0 255 /end CHARACTERISTIC
/begin CHARACTERISTIC FaultManager.ECUP_RangeLow.Action_2 "Fault manager configuration.  Select up to 4 actions for each fault." VALUE 0x8000057E RecordLayout_3 0 CompuMethod_158 0 255 /end CHARACTERISTIC
/begin CHARACTERISTIC FaultManager.ECUP_RangeLow.Action_2_Condition "Fault manager configuration.  Select up to 4 actions for each fault." VALUE 0x8000057F RecordLayout_3 0 CompuMethod_159 0 255 /end CHARACTERISTIC
/begin CHARACTERISTIC FaultManager.ECUP_RangeLow.Action_3 "Fault manager configuration.  Select up to 4 actions for each fault." VALUE 0x80000580 RecordLayout_3 0 CompuMethod_158 0 255 /end CHARACTERISTIC
/begin CHARACTERISTIC FaultManager.ECUP_RangeLow.Action_3_Condition "Fault manager configuration.  Select up to 4 actions for each fault." VALUE 0x80000581 RecordLayout_3 0 CompuMethod_159 0 255 /end CHARACTERISTIC
/begin CHARACTERISTIC FaultManager.ECUP_RangeLow.Action_4 "Fault manager configuration.  Select up to 4 actions for each fault." VALUE 0x80000582 RecordLayout_3 0 CompuMethod_158 0 255 /end CHARACTERISTIC
/begin CHARACTERISTIC FaultManager.ECUP_RangeLow.Action_4_Condition "Fault manager configuration.  Select up to 4 actions for each fault." VALUE 0x80000583 RecordLayout_3 0 CompuMethod_159 0 255 /end CHARACTERISTIC
/begin CHARACTERISTIC FaultManager.ETCPosA_RangeHigh.Mode "Fault manager configuration.  Select up to 4 actions for each fault." VALUE 0x80000584 RecordLayout_3 0 CompuMethod_156 0 255 /end CHARACTERISTIC
/begin CHARACTERISTIC FaultManager.ETCPosA_RangeHigh.ID "Fault manager configuration.  Select up to 4 actions for each fault." VALUE 0x80000585 RecordLayout_3 0 CompuMethod_1 0 255 /end CHARACTERISTIC
/begin CHARACTERISTIC FaultManager.ETCPosA_RangeHigh.Test "Fault manager configuration.  Select up to 4 actions for each fault." VALUE 0x80000586 RecordLayout_3 0 CompuMethod_157 0 255 /end CHARACTERISTIC
/begin CHARACTERISTIC FaultManager.ETCPosA_RangeHigh.Faulty_Samples__X_ "Fault manager configuration.  Select up to 4 actions for each fault." VALUE 0x80000587 RecordLayout_3 0 CompuMethod_1 0 255 /end CHARACTERISTIC
/begin CHARACTERISTIC FaultManager.ETCPosA_RangeHigh.Total_Samples__Y_ "Fault manager configuration.  Select up to 4 actions for each fault." VALUE 0x80000588 RecordLayout_3 0 CompuMethod_1 0 255 /end CHARACTERISTIC
/begin CHARACTERISTIC FaultManager.ETCPosA_RangeHigh.Action_1 "Fault manager configuration.  Select up to 4 actions for each fault." VALUE 0x80000589 RecordLayout_3 0 CompuMethod_158 0 255 /end CHARACTERISTIC
/begin CHARACTERISTIC FaultManager.ETCPosA_RangeHigh.Action_1_Condition "Fault manager configuration.  Select up to 4 actions for each fault." VALUE 0x8000058A RecordLayout_3 0 CompuMethod_159 0 255 /end CHARACTERISTIC
/begin CHARACTERISTIC FaultManager.ETCPosA_RangeHigh.Action_2 "Fault manager configuration.  Select up to 4 actions for each fault." VALUE 0x8000058B RecordLayout_3 0 CompuMethod_158 0 255 /end CHARACTERISTIC
/begin CHARACTERISTIC FaultManager.ETCPosA_RangeHigh.Action_2_Condition "Fault manager configuration.  Select up to 4 actions for each fault." VALUE 0x8000058C RecordLayout_3 0 CompuMethod_159 0 255 /end CHARACTERISTIC
/begin CHARACTERISTIC FaultManager.ETCPosA_RangeHigh.Action_3 "Fault manager configuration.  Select up to 4 actions for each fault." VALUE 0x8000058D RecordLayout_3 0 CompuMethod_158 0 255 /end CHARACTERISTIC
/begin CHARACTERISTIC FaultManager.ETCPosA_RangeHigh.Action_3_Condition "Fault manager configuration.  Select up to 4 actions for each fault." VALUE 0x8000058E RecordLayout_3 0 CompuMethod_159 0 255 /end CHARACTERISTIC
/begin CHARACTERISTIC FaultManager.ETCPosA_RangeHigh.Action_4 "Fault manager configuration.  Select up to 4 actions for each fault." VALUE 0x8000058F RecordLayout_3 0 CompuMethod_158 0 255 /end CHARACTERISTIC
/begin CHARACTERISTIC FaultManager.ETCPosA_RangeHigh.Action_4_Condition "Fault manager configuration.  Select up to 4 actions for each fault." VALUE 0x80000590 RecordLayout_3 0 CompuMethod_159 0 255 /end CHARACTERISTIC
/begin CHARACTERISTIC FaultManager.ETCPosA_RangeLow.Mode "Fault manager configuration.  Select up to 4 actions for each fault." VALUE 0x80000591 RecordLayout_3 0 CompuMethod_156 0 255 /end CHARACTERISTIC
/begin CHARACTERISTIC FaultManager.ETCPosA_RangeLow.ID "Fault manager configuration.  Select up to 4 actions for each fault." VALUE 0x80000592 RecordLayout_3 0 CompuMethod_1 0 255 /end CHARACTERISTIC
/begin CHARACTERISTIC FaultManager.ETCPosA_RangeLow.Test "Fault manager configuration.  Select up to 4 actions for each fault." VALUE 0x80000593 RecordLayout_3 0 CompuMethod_157 0 255 /end CHARACTERISTIC
/begin CHARACTERISTIC FaultManager.ETCPosA_RangeLow.Faulty_Samples__X_ "Fault manager configuration.  Select up to 4 actions for each fault." VALUE 0x80000594 RecordLayout_3 0 CompuMethod_1 0 255 /end CHARACTERISTIC
/begin CHARACTERISTIC FaultManager.ETCPosA_RangeLow.Total_Samples__Y_ "Fault manager configuration.  Select up to 4 actions for each fault." VALUE 0x80000595 RecordLayout_3 0 CompuMethod_1 0 255 /end CHARACTERISTIC
/begin CHARACTERISTIC FaultManager.ETCPosA_RangeLow.Action_1 "Fault manager configuration.  Select up to 4 actions for each fault." VALUE 0x80000596 RecordLayout_3 0 CompuMethod_158 0 255 /end CHARACTERISTIC
/begin CHARACTERISTIC FaultManager.ETCPosA_RangeLow.Action_1_Condition "Fault manager configuration.  Select up to 4 actions for each fault." VALUE 0x80000597 RecordLayout_3 0 CompuMethod_159 0 255 /end CHARACTERISTIC
/begin CHARACTERISTIC FaultManager.ETCPosA_RangeLow.Action_2 "Fault manager configuration.  Select up to 4 actions for each fault." VALUE 0x80000598 RecordLayout_3 0 CompuMethod_158 0 255 /end CHARACTERISTIC
/begin CHARACTERISTIC FaultManager.ETCPosA_RangeLow.Action_2_Condition "Fault manager configuration.  Select up to 4 actions for each fault." VALUE 0x80000599 RecordLayout_3 0 CompuMethod_159 0 255 /end CHARACTERISTIC
/begin CHARACTERISTIC FaultManager.ETCPosA_RangeLow.Action_3 "Fault manager configuration.  Select up to 4 actions for each fault." VALUE 0x8000059A RecordLayout_3 0 CompuMethod_158 0 255 /end CHARACTERISTIC
/begin CHARACTERISTIC FaultManager.ETCPosA_RangeLow.Action_3_Condition "Fault manager configuration.  Select up to 4 actions for each fault." VALUE 0x8000059B RecordLayout_3 0 CompuMethod_159 0 255 /end CHARACTERISTIC
/begin CHARACTERISTIC FaultManager.ETCPosA_RangeLow.Action_4 "Fault manager configuration.  Select up to 4 actions for each fault." VALUE 0x8000059C RecordLayout_3 0 CompuMethod_158 0 255 /end CHARACTERISTIC
/begin CHARACTERISTIC FaultManager.ETCPosA_RangeLow.Action_4_Condition "Fault manager configuration.  Select up to 4 actions for each fault." VALUE 0x8000059D RecordLayout_3 0 CompuMethod_159 0 255 /end CHARACTERISTIC
/begin CHARACTERISTIC FaultManager.ETCPosB_RangeHigh.Mode "Fault manager configuration.  Select up to 4 actions for each fault." VALUE 0x8000059E RecordLayout_3 0 CompuMethod_156 0 255 /end CHARACTERISTIC
/begin CHARACTERISTIC FaultManager.ETCPosB_RangeHigh.ID "Fault manager configuration.  Select up to 4 actions for each fault." VALUE 0x8000059F RecordLayout_3 0 CompuMethod_1 0 255 /end CHARACTERISTIC
/begin CHARACTERISTIC FaultManager.ETCPosB_RangeHigh.Test "Fault manager configuration.  Select up to 4 actions for each fault." VALUE 0x800005A0 RecordLayout_3 0 CompuMethod_157 0 255 /end CHARACTERISTIC
/begin CHARACTERISTIC FaultManager.ETCPosB_RangeHigh.Faulty_Samples__X_ "Fault manager configuration.  Select up to 4 actions for each fault." VALUE 0x800005A1 RecordLayout_3 0 CompuMethod_1 0 255 /end CHARACTERISTIC
/begin CHARACTERISTIC FaultManager.ETCPosB_RangeHigh.Total_Samples__Y_ "Fault manager configuration.  Select up to 4 actions for each fault." VALUE 0x800005A2 RecordLayout_3 0 CompuMethod_1 0 255 /end CHARACTERISTIC
/begin CHARACTERISTIC FaultManager.ETCPosB_RangeHigh.Action_1 "Fault manager configuration.  Select up to 4 actions for each fault." VALUE 0x800005A3 RecordLayout_3 0 CompuMethod_158 0 255 /end CHARACTERISTIC
/begin CHARACTERISTIC FaultManager.ETCPosB_RangeHigh.Action_1_Condition "Fault manager configuration.  Select up to 4 actions for each fault." VALUE 0x800005A4 RecordLayout_3 0 CompuMethod_159 0 255 /end CHARACTERISTIC
/begin CHARACTERISTIC FaultManager.ETCPosB_RangeHigh.Action_2 "Fault manager configuration.  Select up to 4 actions for each fault." VALUE 0x800005A5 RecordLayout_3 0 CompuMethod_158 0 255 /end CHARACTERISTIC
/begin CHARACTERISTIC FaultManager.ETCPosB_RangeHigh.Action_2_Condition "Fault manager configuration.  Select up to 4 actions for each fault." VALUE 0x800005A6 RecordLayout_3 0 CompuMethod_159 0 255 /end CHARACTERISTIC
/begin CHARACTERISTIC FaultManager.ETCPosB_RangeHigh.Action_3 "Fault manager configuration.  Select up to 4 actions for each fault." VALUE 0x800005A7 RecordLayout_3 0 CompuMethod_158 0 255 /end CHARACTERISTIC
/begin CHARACTERISTIC FaultManager.ETCPosB_RangeHigh.Action_3_Condition "Fault manager configuration.  Select up to 4 actions for each fault." VALUE 0x800005A8 RecordLayout_3 0 CompuMethod_159 0 255 /end CHARACTERISTIC
/begin CHARACTERISTIC FaultManager.ETCPosB_RangeHigh.Action_4 "Fault manager configuration.  Select up to 4 actions for each fault." VALUE 0x800005A9 RecordLayout_3 0 CompuMethod_158 0 255 /end CHARACTERISTIC
/begin CHARACTERISTIC FaultManager.ETCPosB_RangeHigh.Action_4_Condition "Fault manager configuration.  Select up to 4 actions for each fault." VALUE 0x800005AA RecordLayout_3 0 CompuMethod_159 0 255 /end CHARACTERISTIC
/begin CHARACTERISTIC FaultManager.ETCPosB_RangeLow.Mode "Fault manager configuration.  Select up to 4 actions for each fault." VALUE 0x800005AB RecordLayout_3 0 CompuMethod_156 0 255 /end CHARACTERISTIC
/begin CHARACTERISTIC FaultManager.ETCPosB_RangeLow.ID "Fault manager configuration.  Select up to 4 actions for each fault." VALUE 0x800005AC RecordLayout_3 0 CompuMethod_1 0 255 /end CHARACTERISTIC
/begin CHARACTERISTIC FaultManager.ETCPosB_RangeLow.Test "Fault manager configuration.  Select up to 4 actions for each fault." VALUE 0x800005AD RecordLayout_3 0 CompuMethod_157 0 255 /end CHARACTERISTIC
/begin CHARACTERISTIC FaultManager.ETCPosB_RangeLow.Faulty_Samples__X_ "Fault manager configuration.  Select up to 4 actions for each fault." VALUE 0x800005AE RecordLayout_3 0 CompuMethod_1 0 255 /end CHARACTERISTIC
/begin CHARACTERISTIC FaultManager.ETCPosB_RangeLow.Total_Samples__Y_ "Fault manager configuration.  Select up to 4 actions for each fault." VALUE 0x800005AF RecordLayout_3 0 CompuMethod_1 0 255 /end CHARACTERISTIC
/begin CHARACTERISTIC FaultManager.ETCPosB_RangeLow.Action_1 "Fault manager configuration.  Select up to 4 actions for each fault." VALUE 0x800005B0 RecordLayout_3 0 CompuMethod_158 0 255 /end CHARACTERISTIC
/begin CHARACTERISTIC FaultManager.ETCPosB_RangeLow.Action_1_Condition "Fault manager configuration.  Select up to 4 actions for each fault." VALUE 0x800005B1 RecordLayout_3 0 CompuMethod_159 0 255 /end CHARACTERISTIC
/begin CHARACTERISTIC FaultManager.ETCPosB_RangeLow.Action_2 "Fault manager configuration.  Select up to 4 actions for each fault." VALUE 0x800005B2 RecordLayout_3 0 CompuMethod_158 0 255 /end CHARACTERISTIC
/begin CHARACTERISTIC FaultManager.ETCPosB_RangeLow.Action_2_Condition "Fault manager configuration.  Select up to 4 actions for each fault." VALUE 0x800005B3 RecordLayout_3 0 CompuMethod_159 0 255 /end CHARACTERISTIC
/begin CHARACTERISTIC FaultManager.ETCPosB_RangeLow.Action_3 "Fault manager configuration.  Select up to 4 actions for each fault." VALUE 0x800005B4 RecordLayout_3 0 CompuMethod_158 0 255 /end CHARACTERISTIC
/begin CHARACTERISTIC FaultManager.ETCPosB_RangeLow.Action_3_Condition "Fault manager configuration.  Select up to 4 actions for each fault." VALUE 0x800005B5 RecordLayout_3 0 CompuMethod_159 0 255 /end CHARACTERISTIC
/begin CHARACTERISTIC FaultManager.ETCPosB_RangeLow.Action_4 "Fault manager configuration.  Select up to 4 actions for each fault." VALUE 0x800005B6 RecordLayout_3 0 CompuMethod_158 0 255 /end CHARACTERISTIC
/begin CHARACTERISTIC FaultManager.ETCPosB_RangeLow.Action_4_Condition "Fault manager configuration.  Select up to 4 actions for each fault." VALUE 0x800005B7 RecordLayout_3 0 CompuMethod_159 0 255 /end CHARACTERISTIC
/begin CHARACTERISTIC FaultManager.ExT1_RangeHigh.Mode "Fault manager configuration.  Select up to 4 actions for each fault." VALUE 0x800005B8 RecordLayout_3 0 CompuMethod_156 0 255 /end CHARACTERISTIC
/begin CHARACTERISTIC FaultManager.ExT1_RangeHigh.ID "Fault manager configuration.  Select up to 4 actions for each fault." VALUE 0x800005B9 RecordLayout_3 0 CompuMethod_1 0 255 /end CHARACTERISTIC
/begin CHARACTERISTIC FaultManager.ExT1_RangeHigh.Test "Fault manager configuration.  Select up to 4 actions for each fault." VALUE 0x800005BA RecordLayout_3 0 CompuMethod_157 0 255 /end CHARACTERISTIC
/begin CHARACTERISTIC FaultManager.ExT1_RangeHigh.Faulty_Samples__X_ "Fault manager configuration.  Select up to 4 actions for each fault." VALUE 0x800005BB RecordLayout_3 0 CompuMethod_1 0 255 /end CHARACTERISTIC
/begin CHARACTERISTIC FaultManager.ExT1_RangeHigh.Total_Samples__Y_ "Fault manager configuration.  Select up to 4 actions for each fault." VALUE 0x800005BC RecordLayout_3 0 CompuMethod_1 0 255 /end CHARACTERISTIC
/begin CHARACTERISTIC FaultManager.ExT1_RangeHigh.Action_1 "Fault manager configuration.  Select up to 4 actions for each fault." VALUE 0x800005BD RecordLayout_3 0 CompuMethod_158 0 255 /end CHARACTERISTIC
/begin CHARACTERISTIC FaultManager.ExT1_RangeHigh.Action_1_Condition "Fault manager configuration.  Select up to 4 actions for each fault." VALUE 0x800005BE RecordLayout_3 0 CompuMethod_159 0 255 /end CHARACTERISTIC
/begin CHARACTERISTIC FaultManager.ExT1_RangeHigh.Action_2 "Fault manager configuration.  Select up to 4 actions for each fault." VALUE 0x800005BF RecordLayout_3 0 CompuMethod_158 0 255 /end CHARACTERISTIC
/begin CHARACTERISTIC FaultManager.ExT1_RangeHigh.Action_2_Condition "Fault manager configuration.  Select up to 4 actions for each fault." VALUE 0x800005C0 RecordLayout_3 0 CompuMethod_159 0 255 /end CHARACTERISTIC
/begin CHARACTERISTIC FaultManager.ExT1_RangeHigh.Action_3 "Fault manager configuration.  Select up to 4 actions for each fault." VALUE 0x800005C1 RecordLayout_3 0 CompuMethod_158 0 255 /end CHARACTERISTIC
/begin CHARACTERISTIC FaultManager.ExT1_RangeHigh.Action_3_Condition "Fault manager configuration.  Select up to 4 actions for each fault." VALUE 0x800005C2 RecordLayout_3 0 CompuMethod_159 0 255 /end CHARACTERISTIC
/begin CHARACTERISTIC FaultManager.ExT1_RangeHigh.Action_4 "Fault manager configuration.  Select up to 4 actions for each fault." VALUE 0x800005C3 RecordLayout_3 0 CompuMethod_158 0 255 /end CHARACTERISTIC
/begin CHARACTERISTIC FaultManager.ExT1_RangeHigh.Action_4_Condition "Fault manager configuration.  Select up to 4 actions for each fault." VALUE 0x800005C4 RecordLayout_3 0 CompuMethod_159 0 255 /end CHARACTERISTIC
/begin CHARACTERISTIC FaultManager.ExT1_RangeLow.Mode "Fault manager configuration.  Select up to 4 actions for each fault." VALUE 0x800005C5 RecordLayout_3 0 CompuMethod_156 0 255 /end CHARACTERISTIC
/begin CHARACTERISTIC FaultManager.ExT1_RangeLow.ID "Fault manager configuration.  Select up to 4 actions for each fault." VALUE 0x800005C6 RecordLayout_3 0 CompuMethod_1 0 255 /end CHARACTERISTIC
/begin CHARACTERISTIC FaultManager.ExT1_RangeLow.Test "Fault manager configuration.  Select up to 4 actions for each fault." VALUE 0x800005C7 RecordLayout_3 0 CompuMethod_157 0 255 /end CHARACTERISTIC
/begin CHARACTERISTIC FaultManager.ExT1_RangeLow.Faulty_Samples__X_ "Fault manager configuration.  Select up to 4 actions for each fault." VALUE 0x800005C8 RecordLayout_3 0 CompuMethod_1 0 255 /end CHARACTERISTIC
/begin CHARACTERISTIC FaultManager.ExT1_RangeLow.Total_Samples__Y_ "Fault manager configuration.  Select up to 4 actions for each fault." VALUE 0x800005C9 RecordLayout_3 0 CompuMethod_1 0 255 /end CHARACTERISTIC
/begin CHARACTERISTIC FaultManager.ExT1_RangeLow.Action_1 "Fault manager configuration.  Select up to 4 actions for each fault." VALUE 0x800005CA RecordLayout_3 0 CompuMethod_158 0 255 /end CHARACTERISTIC
/begin CHARACTERISTIC FaultManager.ExT1_RangeLow.Action_1_Condition "Fault manager configuration.  Select up to 4 actions for each fault." VALUE 0x800005CB RecordLayout_3 0 CompuMethod_159 0 255 /end CHARACTERISTIC
/begin CHARACTERISTIC FaultManager.ExT1_RangeLow.Action_2 "Fault manager configuration.  Select up to 4 actions for each fault." VALUE 0x800005CC RecordLayout_3 0 CompuMethod_158 0 255 /end CHARACTERISTIC
/begin CHARACTERISTIC FaultManager.ExT1_RangeLow.Action_2_Condition "Fault manager configuration.  Select up to 4 actions for each fault." VALUE 0x800005CD RecordLayout_3 0 CompuMethod_159 0 255 /end CHARACTERISTIC
/begin CHARACTERISTIC FaultManager.ExT1_RangeLow.Action_3 "Fault manager configuration.  Select up to 4 actions for each fault." VALUE 0x800005CE RecordLayout_3 0 CompuMethod_158 0 255 /end CHARACTERISTIC
/begin CHARACTERISTIC FaultManager.ExT1_RangeLow.Action_3_Condition "Fault manager configuration.  Select up to 4 actions for each fault." VALUE 0x800005CF RecordLayout_3 0 CompuMethod_159 0 255 /end CHARACTERISTIC
/begin CHARACTERISTIC FaultManager.ExT1_RangeLow.Action_4 "Fault manager configuration.  Select up to 4 actions for each fault." VALUE 0x800005D0 RecordLayout_3 0 CompuMethod_158 0 255 /end CHARACTERISTIC
/begin CHARACTERISTIC FaultManager.ExT1_RangeLow.Action_4_Condition "Fault manager configuration.  Select up to 4 actions for each fault." VALUE 0x800005D1 RecordLayout_3 0 CompuMethod_159 0 255 /end CHARACTERISTIC
/begin CHARACTERISTIC FaultManager.ExT2_RangeHigh.Mode "Fault manager configuration.  Select up to 4 actions for each fault." VALUE 0x800005D2 RecordLayout_3 0 CompuMethod_156 0 255 /end CHARACTERISTIC
/begin CHARACTERISTIC FaultManager.ExT2_RangeHigh.ID "Fault manager configuration.  Select up to 4 actions for each fault." VALUE 0x800005D3 RecordLayout_3 0 CompuMethod_1 0 255 /end CHARACTERISTIC
/begin CHARACTERISTIC FaultManager.ExT2_RangeHigh.Test "Fault manager configuration.  Select up to 4 actions for each fault." VALUE 0x800005D4 RecordLayout_3 0 CompuMethod_157 0 255 /end CHARACTERISTIC
/begin CHARACTERISTIC FaultManager.ExT2_RangeHigh.Faulty_Samples__X_ "Fault manager configuration.  Select up to 4 actions for each fault." VALUE 0x800005D5 RecordLayout_3 0 CompuMethod_1 0 255 /end CHARACTERISTIC
/begin CHARACTERISTIC FaultManager.ExT2_RangeHigh.Total_Samples__Y_ "Fault manager configuration.  Select up to 4 actions for each fault." VALUE 0x800005D6 RecordLayout_3 0 CompuMethod_1 0 255 /end CHARACTERISTIC
/begin CHARACTERISTIC FaultManager.ExT2_RangeHigh.Action_1 "Fault manager configuration.  Select up to 4 actions for each fault." VALUE 0x800005D7 RecordLayout_3 0 CompuMethod_158 0 255 /end CHARACTERISTIC
/begin CHARACTERISTIC FaultManager.ExT2_RangeHigh.Action_1_Condition "Fault manager configuration.  Select up to 4 actions for each fault." VALUE 0x800005D8 RecordLayout_3 0 CompuMethod_159 0 255 /end CHARACTERISTIC
/begin CHARACTERISTIC FaultManager.ExT2_RangeHigh.Action_2 "Fault manager configuration.  Select up to 4 actions for each fault." VALUE 0x800005D9 RecordLayout_3 0 CompuMethod_158 0 255 /end CHARACTERISTIC
/begin CHARACTERISTIC FaultManager.ExT2_RangeHigh.Action_2_Condition "Fault manager configuration.  Select up to 4 actions for each fault." VALUE 0x800005DA RecordLayout_3 0 CompuMethod_159 0 255 /end CHARACTERISTIC
/begin CHARACTERISTIC FaultManager.ExT2_RangeHigh.Action_3 "Fault manager configuration.  Select up to 4 actions for each fault." VALUE 0x800005DB RecordLayout_3 0 CompuMethod_158 0 255 /end CHARACTERISTIC
/begin CHARACTERISTIC FaultManager.ExT2_RangeHigh.Action_3_Condition "Fault manager configuration.  Select up to 4 actions for each fault." VALUE 0x800005DC RecordLayout_3 0 CompuMethod_159 0 255 /end CHARACTERISTIC
/begin CHARACTERISTIC FaultManager.ExT2_RangeHigh.Action_4 "Fault manager configuration.  Select up to 4 actions for each fault." VALUE 0x800005DD RecordLayout_3 0 CompuMethod_158 0 255 /end CHARACTERISTIC
/begin CHARACTERISTIC FaultManager.ExT2_RangeHigh.Action_4_Condition "Fault manager configuration.  Select up to 4 actions for each fault." VALUE 0x800005DE RecordLayout_3 0 CompuMethod_159 0 255 /end CHARACTERISTIC
/begin CHARACTERISTIC FaultManager.ExT2_RangeLow.Mode "Fault manager configuration.  Select up to 4 actions for each fault." VALUE 0x800005DF RecordLayout_3 0 CompuMethod_156 0 255 /end CHARACTERISTIC
/begin CHARACTERISTIC FaultManager.ExT2_RangeLow.ID "Fault manager configuration.  Select up to 4 actions for each fault." VALUE 0x800005E0 RecordLayout_3 0 CompuMethod_1 0 255 /end CHARACTERISTIC
/begin CHARACTERISTIC FaultManager.ExT2_RangeLow.Test "Fault manager configuration.  Select up to 4 actions for each fault." VALUE 0x800005E1 RecordLayout_3 0 CompuMethod_157 0 255 /end CHARACTERISTIC
/begin CHARACTERISTIC FaultManager.ExT2_RangeLow.Faulty_Samples__X_ "Fault manager configuration.  Select up to 4 actions for each fault." VALUE 0x800005E2 RecordLayout_3 0 CompuMethod_1 0 255 /end CHARACTERISTIC
/begin CHARACTERISTIC FaultManager.ExT2_RangeLow.Total_Samples__Y_ "Fault manager configuration.  Select up to 4 actions for each fault." VALUE 0x800005E3 RecordLayout_3 0 CompuMethod_1 0 255 /end CHARACTERISTIC
/begin CHARACTERISTIC FaultManager.ExT2_RangeLow.Action_1 "Fault manager configuration.  Select up to 4 actions for each fault." VALUE 0x800005E4 RecordLayout_3 0 CompuMethod_158 0 255 /end CHARACTERISTIC
/begin CHARACTERISTIC FaultManager.ExT2_RangeLow.Action_1_Condition "Fault manager configuration.  Select up to 4 actions for each fault." VALUE 0x800005E5 RecordLayout_3 0 CompuMethod_159 0 255 /end CHARACTERISTIC
/begin CHARACTERISTIC FaultManager.ExT2_RangeLow.Action_2 "Fault manager configuration.  Select up to 4 actions for each fault." VALUE 0x800005E6 RecordLayout_3 0 CompuMethod_158 0 255 /end CHARACTERISTIC
/begin CHARACTERISTIC FaultManager.ExT2_RangeLow.Action_2_Condition "Fault manager configuration.  Select up to 4 actions for each fault." VALUE 0x800005E7 RecordLayout_3 0 CompuMethod_159 0 255 /end CHARACTERISTIC
/begin CHARACTERISTIC FaultManager.ExT2_RangeLow.Action_3 "Fault manager configuration.  Select up to 4 actions for each fault." VALUE 0x800005E8 RecordLayout_3 0 CompuMethod_158 0 255 /end CHARACTERISTIC
/begin CHARACTERISTIC FaultManager.ExT2_RangeLow.Action_3_Condition "Fault manager configuration.  Select up to 4 actions for each fault." VALUE 0x800005E9 RecordLayout_3 0 CompuMethod_159 0 255 /end CHARACTERISTIC
/begin CHARACTERISTIC FaultManager.ExT2_RangeLow.Action_4 "Fault manager configuration.  Select up to 4 actions for each fault." VALUE 0x800005EA RecordLayout_3 0 CompuMethod_158 0 255 /end CHARACTERISTIC
/begin CHARACTERISTIC FaultManager.ExT2_RangeLow.Action_4_Condition "Fault manager configuration.  Select up to 4 actions for each fault." VALUE 0x800005EB RecordLayout_3 0 CompuMethod_159 0 255 /end CHARACTERISTIC
/begin CHARACTERISTIC FaultManager.FUELT_RangeHigh.Mode "Fault manager configuration.  Select up to 4 actions for each fault." VALUE 0x800005EC RecordLayout_3 0 CompuMethod_156 0 255 /end CHARACTERISTIC
/begin CHARACTERISTIC FaultManager.FUELT_RangeHigh.ID "Fault manager configuration.  Select up to 4 actions for each fault." VALUE 0x800005ED RecordLayout_3 0 CompuMethod_1 0 255 /end CHARACTERISTIC
/begin CHARACTERISTIC FaultManager.FUELT_RangeHigh.Test "Fault manager configuration.  Select up to 4 actions for each fault." VALUE 0x800005EE RecordLayout_3 0 CompuMethod_157 0 255 /end CHARACTERISTIC
/begin CHARACTERISTIC FaultManager.FUELT_RangeHigh.Faulty_Samples__X_ "Fault manager configuration.  Select up to 4 actions for each fault." VALUE 0x800005EF RecordLayout_3 0 CompuMethod_1 0 255 /end CHARACTERISTIC
/begin CHARACTERISTIC FaultManager.FUELT_RangeHigh.Total_Samples__Y_ "Fault manager configuration.  Select up to 4 actions for each fault." VALUE 0x800005F0 RecordLayout_3 0 CompuMethod_1 0 255 /end CHARACTERISTIC
/begin CHARACTERISTIC FaultManager.FUELT_RangeHigh.Action_1 "Fault manager configuration.  Select up to 4 actions for each fault." VALUE 0x800005F1 RecordLayout_3 0 CompuMethod_158 0 255 /end CHARACTERISTIC
/begin CHARACTERISTIC FaultManager.FUELT_RangeHigh.Action_1_Condition "Fault manager configuration.  Select up to 4 actions for each fault." VALUE 0x800005F2 RecordLayout_3 0 CompuMethod_159 0 255 /end CHARACTERISTIC
/begin CHARACTERISTIC FaultManager.FUELT_RangeHigh.Action_2 "Fault manager configuration.  Select up to 4 actions for each fault." VALUE 0x800005F3 RecordLayout_3 0 CompuMethod_158 0 255 /end CHARACTERISTIC
/begin CHARACTERISTIC FaultManager.FUELT_RangeHigh.Action_2_Condition "Fault manager configuration.  Select up to 4 actions for each fault." VALUE 0x800005F4 RecordLayout_3 0 CompuMethod_159 0 255 /end CHARACTERISTIC
/begin CHARACTERISTIC FaultManager.FUELT_RangeHigh.Action_3 "Fault manager configuration.  Select up to 4 actions for each fault." VALUE 0x800005F5 RecordLayout_3 0 CompuMethod_158 0 255 /end CHARACTERISTIC
/begin CHARACTERISTIC FaultManager.FUELT_RangeHigh.Action_3_Condition "Fault manager configuration.  Select up to 4 actions for each fault." VALUE 0x800005F6 RecordLayout_3 0 CompuMethod_159 0 255 /end CHARACTERISTIC
/begin CHARACTERISTIC FaultManager.FUELT_RangeHigh.Action_4 "Fault manager configuration.  Select up to 4 actions for each fault." VALUE 0x800005F7 RecordLayout_3 0 CompuMethod_158 0 255 /end CHARACTERISTIC
/begin CHARACTERISTIC FaultManager.FUELT_RangeHigh.Action_4_Condition "Fault manager configuration.  Select up to 4 actions for each fault." VALUE 0x800005F8 RecordLayout_3 0 CompuMethod_159 0 255 /end CHARACTERISTIC
/begin CHARACTERISTIC FaultManager.FUELT_RangeLow.Mode "Fault manager configuration.  Select up to 4 actions for each fault." VALUE 0x800005F9 RecordLayout_3 0 CompuMethod_156 0 255 /end CHARACTERISTIC
/begin CHARACTERISTIC FaultManager.FUELT_RangeLow.ID "Fault manager configuration.  Select up to 4 actions for each fault." VALUE 0x800005FA RecordLayout_3 0 CompuMethod_1 0 255 /end CHARACTERISTIC
/begin CHARACTERISTIC FaultManager.FUELT_RangeLow.Test "Fault manager configuration.  Select up to 4 actions for each fault." VALUE 0x800005FB RecordLayout_3 0 CompuMethod_157 0 255 /end CHARACTERISTIC
/begin CHARACTERISTIC FaultManager.FUELT_RangeLow.Faulty_Samples__X_ "Fault manager configuration.  Select up to 4 actions for each fault." VALUE 0x800005FC RecordLayout_3 0 CompuMethod_1 0 255 /end CHARACTERISTIC
/begin CHARACTERISTIC FaultManager.FUELT_RangeLow.Total_Samples__Y_ "Fault manager configuration.  Select up to 4 actions for each fault." VALUE 0x800005FD RecordLayout_3 0 CompuMethod_1 0 255 /end CHARACTERISTIC
/begin CHARACTERISTIC FaultManager.FUELT_RangeLow.Action_1 "Fault manager configuration.  Select up to 4 actions for each fault." VALUE 0x800005FE RecordLayout_3 0 CompuMethod_158 0 255 /end CHARACTERISTIC
/begin CHARACTERISTIC FaultManager.FUELT_RangeLow.Action_1_Condition "Fault manager configuration.  Select up to 4 actions for each fault." VALUE 0x800005FF RecordLayout_3 0 CompuMethod_159 0 255 /end CHARACTERISTIC
/begin CHARACTERISTIC FaultManager.FUELT_RangeLow.Action_2 "Fault manager configuration.  Select up to 4 actions for each fault." VALUE 0x80000600 RecordLayout_3 0 CompuMethod_158 0 255 /end CHARACTERISTIC
/begin CHARACTERISTIC FaultManager.FUELT_RangeLow.Action_2_Condition "Fault manager configuration.  Select up to 4 actions for each fault." VALUE 0x80000601 RecordLayout_3 0 CompuMethod_159 0 255 /end CHARACTERISTIC
/begin CHARACTERISTIC FaultManager.FUELT_RangeLow.Action_3 "Fault manager configuration.  Select up to 4 actions for each fault." VALUE 0x80000602 RecordLayout_3 0 CompuMethod_158 0 255 /end CHARACTERISTIC
/begin CHARACTERISTIC FaultManager.FUELT_RangeLow.Action_3_Condition "Fault manager configuration.  Select up to 4 actions for each fault." VALUE 0x80000603 RecordLayout_3 0 CompuMethod_159 0 255 /end CHARACTERISTIC
/begin CHARACTERISTIC FaultManager.FUELT_RangeLow.Action_4 "Fault manager configuration.  Select up to 4 actions for each fault." VALUE 0x80000604 RecordLayout_3 0 CompuMethod_158 0 255 /end CHARACTERISTIC
/begin CHARACTERISTIC FaultManager.FUELT_RangeLow.Action_4_Condition "Fault manager configuration.  Select up to 4 actions for each fault." VALUE 0x80000605 RecordLayout_3 0 CompuMethod_159 0 255 /end CHARACTERISTIC
/begin CHARACTERISTIC FaultManager.FuelP_RangeHigh.Mode "Fault manager configuration.  Select up to 4 actions for each fault." VALUE 0x80000606 RecordLayout_3 0 CompuMethod_156 0 255 /end CHARACTERISTIC
/begin CHARACTERISTIC FaultManager.FuelP_RangeHigh.ID "Fault manager configuration.  Select up to 4 actions for each fault." VALUE 0x80000607 RecordLayout_3 0 CompuMethod_1 0 255 /end CHARACTERISTIC
/begin CHARACTERISTIC FaultManager.FuelP_RangeHigh.Test "Fault manager configuration.  Select up to 4 actions for each fault." VALUE 0x80000608 RecordLayout_3 0 CompuMethod_157 0 255 /end CHARACTERISTIC
/begin CHARACTERISTIC FaultManager.FuelP_RangeHigh.Faulty_Samples__X_ "Fault manager configuration.  Select up to 4 actions for each fault." VALUE 0x80000609 RecordLayout_3 0 CompuMethod_1 0 255 /end CHARACTERISTIC
/begin CHARACTERISTIC FaultManager.FuelP_RangeHigh.Total_Samples__Y_ "Fault manager configuration.  Select up to 4 actions for each fault." VALUE 0x8000060A RecordLayout_3 0 CompuMethod_1 0 255 /end CHARACTERISTIC
/begin CHARACTERISTIC FaultManager.FuelP_RangeHigh.Action_1 "Fault manager configuration.  Select up to 4 actions for each fault." VALUE 0x8000060B RecordLayout_3 0 CompuMethod_158 0 255 /end CHARACTERISTIC
/begin CHARACTERISTIC FaultManager.FuelP_RangeHigh.Action_1_Condition "Fault manager configuration.  Select up to 4 actions for each fault." VALUE 0x8000060C RecordLayout_3 0 CompuMethod_159 0 255 /end CHARACTERISTIC
/begin CHARACTERISTIC FaultManager.FuelP_RangeHigh.Action_2 "Fault manager configuration.  Select up to 4 actions for each fault." VALUE 0x8000060D RecordLayout_3 0 CompuMethod_158 0 255 /end CHARACTERISTIC
/begin CHARACTERISTIC FaultManager.FuelP_RangeHigh.Action_2_Condition "Fault manager configuration.  Select up to 4 actions for each fault." VALUE 0x8000060E RecordLayout_3 0 CompuMethod_159 0 255 /end CHARACTERISTIC
/begin CHARACTERISTIC FaultManager.FuelP_RangeHigh.Action_3 "Fault manager configuration.  Select up to 4 actions for each fault." VALUE 0x8000060F RecordLayout_3 0 CompuMethod_158 0 255 /end CHARACTERISTIC
/begin CHARACTERISTIC FaultManager.FuelP_RangeHigh.Action_3_Condition "Fault manager configuration.  Select up to 4 actions for each fault." VALUE 0x80000610 RecordLayout_3 0 CompuMethod_159 0 255 /end CHARACTERISTIC
/begin CHARACTERISTIC FaultManager.FuelP_RangeHigh.Action_4 "Fault manager configuration.  Select up to 4 actions for each fault." VALUE 0x80000611 RecordLayout_3 0 CompuMethod_158 0 255 /end CHARACTERISTIC
/begin CHARACTERISTIC FaultManager.FuelP_RangeHigh.Action_4_Condition "Fault manager configuration.  Select up to 4 actions for each fault." VALUE 0x80000612 RecordLayout_3 0 CompuMethod_159 0 255 /end CHARACTERISTIC
/begin CHARACTERISTIC FaultManager.FuelP_RangeLow.Mode "Fault manager configuration.  Select up to 4 actions for each fault." VALUE 0x80000613 RecordLayout_3 0 CompuMethod_156 0 255 /end CHARACTERISTIC
/begin CHARACTERISTIC FaultManager.FuelP_RangeLow.ID "Fault manager configuration.  Select up to 4 actions for each fault." VALUE 0x80000614 RecordLayout_3 0 CompuMethod_1 0 255 /end CHARACTERISTIC
/begin CHARACTERISTIC FaultManager.FuelP_RangeLow.Test "Fault manager configuration.  Select up to 4 actions for each fault." VALUE 0x80000615 RecordLayout_3 0 CompuMethod_157 0 255 /end CHARACTERISTIC
/begin CHARACTERISTIC FaultManager.FuelP_RangeLow.Faulty_Samples__X_ "Fault manager configuration.  Select up to 4 actions for each fault." VALUE 0x80000616 RecordLayout_3 0 CompuMethod_1 0 255 /end CHARACTERISTIC
/begin CHARACTERISTIC FaultManager.FuelP_RangeLow.Total_Samples__Y_ "Fault manager configuration.  Select up to 4 actions for each fault." VALUE 0x80000617 RecordLayout_3 0 CompuMethod_1 0 255 /end CHARACTERISTIC
/begin CHARACTERISTIC FaultManager.FuelP_RangeLow.Action_1 "Fault manager configuration.  Select up to 4 actions for each fault." VALUE 0x80000618 RecordLayout_3 0 CompuMethod_158 0 255 /end CHARACTERISTIC
/begin CHARACTERISTIC FaultManager.FuelP_RangeLow.Action_1_Condition "Fault manager configuration.  Select up to 4 actions for each fault." VALUE 0x80000619 RecordLayout_3 0 CompuMethod_159 0 255 /end CHARACTERISTIC
/begin CHARACTERISTIC FaultManager.FuelP_RangeLow.Action_2 "Fault manager configuration.  Select up to 4 actions for each fault." VALUE 0x8000061A RecordLayout_3 0 CompuMethod_158 0 255 /end CHARACTERISTIC
/begin CHARACTERISTIC FaultManager.FuelP_RangeLow.Action_2_Condition "Fault manager configuration.  Select up to 4 actions for each fault." VALUE 0x8000061B RecordLayout_3 0 CompuMethod_159 0 255 /end CHARACTERISTIC
/begin CHARACTERISTIC FaultManager.FuelP_RangeLow.Action_3 "Fault manager configuration.  Select up to 4 actions for each fault." VALUE 0x8000061C RecordLayout_3 0 CompuMethod_158 0 255 /end CHARACTERISTIC
/begin CHARACTERISTIC FaultManager.FuelP_RangeLow.Action_3_Condition "Fault manager configuration.  Select up to 4 actions for each fault." VALUE 0x8000061D RecordLayout_3 0 CompuMethod_159 0 255 /end CHARACTERISTIC
/begin CHARACTERISTIC FaultManager.FuelP_RangeLow.Action_4 "Fault manager configuration.  Select up to 4 actions for each fault." VALUE 0x8000061E RecordLayout_3 0 CompuMethod_158 0 255 /end CHARACTERISTIC
/begin CHARACTERISTIC FaultManager.FuelP_RangeLow.Action_4_Condition "Fault manager configuration.  Select up to 4 actions for each fault." VALUE 0x8000061F RecordLayout_3 0 CompuMethod_159 0 255 /end CHARACTERISTIC
/begin CHARACTERISTIC FaultManager.IMP_RangeHigh.Mode "Fault manager configuration.  Select up to 4 actions for each fault." VALUE 0x80000620 RecordLayout_3 0 CompuMethod_156 0 255 /end CHARACTERISTIC
/begin CHARACTERISTIC FaultManager.IMP_RangeHigh.ID "Fault manager configuration.  Select up to 4 actions for each fault." VALUE 0x80000621 RecordLayout_3 0 CompuMethod_1 0 255 /end CHARACTERISTIC
/begin CHARACTERISTIC FaultManager.IMP_RangeHigh.Test "Fault manager configuration.  Select up to 4 actions for each fault." VALUE 0x80000622 RecordLayout_3 0 CompuMethod_157 0 255 /end CHARACTERISTIC
/begin CHARACTERISTIC FaultManager.IMP_RangeHigh.Faulty_Samples__X_ "Fault manager configuration.  Select up to 4 actions for each fault." VALUE 0x80000623 RecordLayout_3 0 CompuMethod_1 0 255 /end CHARACTERISTIC
/begin CHARACTERISTIC FaultManager.IMP_RangeHigh.Total_Samples__Y_ "Fault manager configuration.  Select up to 4 actions for each fault." VALUE 0x80000624 RecordLayout_3 0 CompuMethod_1 0 255 /end CHARACTERISTIC
/begin CHARACTERISTIC FaultManager.IMP_RangeHigh.Action_1 "Fault manager configuration.  Select up to 4 actions for each fault." VALUE 0x80000625 RecordLayout_3 0 CompuMethod_158 0 255 /end CHARACTERISTIC
/begin CHARACTERISTIC FaultManager.IMP_RangeHigh.Action_1_Condition "Fault manager configuration.  Select up to 4 actions for each fault." VALUE 0x80000626 RecordLayout_3 0 CompuMethod_159 0 255 /end CHARACTERISTIC
/begin CHARACTERISTIC FaultManager.IMP_RangeHigh.Action_2 "Fault manager configuration.  Select up to 4 actions for each fault." VALUE 0x80000627 RecordLayout_3 0 CompuMethod_158 0 255 /end CHARACTERISTIC
/begin CHARACTERISTIC FaultManager.IMP_RangeHigh.Action_2_Condition "Fault manager configuration.  Select up to 4 actions for each fault." VALUE 0x80000628 RecordLayout_3 0 CompuMethod_159 0 255 /end CHARACTERISTIC
/begin CHARACTERISTIC FaultManager.IMP_RangeHigh.Action_3 "Fault manager configuration.  Select up to 4 actions for each fault." VALUE 0x80000629 RecordLayout_3 0 CompuMethod_158 0 255 /end CHARACTERISTIC
/begin CHARACTERISTIC FaultManager.IMP_RangeHigh.Action_3_Condition "Fault manager configuration.  Select up to 4 actions for each fault." VALUE 0x8000062A RecordLayout_3 0 CompuMethod_159 0 255 /end CHARACTERISTIC
/begin CHARACTERISTIC FaultManager.IMP_RangeHigh.Action_4 "Fault manager configuration.  Select up to 4 actions for each fault." VALUE 0x8000062B RecordLayout_3 0 CompuMethod_158 0 255 /end CHARACTERISTIC
/begin CHARACTERISTIC FaultManager.IMP_RangeHigh.Action_4_Condition "Fault manager configuration.  Select up to 4 actions for each fault." VALUE 0x8000062C RecordLayout_3 0 CompuMethod_159 0 255 /end CHARACTERISTIC
/begin CHARACTERISTIC FaultManager.IMP_RangeLow.Mode "Fault manager configuration.  Select up to 4 actions for each fault." VALUE 0x8000062D RecordLayout_3 0 CompuMethod_156 0 255 /end CHARACTERISTIC
/begin CHARACTERISTIC FaultManager.IMP_RangeLow.ID "Fault manager configuration.  Select up to 4 actions for each fault." VALUE 0x8000062E RecordLayout_3 0 CompuMethod_1 0 255 /end CHARACTERISTIC
/begin CHARACTERISTIC FaultManager.IMP_RangeLow.Test "Fault manager configuration.  Select up to 4 actions for each fault." VALUE 0x8000062F RecordLayout_3 0 CompuMethod_157 0 255 /end CHARACTERISTIC
/begin CHARACTERISTIC FaultManager.IMP_RangeLow.Faulty_Samples__X_ "Fault manager configuration.  Select up to 4 actions for each fault." VALUE 0x80000630 RecordLayout_3 0 CompuMethod_1 0 255 /end CHARACTERISTIC
/begin CHARACTERISTIC FaultManager.IMP_RangeLow.Total_Samples__Y_ "Fault manager configuration.  Select up to 4 actions for each fault." VALUE 0x80000631 RecordLayout_3 0 CompuMethod_1 0 255 /end CHARACTERISTIC
/begin CHARACTERISTIC FaultManager.IMP_RangeLow.Action_1 "Fault manager configuration.  Select up to 4 actions for each fault." VALUE 0x80000632 RecordLayout_3 0 CompuMethod_158 0 255 /end CHARACTERISTIC
/begin CHARACTERISTIC FaultManager.IMP_RangeLow.Action_1_Condition "Fault manager configuration.  Select up to 4 actions for each fault." VALUE 0x80000633 RecordLayout_3 0 CompuMethod_159 0 255 /end CHARACTERISTIC
/begin CHARACTERISTIC FaultManager.IMP_RangeLow.Action_2 "Fault manager configuration.  Select up to 4 actions for each fault." VALUE 0x80000634 RecordLayout_3 0 CompuMethod_158 0 255 /end CHARACTERISTIC
/begin CHARACTERISTIC FaultManager.IMP_RangeLow.Action_2_Condition "Fault manager configuration.  Select up to 4 actions for each fault." VALUE 0x80000635 RecordLayout_3 0 CompuMethod_159 0 255 /end CHARACTERISTIC
/begin CHARACTERISTIC FaultManager.IMP_RangeLow.Action_3 "Fault manager configuration.  Select up to 4 actions for each fault." VALUE 0x80000636 RecordLayout_3 0 CompuMethod_158 0 255 /end CHARACTERISTIC
/begin CHARACTERISTIC FaultManager.IMP_RangeLow.Action_3_Condition "Fault manager configuration.  Select up to 4 actions for each fault." VALUE 0x80000637 RecordLayout_3 0 CompuMethod_159 0 255 /end CHARACTERISTIC
/begin CHARACTERISTIC FaultManager.IMP_RangeLow.Action_4 "Fault manager configuration.  Select up to 4 actions for each fault." VALUE 0x80000638 RecordLayout_3 0 CompuMethod_158 0 255 /end CHARACTERISTIC
/begin CHARACTERISTIC FaultManager.IMP_RangeLow.Action_4_Condition "Fault manager configuration.  Select up to 4 actions for each fault." VALUE 0x80000639 RecordLayout_3 0 CompuMethod_159 0 255 /end CHARACTERISTIC
/begin CHARACTERISTIC FaultManager.IMT_RangeHigh.Mode "Fault manager configuration.  Select up to 4 actions for each fault." VALUE 0x8000063A RecordLayout_3 0 CompuMethod_156 0 255 /end CHARACTERISTIC
/begin CHARACTERISTIC FaultManager.IMT_RangeHigh.ID "Fault manager configuration.  Select up to 4 actions for each fault." VALUE 0x8000063B RecordLayout_3 0 CompuMethod_1 0 255 /end CHARACTERISTIC
/begin CHARACTERISTIC FaultManager.IMT_RangeHigh.Test "Fault manager configuration.  Select up to 4 actions for each fault." VALUE 0x8000063C RecordLayout_3 0 CompuMethod_157 0 255 /end CHARACTERISTIC
/begin CHARACTERISTIC FaultManager.IMT_RangeHigh.Faulty_Samples__X_ "Fault manager configuration.  Select up to 4 actions for each fault." VALUE 0x8000063D RecordLayout_3 0 CompuMethod_1 0 255 /end CHARACTERISTIC
/begin CHARACTERISTIC FaultManager.IMT_RangeHigh.Total_Samples__Y_ "Fault manager configuration.  Select up to 4 actions for each fault." VALUE 0x8000063E RecordLayout_3 0 CompuMethod_1 0 255 /end CHARACTERISTIC
/begin CHARACTERISTIC FaultManager.IMT_RangeHigh.Action_1 "Fault manager configuration.  Select up to 4 actions for each fault." VALUE 0x8000063F RecordLayout_3 0 CompuMethod_158 0 255 /end CHARACTERISTIC
/begin CHARACTERISTIC FaultManager.IMT_RangeHigh.Action_1_Condition "Fault manager configuration.  Select up to 4 actions for each fault." VALUE 0x80000640 RecordLayout_3 0 CompuMethod_159 0 255 /end CHARACTERISTIC
/begin CHARACTERISTIC FaultManager.IMT_RangeHigh.Action_2 "Fault manager configuration.  Select up to 4 actions for each fault." VALUE 0x80000641 RecordLayout_3 0 CompuMethod_158 0 255 /end CHARACTERISTIC
/begin CHARACTERISTIC FaultManager.IMT_RangeHigh.Action_2_Condition "Fault manager configuration.  Select up to 4 actions for each fault." VALUE 0x80000642 RecordLayout_3 0 CompuMethod_159 0 255 /end CHARACTERISTIC
/begin CHARACTERISTIC FaultManager.IMT_RangeHigh.Action_3 "Fault manager configuration.  Select up to 4 actions for each fault." VALUE 0x80000643 RecordLayout_3 0 CompuMethod_158 0 255 /end CHARACTERISTIC
/begin CHARACTERISTIC FaultManager.IMT_RangeHigh.Action_3_Condition "Fault manager configuration.  Select up to 4 actions for each fault." VALUE 0x80000644 RecordLayout_3 0 CompuMethod_159 0 255 /end CHARACTERISTIC
/begin CHARACTERISTIC FaultManager.IMT_RangeHigh.Action_4 "Fault manager configuration.  Select up to 4 actions for each fault." VALUE 0x80000645 RecordLayout_3 0 CompuMethod_158 0 255 /end CHARACTERISTIC
/begin CHARACTERISTIC FaultManager.IMT_RangeHigh.Action_4_Condition "Fault manager configuration.  Select up to 4 actions for each fault." VALUE 0x80000646 RecordLayout_3 0 CompuMethod_159 0 255 /end CHARACTERISTIC
/begin CHARACTERISTIC FaultManager.IMT_RangeLow.Mode "Fault manager configuration.  Select up to 4 actions for each fault." VALUE 0x80000647 RecordLayout_3 0 CompuMethod_156 0 255 /end CHARACTERISTIC
/begin CHARACTERISTIC FaultManager.IMT_RangeLow.ID "Fault manager configuration.  Select up to 4 actions for each fault." VALUE 0x80000648 RecordLayout_3 0 CompuMethod_1 0 255 /end CHARACTERISTIC
/begin CHARACTERISTIC FaultManager.IMT_RangeLow.Test "Fault manager configuration.  Select up to 4 actions for each fault." VALUE 0x80000649 RecordLayout_3 0 CompuMethod_157 0 255 /end CHARACTERISTIC
/begin CHARACTERISTIC FaultManager.IMT_RangeLow.Faulty_Samples__X_ "Fault manager configuration.  Select up to 4 actions for each fault." VALUE 0x8000064A RecordLayout_3 0 CompuMethod_1 0 255 /end CHARACTERISTIC
/begin CHARACTERISTIC FaultManager.IMT_RangeLow.Total_Samples__Y_ "Fault manager configuration.  Select up to 4 actions for each fault." VALUE 0x8000064B RecordLayout_3 0 CompuMethod_1 0 255 /end CHARACTERISTIC
/begin CHARACTERISTIC FaultManager.IMT_RangeLow.Action_1 "Fault manager configuration.  Select up to 4 actions for each fault." VALUE 0x8000064C RecordLayout_3 0 CompuMethod_158 0 255 /end CHARACTERISTIC
/begin CHARACTERISTIC FaultManager.IMT_RangeLow.Action_1_Condition "Fault manager configuration.  Select up to 4 actions for each fault." VALUE 0x8000064D RecordLayout_3 0 CompuMethod_159 0 255 /end CHARACTERISTIC
/begin CHARACTERISTIC FaultManager.IMT_RangeLow.Action_2 "Fault manager configuration.  Select up to 4 actions for each fault." VALUE 0x8000064E RecordLayout_3 0 CompuMethod_158 0 255 /end CHARACTERISTIC
/begin CHARACTERISTIC FaultManager.IMT_RangeLow.Action_2_Condition "Fault manager configuration.  Select up to 4 actions for each fault." VALUE 0x8000064F RecordLayout_3 0 CompuMethod_159 0 255 /end CHARACTERISTIC
/begin CHARACTERISTIC FaultManager.IMT_RangeLow.Action_3 "Fault manager configuration.  Select up to 4 actions for each fault." VALUE 0x80000650 RecordLayout_3 0 CompuMethod_158 0 255 /end CHARACTERISTIC
/begin CHARACTERISTIC FaultManager.IMT_RangeLow.Action_3_Condition "Fault manager configuration.  Select up to 4 actions for each fault." VALUE 0x80000651 RecordLayout_3 0 CompuMethod_159 0 255 /end CHARACTERISTIC
/begin CHARACTERISTIC FaultManager.IMT_RangeLow.Action_4 "Fault manager configuration.  Select up to 4 actions for each fault." VALUE 0x80000652 RecordLayout_3 0 CompuMethod_158 0 255 /end CHARACTERISTIC
/begin CHARACTERISTIC FaultManager.IMT_RangeLow.Action_4_Condition "Fault manager configuration.  Select up to 4 actions for each fault." VALUE 0x80000653 RecordLayout_3 0 CompuMethod_159 0 255 /end CHARACTERISTIC
/begin CHARACTERISTIC FaultManager.Idle_CPU.Mode "Fault manager configuration.  Select up to 4 actions for each fault." VALUE 0x80000654 RecordLayout_3 0 CompuMethod_156 0 255 /end CHARACTERISTIC
/begin CHARACTERISTIC FaultManager.Idle_CPU.ID "Fault manager configuration.  Select up to 4 actions for each fault." VALUE 0x80000655 RecordLayout_3 0 CompuMethod_1 0 255 /end CHARACTERISTIC
/begin CHARACTERISTIC FaultManager.Idle_CPU.Test "Fault manager configuration.  Select up to 4 actions for each fault." VALUE 0x80000656 RecordLayout_3 0 CompuMethod_157 0 255 /end CHARACTERISTIC
/begin CHARACTERISTIC FaultManager.Idle_CPU.Faulty_Samples__X_ "Fault manager configuration.  Select up to 4 actions for each fault." VALUE 0x80000657 RecordLayout_3 0 CompuMethod_1 0 255 /end CHARACTERISTIC
/begin CHARACTERISTIC FaultManager.Idle_CPU.Total_Samples__Y_ "Fault manager configuration.  Select up to 4 actions for each fault." VALUE 0x80000658 RecordLayout_3 0 CompuMethod_1 0 255 /end CHARACTERISTIC
/begin CHARACTERISTIC FaultManager.Idle_CPU.Action_1 "Fault manager configuration.  Select up to 4 actions for each fault." VALUE 0x80000659 RecordLayout_3 0 CompuMethod_158 0 255 /end CHARACTERISTIC
/begin CHARACTERISTIC FaultManager.Idle_CPU.Action_1_Condition "Fault manager configuration.  Select up to 4 actions for each fault." VALUE 0x8000065A RecordLayout_3 0 CompuMethod_159 0 255 /end CHARACTERISTIC
/begin CHARACTERISTIC FaultManager.Idle_CPU.Action_2 "Fault manager configuration.  Select up to 4 actions for each fault." VALUE 0x8000065B RecordLayout_3 0 CompuMethod_158 0 255 /end CHARACTERISTIC
/begin CHARACTERISTIC FaultManager.Idle_CPU.Action_2_Condition "Fault manager configuration.  Select up to 4 actions for each fault." VALUE 0x8000065C RecordLayout_3 0 CompuMethod_159 0 255 /end CHARACTERISTIC
/begin CHARACTERISTIC FaultManager.Idle_CPU.Action_3 "Fault manager configuration.  Select up to 4 actions for each fault." VALUE 0x8000065D RecordLayout_3 0 CompuMethod_158 0 255 /end CHARACTERISTIC
/begin CHARACTERISTIC FaultManager.Idle_CPU.Action_3_Condition "Fault manager configuration.  Select up to 4 actions for each fault." VALUE 0x8000065E RecordLayout_3 0 CompuMethod_159 0 255 /end CHARACTERISTIC
/begin CHARACTERISTIC FaultManager.Idle_CPU.Action_4 "Fault manager configuration.  Select up to 4 actions for each fault." VALUE 0x8000065F RecordLayout_3 0 CompuMethod_158 0 255 /end CHARACTERISTIC
/begin CHARACTERISTIC FaultManager.Idle_CPU.Action_4_Condition "Fault manager configuration.  Select up to 4 actions for each fault." VALUE 0x80000660 RecordLayout_3 0 CompuMethod_159 0 255 /end CHARACTERISTIC
/begin CHARACTERISTIC FaultManager.O2A_RangeHigh.Mode "Fault manager configuration.  Select up to 4 actions for each fault." VALUE 0x80000661 RecordLayout_3 0 CompuMethod_156 0 255 /end CHARACTERISTIC
/begin CHARACTERISTIC FaultManager.O2A_RangeHigh.ID "Fault manager configuration.  Select up to 4 actions for each fault." VALUE 0x80000662 RecordLayout_3 0 CompuMethod_1 0 255 /end CHARACTERISTIC
/begin CHARACTERISTIC FaultManager.O2A_RangeHigh.Test "Fault manager configuration.  Select up to 4 actions for each fault." VALUE 0x80000663 RecordLayout_3 0 CompuMethod_157 0 255 /end CHARACTERISTIC
/begin CHARACTERISTIC FaultManager.O2A_RangeHigh.Faulty_Samples__X_ "Fault manager configuration.  Select up to 4 actions for each fault." VALUE 0x80000664 RecordLayout_3 0 CompuMethod_1 0 255 /end CHARACTERISTIC
/begin CHARACTERISTIC FaultManager.O2A_RangeHigh.Total_Samples__Y_ "Fault manager configuration.  Select up to 4 actions for each fault." VALUE 0x80000665 RecordLayout_3 0 CompuMethod_1 0 255 /end CHARACTERISTIC
/begin CHARACTERISTIC FaultManager.O2A_RangeHigh.Action_1 "Fault manager configuration.  Select up to 4 actions for each fault." VALUE 0x80000666 RecordLayout_3 0 CompuMethod_158 0 255 /end CHARACTERISTIC
/begin CHARACTERISTIC FaultManager.O2A_RangeHigh.Action_1_Condition "Fault manager configuration.  Select up to 4 actions for each fault." VALUE 0x80000667 RecordLayout_3 0 CompuMethod_159 0 255 /end CHARACTERISTIC
/begin CHARACTERISTIC FaultManager.O2A_RangeHigh.Action_2 "Fault manager configuration.  Select up to 4 actions for each fault." VALUE 0x80000668 RecordLayout_3 0 CompuMethod_158 0 255 /end CHARACTERISTIC
/begin CHARACTERISTIC FaultManager.O2A_RangeHigh.Action_2_Condition "Fault manager configuration.  Select up to 4 actions for each fault." VALUE 0x80000669 RecordLayout_3 0 CompuMethod_159 0 255 /end CHARACTERISTIC
/begin CHARACTERISTIC FaultManager.O2A_RangeHigh.Action_3 "Fault manager configuration.  Select up to 4 actions for each fault." VALUE 0x8000066A RecordLayout_3 0 CompuMethod_158 0 255 /end CHARACTERISTIC
/begin CHARACTERISTIC FaultManager.O2A_RangeHigh.Action_3_Condition "Fault manager configuration.  Select up to 4 actions for each fault." VALUE 0x8000066B RecordLayout_3 0 CompuMethod_159 0 255 /end CHARACTERISTIC
/begin CHARACTERISTIC FaultManager.O2A_RangeHigh.Action_4 "Fault manager configuration.  Select up to 4 actions for each fault." VALUE 0x8000066C RecordLayout_3 0 CompuMethod_158 0 255 /end CHARACTERISTIC
/begin CHARACTERISTIC FaultManager.O2A_RangeHigh.Action_4_Condition "Fault manager configuration.  Select up to 4 actions for each fault." VALUE 0x8000066D RecordLayout_3 0 CompuMethod_159 0 255 /end CHARACTERISTIC
/begin CHARACTERISTIC FaultManager.O2A_RangeLow.Mode "Fault manager configuration.  Select up to 4 actions for each fault." VALUE 0x8000066E RecordLayout_3 0 CompuMethod_156 0 255 /end CHARACTERISTIC
/begin CHARACTERISTIC FaultManager.O2A_RangeLow.ID "Fault manager configuration.  Select up to 4 actions for each fault." VALUE 0x8000066F RecordLayout_3 0 CompuMethod_1 0 255 /end CHARACTERISTIC
/begin CHARACTERISTIC FaultManager.O2A_RangeLow.Test "Fault manager configuration.  Select up to 4 actions for each fault." VALUE 0x80000670 RecordLayout_3 0 CompuMethod_157 0 255 /end CHARACTERISTIC
/begin CHARACTERISTIC FaultManager.O2A_RangeLow.Faulty_Samples__X_ "Fault manager configuration.  Select up to 4 actions for each fault." VALUE 0x80000671 RecordLayout_3 0 CompuMethod_1 0 255 /end CHARACTERISTIC
/begin CHARACTERISTIC FaultManager.O2A_RangeLow.Total_Samples__Y_ "Fault manager configuration.  Select up to 4 actions for each fault." VALUE 0x80000672 RecordLayout_3 0 CompuMethod_1 0 255 /end CHARACTERISTIC
/begin CHARACTERISTIC FaultManager.O2A_RangeLow.Action_1 "Fault manager configuration.  Select up to 4 actions for each fault." VALUE 0x80000673 RecordLayout_3 0 CompuMethod_158 0 255 /end CHARACTERISTIC
/begin CHARACTERISTIC FaultManager.O2A_RangeLow.Action_1_Condition "Fault manager configuration.  Select up to 4 actions for each fault." VALUE 0x80000674 RecordLayout_3 0 CompuMethod_159 0 255 /end CHARACTERISTIC
/begin CHARACTERISTIC FaultManager.O2A_RangeLow.Action_2 "Fault manager configuration.  Select up to 4 actions for each fault." VALUE 0x80000675 RecordLayout_3 0 CompuMethod_158 0 255 /end CHARACTERISTIC
/begin CHARACTERISTIC FaultManager.O2A_RangeLow.Action_2_Condition "Fault manager configuration.  Select up to 4 actions for each fault." VALUE 0x80000676 RecordLayout_3 0 CompuMethod_159 0 255 /end CHARACTERISTIC
/begin CHARACTERISTIC FaultManager.O2A_RangeLow.Action_3 "Fault manager configuration.  Select up to 4 actions for each fault." VALUE 0x80000677 RecordLayout_3 0 CompuMethod_158 0 255 /end CHARACTERISTIC
/begin CHARACTERISTIC FaultManager.O2A_RangeLow.Action_3_Condition "Fault manager configuration.  Select up to 4 actions for each fault." VALUE 0x80000678 RecordLayout_3 0 CompuMethod_159 0 255 /end CHARACTERISTIC
/begin CHARACTERISTIC FaultManager.O2A_RangeLow.Action_4 "Fault manager configuration.  Select up to 4 actions for each fault." VALUE 0x80000679 RecordLayout_3 0 CompuMethod_158 0 255 /end CHARACTERISTIC
/begin CHARACTERISTIC FaultManager.O2A_RangeLow.Action_4_Condition "Fault manager configuration.  Select up to 4 actions for each fault." VALUE 0x8000067A RecordLayout_3 0 CompuMethod_159 0 255 /end CHARACTERISTIC
/begin CHARACTERISTIC FaultManager.O2B_RangeHigh.Mode "Fault manager configuration.  Select up to 4 actions for each fault." VALUE 0x8000067B RecordLayout_3 0 CompuMethod_156 0 255 /end CHARACTERISTIC
/begin CHARACTERISTIC FaultManager.O2B_RangeHigh.ID "Fault manager configuration.  Select up to 4 actions for each fault." VALUE 0x8000067C RecordLayout_3 0 CompuMethod_1 0 255 /end CHARACTERISTIC
/begin CHARACTERISTIC FaultManager.O2B_RangeHigh.Test "Fault manager configuration.  Select up to 4 actions for each fault." VALUE 0x8000067D RecordLayout_3 0 CompuMethod_157 0 255 /end CHARACTERISTIC
/begin CHARACTERISTIC FaultManager.O2B_RangeHigh.Faulty_Samples__X_ "Fault manager configuration.  Select up to 4 actions for each fault." VALUE 0x8000067E RecordLayout_3 0 CompuMethod_1 0 255 /end CHARACTERISTIC
/begin CHARACTERISTIC FaultManager.O2B_RangeHigh.Total_Samples__Y_ "Fault manager configuration.  Select up to 4 actions for each fault." VALUE 0x8000067F RecordLayout_3 0 CompuMethod_1 0 255 /end CHARACTERISTIC
/begin CHARACTERISTIC FaultManager.O2B_RangeHigh.Action_1 "Fault manager configuration.  Select up to 4 actions for each fault." VALUE 0x80000680 RecordLayout_3 0 CompuMethod_158 0 255 /end CHARACTERISTIC
/begin CHARACTERISTIC FaultManager.O2B_RangeHigh.Action_1_Condition "Fault manager configuration.  Select up to 4 actions for each fault." VALUE 0x80000681 RecordLayout_3 0 CompuMethod_159 0 255 /end CHARACTERISTIC
/begin CHARACTERISTIC FaultManager.O2B_RangeHigh.Action_2 "Fault manager configuration.  Select up to 4 actions for each fault." VALUE 0x80000682 RecordLayout_3 0 CompuMethod_158 0 255 /end CHARACTERISTIC
/begin CHARACTERISTIC FaultManager.O2B_RangeHigh.Action_2_Condition "Fault manager configuration.  Select up to 4 actions for each fault." VALUE 0x80000683 RecordLayout_3 0 CompuMethod_159 0 255 /end CHARACTERISTIC
/begin CHARACTERISTIC FaultManager.O2B_RangeHigh.Action_3 "Fault manager configuration.  Select up to 4 actions for each fault." VALUE 0x80000684 RecordLayout_3 0 CompuMethod_158 0 255 /end CHARACTERISTIC
/begin CHARACTERISTIC FaultManager.O2B_RangeHigh.Action_3_Condition "Fault manager configuration.  Select up to 4 actions for each fault." VALUE 0x80000685 RecordLayout_3 0 CompuMethod_159 0 255 /end CHARACTERISTIC
/begin CHARACTERISTIC FaultManager.O2B_RangeHigh.Action_4 "Fault manager configuration.  Select up to 4 actions for each fault." VALUE 0x80000686 RecordLayout_3 0 CompuMethod_158 0 255 /end CHARACTERISTIC
/begin CHARACTERISTIC FaultManager.O2B_RangeHigh.Action_4_Condition "Fault manager configuration.  Select up to 4 actions for each fault." VALUE 0x80000687 RecordLayout_3 0 CompuMethod_159 0 255 /end CHARACTERISTIC
/begin CHARACTERISTIC FaultManager.O2B_RangeLow.Mode "Fault manager configuration.  Select up to 4 actions for each fault." VALUE 0x80000688 RecordLayout_3 0 CompuMethod_156 0 255 /end CHARACTERISTIC
/begin CHARACTERISTIC FaultManager.O2B_RangeLow.ID "Fault manager configuration.  Select up to 4 actions for each fault." VALUE 0x80000689 RecordLayout_3 0 CompuMethod_1 0 255 /end CHARACTERISTIC
/begin CHARACTERISTIC FaultManager.O2B_RangeLow.Test "Fault manager configuration.  Select up to 4 actions for each fault." VALUE 0x8000068A RecordLayout_3 0 CompuMethod_157 0 255 /end CHARACTERISTIC
/begin CHARACTERISTIC FaultManager.O2B_RangeLow.Faulty_Samples__X_ "Fault manager configuration.  Select up to 4 actions for each fault." VALUE 0x8000068B RecordLayout_3 0 CompuMethod_1 0 255 /end CHARACTERISTIC
/begin CHARACTERISTIC FaultManager.O2B_RangeLow.Total_Samples__Y_ "Fault manager configuration.  Select up to 4 actions for each fault." VALUE 0x8000068C RecordLayout_3 0 CompuMethod_1 0 255 /end CHARACTERISTIC
/begin CHARACTERISTIC FaultManager.O2B_RangeLow.Action_1 "Fault manager configuration.  Select up to 4 actions for each fault." VALUE 0x8000068D RecordLayout_3 0 CompuMethod_158 0 255 /end CHARACTERISTIC
/begin CHARACTERISTIC FaultManager.O2B_RangeLow.Action_1_Condition "Fault manager configuration.  Select up to 4 actions for each fault." VALUE 0x8000068E RecordLayout_3 0 CompuMethod_159 0 255 /end CHARACTERISTIC
/begin CHARACTERISTIC FaultManager.O2B_RangeLow.Action_2 "Fault manager configuration.  Select up to 4 actions for each fault." VALUE 0x8000068F RecordLayout_3 0 CompuMethod_158 0 255 /end CHARACTERISTIC
/begin CHARACTERISTIC FaultManager.O2B_RangeLow.Action_2_Condition "Fault manager configuration.  Select up to 4 actions for each fault." VALUE 0x80000690 RecordLayout_3 0 CompuMethod_159 0 255 /end CHARACTERISTIC
/begin CHARACTERISTIC FaultManager.O2B_RangeLow.Action_3 "Fault manager configuration.  Select up to 4 actions for each fault." VALUE 0x80000691 RecordLayout_3 0 CompuMethod_158 0 255 /end CHARACTERISTIC
/begin CHARACTERISTIC FaultManager.O2B_RangeLow.Action_3_Condition "Fault manager configuration.  Select up to 4 actions for each fault." VALUE 0x80000692 RecordLayout_3 0 CompuMethod_159 0 255 /end CHARACTERISTIC
/begin CHARACTERISTIC FaultManager.O2B_RangeLow.Action_4 "Fault manager configuration.  Select up to 4 actions for each fault." VALUE 0x80000693 RecordLayout_3 0 CompuMethod_158 0 255 /end CHARACTERISTIC
/begin CHARACTERISTIC FaultManager.O2B_RangeLow.Action_4_Condition "Fault manager configuration.  Select up to 4 actions for each fault." VALUE 0x80000694 RecordLayout_3 0 CompuMethod_159 0 255 /end CHARACTERISTIC
/begin CHARACTERISTIC FaultManager.O2C_RangeHigh.Mode "Fault manager configuration.  Select up to 4 actions for each fault." VALUE 0x80000695 RecordLayout_3 0 CompuMethod_156 0 255 /end CHARACTERISTIC
/begin CHARACTERISTIC FaultManager.O2C_RangeHigh.ID "Fault manager configuration.  Select up to 4 actions for each fault." VALUE 0x80000696 RecordLayout_3 0 CompuMethod_1 0 255 /end CHARACTERISTIC
/begin CHARACTERISTIC FaultManager.O2C_RangeHigh.Test "Fault manager configuration.  Select up to 4 actions for each fault." VALUE 0x80000697 RecordLayout_3 0 CompuMethod_157 0 255 /end CHARACTERISTIC
/begin CHARACTERISTIC FaultManager.O2C_RangeHigh.Faulty_Samples__X_ "Fault manager configuration.  Select up to 4 actions for each fault." VALUE 0x80000698 RecordLayout_3 0 CompuMethod_1 0 255 /end CHARACTERISTIC
/begin CHARACTERISTIC FaultManager.O2C_RangeHigh.Total_Samples__Y_ "Fault manager configuration.  Select up to 4 actions for each fault." VALUE 0x80000699 RecordLayout_3 0 CompuMethod_1 0 255 /end CHARACTERISTIC
/begin CHARACTERISTIC FaultManager.O2C_RangeHigh.Action_1 "Fault manager configuration.  Select up to 4 actions for each fault." VALUE 0x8000069A RecordLayout_3 0 CompuMethod_158 0 255 /end CHARACTERISTIC
/begin CHARACTERISTIC FaultManager.O2C_RangeHigh.Action_1_Condition "Fault manager configuration.  Select up to 4 actions for each fault." VALUE 0x8000069B RecordLayout_3 0 CompuMethod_159 0 255 /end CHARACTERISTIC
/begin CHARACTERISTIC FaultManager.O2C_RangeHigh.Action_2 "Fault manager configuration.  Select up to 4 actions for each fault." VALUE 0x8000069C RecordLayout_3 0 CompuMethod_158 0 255 /end CHARACTERISTIC
/begin CHARACTERISTIC FaultManager.O2C_RangeHigh.Action_2_Condition "Fault manager configuration.  Select up to 4 actions for each fault." VALUE 0x8000069D RecordLayout_3 0 CompuMethod_159 0 255 /end CHARACTERISTIC
/begin CHARACTERISTIC FaultManager.O2C_RangeHigh.Action_3 "Fault manager configuration.  Select up to 4 actions for each fault." VALUE 0x8000069E RecordLayout_3 0 CompuMethod_158 0 255 /end CHARACTERISTIC
/begin CHARACTERISTIC FaultManager.O2C_RangeHigh.Action_3_Condition "Fault manager configuration.  Select up to 4 actions for each fault." VALUE 0x8000069F RecordLayout_3 0 CompuMethod_159 0 255 /end CHARACTERISTIC
/begin CHARACTERISTIC FaultManager.O2C_RangeHigh.Action_4 "Fault manager configuration.  Select up to 4 actions for each fault." VALUE 0x800006A0 RecordLayout_3 0 CompuMethod_158 0 255 /end CHARACTERISTIC
/begin CHARACTERISTIC FaultManager.O2C_RangeHigh.Action_4_Condition "Fault manager configuration.  Select up to 4 actions for each fault." VALUE 0x800006A1 RecordLayout_3 0 CompuMethod_159 0 255 /end CHARACTERISTIC
/begin CHARACTERISTIC FaultManager.O2C_RangeLow.Mode "Fault manager configuration.  Select up to 4 actions for each fault." VALUE 0x800006A2 RecordLayout_3 0 CompuMethod_156 0 255 /end CHARACTERISTIC
/begin CHARACTERISTIC FaultManager.O2C_RangeLow.ID "Fault manager configuration.  Select up to 4 actions for each fault." VALUE 0x800006A3 RecordLayout_3 0 CompuMethod_1 0 255 /end CHARACTERISTIC
/begin CHARACTERISTIC FaultManager.O2C_RangeLow.Test "Fault manager configuration.  Select up to 4 actions for each fault." VALUE 0x800006A4 RecordLayout_3 0 CompuMethod_157 0 255 /end CHARACTERISTIC
/begin CHARACTERISTIC FaultManager.O2C_RangeLow.Faulty_Samples__X_ "Fault manager configuration.  Select up to 4 actions for each fault." VALUE 0x800006A5 RecordLayout_3 0 CompuMethod_1 0 255 /end CHARACTERISTIC
/begin CHARACTERISTIC FaultManager.O2C_RangeLow.Total_Samples__Y_ "Fault manager configuration.  Select up to 4 actions for each fault." VALUE 0x800006A6 RecordLayout_3 0 CompuMethod_1 0 255 /end CHARACTERISTIC
/begin CHARACTERISTIC FaultManager.O2C_RangeLow.Action_1 "Fault manager configuration.  Select up to 4 actions for each fault." VALUE 0x800006A7 RecordLayout_3 0 CompuMethod_158 0 255 /end CHARACTERISTIC
/begin CHARACTERISTIC FaultManager.O2C_RangeLow.Action_1_Condition "Fault manager configuration.  Select up to 4 actions for each fault." VALUE 0x800006A8 RecordLayout_3 0 CompuMethod_159 0 255 /end CHARACTERISTIC
/begin CHARACTERISTIC FaultManager.O2C_RangeLow.Action_2 "Fault manager configuration.  Select up to 4 actions for each fault." VALUE 0x800006A9 RecordLayout_3 0 CompuMethod_158 0 255 /end CHARACTERISTIC
/begin CHARACTERISTIC FaultManager.O2C_RangeLow.Action_2_Condition "Fault manager configuration.  Select up to 4 actions for each fault." VALUE 0x800006AA RecordLayout_3 0 CompuMethod_159 0 255 /end CHARACTERISTIC
/begin CHARACTERISTIC FaultManager.O2C_RangeLow.Action_3 "Fault manager configuration.  Select up to 4 actions for each fault." VALUE 0x800006AB RecordLayout_3 0 CompuMethod_158 0 255 /end CHARACTERISTIC
/begin CHARACTERISTIC FaultManager.O2C_RangeLow.Action_3_Condition "Fault manager configuration.  Select up to 4 actions for each fault." VALUE 0x800006AC RecordLayout_3 0 CompuMethod_159 0 255 /end CHARACTERISTIC
/begin CHARACTERISTIC FaultManager.O2C_RangeLow.Action_4 "Fault manager configuration.  Select up to 4 actions for each fault." VALUE 0x800006AD RecordLayout_3 0 CompuMethod_158 0 255 /end CHARACTERISTIC
/begin CHARACTERISTIC FaultManager.O2C_RangeLow.Action_4_Condition "Fault manager configuration.  Select up to 4 actions for each fault." VALUE 0x800006AE RecordLayout_3 0 CompuMethod_159 0 255 /end CHARACTERISTIC
/begin CHARACTERISTIC FaultManager.O2D_RangeHigh.Mode "Fault manager configuration.  Select up to 4 actions for each fault." VALUE 0x800006AF RecordLayout_3 0 CompuMethod_156 0 255 /end CHARACTERISTIC
/begin CHARACTERISTIC FaultManager.O2D_RangeHigh.ID "Fault manager configuration.  Select up to 4 actions for each fault." VALUE 0x800006B0 RecordLayout_3 0 CompuMethod_1 0 255 /end CHARACTERISTIC
/begin CHARACTERISTIC FaultManager.O2D_RangeHigh.Test "Fault manager configuration.  Select up to 4 actions for each fault." VALUE 0x800006B1 RecordLayout_3 0 CompuMethod_157 0 255 /end CHARACTERISTIC
/begin CHARACTERISTIC FaultManager.O2D_RangeHigh.Faulty_Samples__X_ "Fault manager configuration.  Select up to 4 actions for each fault." VALUE 0x800006B2 RecordLayout_3 0 CompuMethod_1 0 255 /end CHARACTERISTIC
/begin CHARACTERISTIC FaultManager.O2D_RangeHigh.Total_Samples__Y_ "Fault manager configuration.  Select up to 4 actions for each fault." VALUE 0x800006B3 RecordLayout_3 0 CompuMethod_1 0 255 /end CHARACTERISTIC
/begin CHARACTERISTIC FaultManager.O2D_RangeHigh.Action_1 "Fault manager configuration.  Select up to 4 actions for each fault." VALUE 0x800006B4 RecordLayout_3 0 CompuMethod_158 0 255 /end CHARACTERISTIC
/begin CHARACTERISTIC FaultManager.O2D_RangeHigh.Action_1_Condition "Fault manager configuration.  Select up to 4 actions for each fault." VALUE 0x800006B5 RecordLayout_3 0 CompuMethod_159 0 255 /end CHARACTERISTIC
/begin CHARACTERISTIC FaultManager.O2D_RangeHigh.Action_2 "Fault manager configuration.  Select up to 4 actions for each fault." VALUE 0x800006B6 RecordLayout_3 0 CompuMethod_158 0 255 /end CHARACTERISTIC
/begin CHARACTERISTIC FaultManager.O2D_RangeHigh.Action_2_Condition "Fault manager configuration.  Select up to 4 actions for each fault." VALUE 0x800006B7 RecordLayout_3 0 CompuMethod_159 0 255 /end CHARACTERISTIC
/begin CHARACTERISTIC FaultManager.O2D_RangeHigh.Action_3 "Fault manager configuration.  Select up to 4 actions for each fault." VALUE 0x800006B8 RecordLayout_3 0 CompuMethod_158 0 255 /end CHARACTERISTIC
/begin CHARACTERISTIC FaultManager.O2D_RangeHigh.Action_3_Condition "Fault manager configuration.  Select up to 4 actions for each fault." VALUE 0x800006B9 RecordLayout_3 0 CompuMethod_159 0 255 /end CHARACTERISTIC
/begin CHARACTERISTIC FaultManager.O2D_RangeHigh.Action_4 "Fault manager configuration.  Select up to 4 actions for each fault." VALUE 0x800006BA RecordLayout_3 0 CompuMethod_158 0 255 /end CHARACTERISTIC
/begin CHARACTERISTIC FaultManager.O2D_RangeHigh.Action_4_Condition "Fault manager configuration.  Select up to 4 actions for each fault." VALUE 0x800006BB RecordLayout_3 0 CompuMethod_159 0 255 /end CHARACTERISTIC
/begin CHARACTERISTIC FaultManager.O2D_RangeLow.Mode "Fault manager configuration.  Select up to 4 actions for each fault." VALUE 0x800006BC RecordLayout_3 0 CompuMethod_156 0 255 /end CHARACTERISTIC
/begin CHARACTERISTIC FaultManager.O2D_RangeLow.ID "Fault manager configuration.  Select up to 4 actions for each fault." VALUE 0x800006BD RecordLayout_3 0 CompuMethod_1 0 255 /end CHARACTERISTIC
/begin CHARACTERISTIC FaultManager.O2D_RangeLow.Test "Fault manager configuration.  Select up to 4 actions for each fault." VALUE 0x800006BE RecordLayout_3 0 CompuMethod_157 0 255 /end CHARACTERISTIC
/begin CHARACTERISTIC FaultManager.O2D_RangeLow.Faulty_Samples__X_ "Fault manager configuration.  Select up to 4 actions for each fault." VALUE 0x800006BF RecordLayout_3 0 CompuMethod_1 0 255 /end CHARACTERISTIC
/begin CHARACTERISTIC FaultManager.O2D_RangeLow.Total_Samples__Y_ "Fault manager configuration.  Select up to 4 actions for each fault." VALUE 0x800006C0 RecordLayout_3 0 CompuMethod_1 0 255 /end CHARACTERISTIC
/begin CHARACTERISTIC FaultManager.O2D_RangeLow.Action_1 "Fault manager configuration.  Select up to 4 actions for each fault." VALUE 0x800006C1 RecordLayout_3 0 CompuMethod_158 0 255 /end CHARACTERISTIC
/begin CHARACTERISTIC FaultManager.O2D_RangeLow.Action_1_Condition "Fault manager configuration.  Select up to 4 actions for each fault." VALUE 0x800006C2 RecordLayout_3 0 CompuMethod_159 0 255 /end CHARACTERISTIC
/begin CHARACTERISTIC FaultManager.O2D_RangeLow.Action_2 "Fault manager configuration.  Select up to 4 actions for each fault." VALUE 0x800006C3 RecordLayout_3 0 CompuMethod_158 0 255 /end CHARACTERISTIC
/begin CHARACTERISTIC FaultManager.O2D_RangeLow.Action_2_Condition "Fault manager configuration.  Select up to 4 actions for each fault." VALUE 0x800006C4 RecordLayout_3 0 CompuMethod_159 0 255 /end CHARACTERISTIC
/begin CHARACTERISTIC FaultManager.O2D_RangeLow.Action_3 "Fault manager configuration.  Select up to 4 actions for each fault." VALUE 0x800006C5 RecordLayout_3 0 CompuMethod_158 0 255 /end CHARACTERISTIC
/begin CHARACTERISTIC FaultManager.O2D_RangeLow.Action_3_Condition "Fault manager configuration.  Select up to 4 actions for each fault." VALUE 0x800006C6 RecordLayout_3 0 CompuMethod_159 0 255 /end CHARACTERISTIC
/begin CHARACTERISTIC FaultManager.O2D_RangeLow.Action_4 "Fault manager configuration.  Select up to 4 actions for each fault." VALUE 0x800006C7 RecordLayout_3 0 CompuMethod_158 0 255 /end CHARACTERISTIC
/begin CHARACTERISTIC FaultManager.O2D_RangeLow.Action_4_Condition "Fault manager configuration.  Select up to 4 actions for each fault." VALUE 0x800006C8 RecordLayout_3 0 CompuMethod_159 0 255 /end CHARACTERISTIC
/begin CHARACTERISTIC FaultManager.OilP_RangeHigh.Mode "Fault manager configuration.  Select up to 4 actions for each fault." VALUE 0x800006C9 RecordLayout_3 0 CompuMethod_156 0 255 /end CHARACTERISTIC
/begin CHARACTERISTIC FaultManager.OilP_RangeHigh.ID "Fault manager configuration.  Select up to 4 actions for each fault." VALUE 0x800006CA RecordLayout_3 0 CompuMethod_1 0 255 /end CHARACTERISTIC
/begin CHARACTERISTIC FaultManager.OilP_RangeHigh.Test "Fault manager configuration.  Select up to 4 actions for each fault." VALUE 0x800006CB RecordLayout_3 0 CompuMethod_157 0 255 /end CHARACTERISTIC
/begin CHARACTERISTIC FaultManager.OilP_RangeHigh.Faulty_Samples__X_ "Fault manager configuration.  Select up to 4 actions for each fault." VALUE 0x800006CC RecordLayout_3 0 CompuMethod_1 0 255 /end CHARACTERISTIC
/begin CHARACTERISTIC FaultManager.OilP_RangeHigh.Total_Samples__Y_ "Fault manager configuration.  Select up to 4 actions for each fault." VALUE 0x800006CD RecordLayout_3 0 CompuMethod_1 0 255 /end CHARACTERISTIC
/begin CHARACTERISTIC FaultManager.OilP_RangeHigh.Action_1 "Fault manager configuration.  Select up to 4 actions for each fault." VALUE 0x800006CE RecordLayout_3 0 CompuMethod_158 0 255 /end CHARACTERISTIC
/begin CHARACTERISTIC FaultManager.OilP_RangeHigh.Action_1_Condition "Fault manager configuration.  Select up to 4 actions for each fault." VALUE 0x800006CF RecordLayout_3 0 CompuMethod_159 0 255 /end CHARACTERISTIC
/begin CHARACTERISTIC FaultManager.OilP_RangeHigh.Action_2 "Fault manager configuration.  Select up to 4 actions for each fault." VALUE 0x800006D0 RecordLayout_3 0 CompuMethod_158 0 255 /end CHARACTERISTIC
/begin CHARACTERISTIC FaultManager.OilP_RangeHigh.Action_2_Condition "Fault manager configuration.  Select up to 4 actions for each fault." VALUE 0x800006D1 RecordLayout_3 0 CompuMethod_159 0 255 /end CHARACTERISTIC
/begin CHARACTERISTIC FaultManager.OilP_RangeHigh.Action_3 "Fault manager configuration.  Select up to 4 actions for each fault." VALUE 0x800006D2 RecordLayout_3 0 CompuMethod_158 0 255 /end CHARACTERISTIC
/begin CHARACTERISTIC FaultManager.OilP_RangeHigh.Action_3_Condition "Fault manager configuration.  Select up to 4 actions for each fault." VALUE 0x800006D3 RecordLayout_3 0 CompuMethod_159 0 255 /end CHARACTERISTIC
/begin CHARACTERISTIC FaultManager.OilP_RangeHigh.Action_4 "Fault manager configuration.  Select up to 4 actions for each fault." VALUE 0x800006D4 RecordLayout_3 0 CompuMethod_158 0 255 /end CHARACTERISTIC
/begin CHARACTERISTIC FaultManager.OilP_RangeHigh.Action_4_Condition "Fault manager configuration.  Select up to 4 actions for each fault." VALUE 0x800006D5 RecordLayout_3 0 CompuMethod_159 0 255 /end CHARACTERISTIC
/begin CHARACTERISTIC FaultManager.OilP_RangeLow.Mode "Fault manager configuration.  Select up to 4 actions for each fault." VALUE 0x800006D6 RecordLayout_3 0 CompuMethod_156 0 255 /end CHARACTERISTIC
/begin CHARACTERISTIC FaultManager.OilP_RangeLow.ID "Fault manager configuration.  Select up to 4 actions for each fault." VALUE 0x800006D7 RecordLayout_3 0 CompuMethod_1 0 255 /end CHARACTERISTIC
/begin CHARACTERISTIC FaultManager.OilP_RangeLow.Test "Fault manager configuration.  Select up to 4 actions for each fault." VALUE 0x800006D8 RecordLayout_3 0 CompuMethod_157 0 255 /end CHARACTERISTIC
/begin CHARACTERISTIC FaultManager.OilP_RangeLow.Faulty_Samples__X_ "Fault manager configuration.  Select up to 4 actions for each fault." VALUE 0x800006D9 RecordLayout_3 0 CompuMethod_1 0 255 /end CHARACTERISTIC
/begin CHARACTERISTIC FaultManager.OilP_RangeLow.Total_Samples__Y_ "Fault manager configuration.  Select up to 4 actions for each fault." VALUE 0x800006DA RecordLayout_3 0 CompuMethod_1 0 255 /end CHARACTERISTIC
/begin CHARACTERISTIC FaultManager.OilP_RangeLow.Action_1 "Fault manager configuration.  Select up to 4 actions for each fault." VALUE 0x800006DB RecordLayout_3 0 CompuMethod_158 0 255 /end CHARACTERISTIC
/begin CHARACTERISTIC FaultManager.OilP_RangeLow.Action_1_Condition "Fault manager configuration.  Select up to 4 actions for each fault." VALUE 0x800006DC RecordLayout_3 0 CompuMethod_159 0 255 /end CHARACTERISTIC
/begin CHARACTERISTIC FaultManager.OilP_RangeLow.Action_2 "Fault manager configuration.  Select up to 4 actions for each fault." VALUE 0x800006DD RecordLayout_3 0 CompuMethod_158 0 255 /end CHARACTERISTIC
/begin CHARACTERISTIC FaultManager.OilP_RangeLow.Action_2_Condition "Fault manager configuration.  Select up to 4 actions for each fault." VALUE 0x800006DE RecordLayout_3 0 CompuMethod_159 0 255 /end CHARACTERISTIC
/begin CHARACTERISTIC FaultManager.OilP_RangeLow.Action_3 "Fault manager configuration.  Select up to 4 actions for each fault." VALUE 0x800006DF RecordLayout_3 0 CompuMethod_158 0 255 /end CHARACTERISTIC
/begin CHARACTERISTIC FaultManager.OilP_RangeLow.Action_3_Condition "Fault manager configuration.  Select up to 4 actions for each fault." VALUE 0x800006E0 RecordLayout_3 0 CompuMethod_159 0 255 /end CHARACTERISTIC
/begin CHARACTERISTIC FaultManager.OilP_RangeLow.Action_4 "Fault manager configuration.  Select up to 4 actions for each fault." VALUE 0x800006E1 RecordLayout_3 0 CompuMethod_158 0 255 /end CHARACTERISTIC
/begin CHARACTERISTIC FaultManager.OilP_RangeLow.Action_4_Condition "Fault manager configuration.  Select up to 4 actions for each fault." VALUE 0x800006E2 RecordLayout_3 0 CompuMethod_159 0 255 /end CHARACTERISTIC
/begin CHARACTERISTIC FaultManager.Pcyl1_RangeHigh.Mode "Fault manager configuration.  Select up to 4 actions for each fault." VALUE 0x800006E3 RecordLayout_3 0 CompuMethod_156 0 255 /end CHARACTERISTIC
/begin CHARACTERISTIC FaultManager.Pcyl1_RangeHigh.ID "Fault manager configuration.  Select up to 4 actions for each fault." VALUE 0x800006E4 RecordLayout_3 0 CompuMethod_1 0 255 /end CHARACTERISTIC
/begin CHARACTERISTIC FaultManager.Pcyl1_RangeHigh.Test "Fault manager configuration.  Select up to 4 actions for each fault." VALUE 0x800006E5 RecordLayout_3 0 CompuMethod_157 0 255 /end CHARACTERISTIC
/begin CHARACTERISTIC FaultManager.Pcyl1_RangeHigh.Faulty_Samples__X_ "Fault manager configuration.  Select up to 4 actions for each fault." VALUE 0x800006E6 RecordLayout_3 0 CompuMethod_1 0 255 /end CHARACTERISTIC
/begin CHARACTERISTIC FaultManager.Pcyl1_RangeHigh.Total_Samples__Y_ "Fault manager configuration.  Select up to 4 actions for each fault." VALUE 0x800006E7 RecordLayout_3 0 CompuMethod_1 0 255 /end CHARACTERISTIC
/begin CHARACTERISTIC FaultManager.Pcyl1_RangeHigh.Action_1 "Fault manager configuration.  Select up to 4 actions for each fault." VALUE 0x800006E8 RecordLayout_3 0 CompuMethod_158 0 255 /end CHARACTERISTIC
/begin CHARACTERISTIC FaultManager.Pcyl1_RangeHigh.Action_1_Condition "Fault manager configuration.  Select up to 4 actions for each fault." VALUE 0x800006E9 RecordLayout_3 0 CompuMethod_159 0 255 /end CHARACTERISTIC
/begin CHARACTERISTIC FaultManager.Pcyl1_RangeHigh.Action_2 "Fault manager configuration.  Select up to 4 actions for each fault." VALUE 0x800006EA RecordLayout_3 0 CompuMethod_158 0 255 /end CHARACTERISTIC
/begin CHARACTERISTIC FaultManager.Pcyl1_RangeHigh.Action_2_Condition "Fault manager configuration.  Select up to 4 actions for each fault." VALUE 0x800006EB RecordLayout_3 0 CompuMethod_159 0 255 /end CHARACTERISTIC
/begin CHARACTERISTIC FaultManager.Pcyl1_RangeHigh.Action_3 "Fault manager configuration.  Select up to 4 actions for each fault." VALUE 0x800006EC RecordLayout_3 0 CompuMethod_158 0 255 /end CHARACTERISTIC
/begin CHARACTERISTIC FaultManager.Pcyl1_RangeHigh.Action_3_Condition "Fault manager configuration.  Select up to 4 actions for each fault." VALUE 0x800006ED RecordLayout_3 0 CompuMethod_159 0 255 /end CHARACTERISTIC
/begin CHARACTERISTIC FaultManager.Pcyl1_RangeHigh.Action_4 "Fault manager configuration.  Select up to 4 actions for each fault." VALUE 0x800006EE RecordLayout_3 0 CompuMethod_158 0 255 /end CHARACTERISTIC
/begin CHARACTERISTIC FaultManager.Pcyl1_RangeHigh.Action_4_Condition "Fault manager configuration.  Select up to 4 actions for each fault." VALUE 0x800006EF RecordLayout_3 0 CompuMethod_159 0 255 /end CHARACTERISTIC
/begin CHARACTERISTIC FaultManager.Pcyl1_RangeLow.Mode "Fault manager configuration.  Select up to 4 actions for each fault." VALUE 0x800006F0 RecordLayout_3 0 CompuMethod_156 0 255 /end CHARACTERISTIC
/begin CHARACTERISTIC FaultManager.Pcyl1_RangeLow.ID "Fault manager configuration.  Select up to 4 actions for each fault." VALUE 0x800006F1 RecordLayout_3 0 CompuMethod_1 0 255 /end CHARACTERISTIC
/begin CHARACTERISTIC FaultManager.Pcyl1_RangeLow.Test "Fault manager configuration.  Select up to 4 actions for each fault." VALUE 0x800006F2 RecordLayout_3 0 CompuMethod_157 0 255 /end CHARACTERISTIC
/begin CHARACTERISTIC FaultManager.Pcyl1_RangeLow.Faulty_Samples__X_ "Fault manager configuration.  Select up to 4 actions for each fault." VALUE 0x800006F3 RecordLayout_3 0 CompuMethod_1 0 255 /end CHARACTERISTIC
/begin CHARACTERISTIC FaultManager.Pcyl1_RangeLow.Total_Samples__Y_ "Fault manager configuration.  Select up to 4 actions for each fault." VALUE 0x800006F4 RecordLayout_3 0 CompuMethod_1 0 255 /end CHARACTERISTIC
/begin CHARACTERISTIC FaultManager.Pcyl1_RangeLow.Action_1 "Fault manager configuration.  Select up to 4 actions for each fault." VALUE 0x800006F5 RecordLayout_3 0 CompuMethod_158 0 255 /end CHARACTERISTIC
/begin CHARACTERISTIC FaultManager.Pcyl1_RangeLow.Action_1_Condition "Fault manager configuration.  Select up to 4 actions for each fault." VALUE 0x800006F6 RecordLayout_3 0 CompuMethod_159 0 255 /end CHARACTERISTIC
/begin CHARACTERISTIC FaultManager.Pcyl1_RangeLow.Action_2 "Fault manager configuration.  Select up to 4 actions for each fault." VALUE 0x800006F7 RecordLayout_3 0 CompuMethod_158 0 255 /end CHARACTERISTIC
/begin CHARACTERISTIC FaultManager.Pcyl1_RangeLow.Action_2_Condition "Fault manager configuration.  Select up to 4 actions for each fault." VALUE 0x800006F8 RecordLayout_3 0 CompuMethod_159 0 255 /end CHARACTERISTIC
/begin CHARACTERISTIC FaultManager.Pcyl1_RangeLow.Action_3 "Fault manager configuration.  Select up to 4 actions for each fault." VALUE 0x800006F9 RecordLayout_3 0 CompuMethod_158 0 255 /end CHARACTERISTIC
/begin CHARACTERISTIC FaultManager.Pcyl1_RangeLow.Action_3_Condition "Fault manager configuration.  Select up to 4 actions for each fault." VALUE 0x800006FA RecordLayout_3 0 CompuMethod_159 0 255 /end CHARACTERISTIC
/begin CHARACTERISTIC FaultManager.Pcyl1_RangeLow.Action_4 "Fault manager configuration.  Select up to 4 actions for each fault." VALUE 0x800006FB RecordLayout_3 0 CompuMethod_158 0 255 /end CHARACTERISTIC
/begin CHARACTERISTIC FaultManager.Pcyl1_RangeLow.Action_4_Condition "Fault manager configuration.  Select up to 4 actions for each fault." VALUE 0x800006FC RecordLayout_3 0 CompuMethod_159 0 255 /end CHARACTERISTIC
/begin CHARACTERISTIC FaultManager.Pcyl2_RangeHigh.Mode "Fault manager configuration.  Select up to 4 actions for each fault." VALUE 0x800006FD RecordLayout_3 0 CompuMethod_156 0 255 /end CHARACTERISTIC
/begin CHARACTERISTIC FaultManager.Pcyl2_RangeHigh.ID "Fault manager configuration.  Select up to 4 actions for each fault." VALUE 0x800006FE RecordLayout_3 0 CompuMethod_1 0 255 /end CHARACTERISTIC
/begin CHARACTERISTIC FaultManager.Pcyl2_RangeHigh.Test "Fault manager configuration.  Select up to 4 actions for each fault." VALUE 0x800006FF RecordLayout_3 0 CompuMethod_157 0 255 /end CHARACTERISTIC
/begin CHARACTERISTIC FaultManager.Pcyl2_RangeHigh.Faulty_Samples__X_ "Fault manager configuration.  Select up to 4 actions for each fault." VALUE 0x80000700 RecordLayout_3 0 CompuMethod_1 0 255 /end CHARACTERISTIC
/begin CHARACTERISTIC FaultManager.Pcyl2_RangeHigh.Total_Samples__Y_ "Fault manager configuration.  Select up to 4 actions for each fault." VALUE 0x80000701 RecordLayout_3 0 CompuMethod_1 0 255 /end CHARACTERISTIC
/begin CHARACTERISTIC FaultManager.Pcyl2_RangeHigh.Action_1 "Fault manager configuration.  Select up to 4 actions for each fault." VALUE 0x80000702 RecordLayout_3 0 CompuMethod_158 0 255 /end CHARACTERISTIC
/begin CHARACTERISTIC FaultManager.Pcyl2_RangeHigh.Action_1_Condition "Fault manager configuration.  Select up to 4 actions for each fault." VALUE 0x80000703 RecordLayout_3 0 CompuMethod_159 0 255 /end CHARACTERISTIC
/begin CHARACTERISTIC FaultManager.Pcyl2_RangeHigh.Action_2 "Fault manager configuration.  Select up to 4 actions for each fault." VALUE 0x80000704 RecordLayout_3 0 CompuMethod_158 0 255 /end CHARACTERISTIC
/begin CHARACTERISTIC FaultManager.Pcyl2_RangeHigh.Action_2_Condition "Fault manager configuration.  Select up to 4 actions for each fault." VALUE 0x80000705 RecordLayout_3 0 CompuMethod_159 0 255 /end CHARACTERISTIC
/begin CHARACTERISTIC FaultManager.Pcyl2_RangeHigh.Action_3 "Fault manager configuration.  Select up to 4 actions for each fault." VALUE 0x80000706 RecordLayout_3 0 CompuMethod_158 0 255 /end CHARACTERISTIC
/begin CHARACTERISTIC FaultManager.Pcyl2_RangeHigh.Action_3_Condition "Fault manager configuration.  Select up to 4 actions for each fault." VALUE 0x80000707 RecordLayout_3 0 CompuMethod_159 0 255 /end CHARACTERISTIC
/begin CHARACTERISTIC FaultManager.Pcyl2_RangeHigh.Action_4 "Fault manager configuration.  Select up to 4 actions for each fault." VALUE 0x80000708 RecordLayout_3 0 CompuMethod_158 0 255 /end CHARACTERISTIC
/begin CHARACTERISTIC FaultManager.Pcyl2_RangeHigh.Action_4_Condition "Fault manager configuration.  Select up to 4 actions for each fault." VALUE 0x80000709 RecordLayout_3 0 CompuMethod_159 0 255 /end CHARACTERISTIC
/begin CHARACTERISTIC FaultManager.Pcyl2_RangeLow.Mode "Fault manager configuration.  Select up to 4 actions for each fault." VALUE 0x8000070A RecordLayout_3 0 CompuMethod_156 0 255 /end CHARACTERISTIC
/begin CHARACTERISTIC FaultManager.Pcyl2_RangeLow.ID "Fault manager configuration.  Select up to 4 actions for each fault." VALUE 0x8000070B RecordLayout_3 0 CompuMethod_1 0 255 /end CHARACTERISTIC
/begin CHARACTERISTIC FaultManager.Pcyl2_RangeLow.Test "Fault manager configuration.  Select up to 4 actions for each fault." VALUE 0x8000070C RecordLayout_3 0 CompuMethod_157 0 255 /end CHARACTERISTIC
/begin CHARACTERISTIC FaultManager.Pcyl2_RangeLow.Faulty_Samples__X_ "Fault manager configuration.  Select up to 4 actions for each fault." VALUE 0x8000070D RecordLayout_3 0 CompuMethod_1 0 255 /end CHARACTERISTIC
/begin CHARACTERISTIC FaultManager.Pcyl2_RangeLow.Total_Samples__Y_ "Fault manager configuration.  Select up to 4 actions for each fault." VALUE 0x8000070E RecordLayout_3 0 CompuMethod_1 0 255 /end CHARACTERISTIC
/begin CHARACTERISTIC FaultManager.Pcyl2_RangeLow.Action_1 "Fault manager configuration.  Select up to 4 actions for each fault." VALUE 0x8000070F RecordLayout_3 0 CompuMethod_158 0 255 /end CHARACTERISTIC
/begin CHARACTERISTIC FaultManager.Pcyl2_RangeLow.Action_1_Condition "Fault manager configuration.  Select up to 4 actions for each fault." VALUE 0x80000710 RecordLayout_3 0 CompuMethod_159 0 255 /end CHARACTERISTIC
/begin CHARACTERISTIC FaultManager.Pcyl2_RangeLow.Action_2 "Fault manager configuration.  Select up to 4 actions for each fault." VALUE 0x80000711 RecordLayout_3 0 CompuMethod_158 0 255 /end CHARACTERISTIC
/begin CHARACTERISTIC FaultManager.Pcyl2_RangeLow.Action_2_Condition "Fault manager configuration.  Select up to 4 actions for each fault." VALUE 0x80000712 RecordLayout_3 0 CompuMethod_159 0 255 /end CHARACTERISTIC
/begin CHARACTERISTIC FaultManager.Pcyl2_RangeLow.Action_3 "Fault manager configuration.  Select up to 4 actions for each fault." VALUE 0x80000713 RecordLayout_3 0 CompuMethod_158 0 255 /end CHARACTERISTIC
/begin CHARACTERISTIC FaultManager.Pcyl2_RangeLow.Action_3_Condition "Fault manager configuration.  Select up to 4 actions for each fault." VALUE 0x80000714 RecordLayout_3 0 CompuMethod_159 0 255 /end CHARACTERISTIC
/begin CHARACTERISTIC FaultManager.Pcyl2_RangeLow.Action_4 "Fault manager configuration.  Select up to 4 actions for each fault." VALUE 0x80000715 RecordLayout_3 0 CompuMethod_158 0 255 /end CHARACTERISTIC
/begin CHARACTERISTIC FaultManager.Pcyl2_RangeLow.Action_4_Condition "Fault manager configuration.  Select up to 4 actions for each fault." VALUE 0x80000716 RecordLayout_3 0 CompuMethod_159 0 255 /end CHARACTERISTIC
/begin CHARACTERISTIC FaultManager.Pcyl3_RangeHigh.Mode "Fault manager configuration.  Select up to 4 actions for each fault." VALUE 0x80000717 RecordLayout_3 0 CompuMethod_156 0 255 /end CHARACTERISTIC
/begin CHARACTERISTIC FaultManager.Pcyl3_RangeHigh.ID "Fault manager configuration.  Select up to 4 actions for each fault." VALUE 0x80000718 RecordLayout_3 0 CompuMethod_1 0 255 /end CHARACTERISTIC
/begin CHARACTERISTIC FaultManager.Pcyl3_RangeHigh.Test "Fault manager configuration.  Select up to 4 actions for each fault." VALUE 0x80000719 RecordLayout_3 0 CompuMethod_157 0 255 /end CHARACTERISTIC
/begin CHARACTERISTIC FaultManager.Pcyl3_RangeHigh.Faulty_Samples__X_ "Fault manager configuration.  Select up to 4 actions for each fault." VALUE 0x8000071A RecordLayout_3 0 CompuMethod_1 0 255 /end CHARACTERISTIC
/begin CHARACTERISTIC FaultManager.Pcyl3_RangeHigh.Total_Samples__Y_ "Fault manager configuration.  Select up to 4 actions for each fault." VALUE 0x8000071B RecordLayout_3 0 CompuMethod_1 0 255 /end CHARACTERISTIC
/begin CHARACTERISTIC FaultManager.Pcyl3_RangeHigh.Action_1 "Fault manager configuration.  Select up to 4 actions for each fault." VALUE 0x8000071C RecordLayout_3 0 CompuMethod_158 0 255 /end CHARACTERISTIC
/begin CHARACTERISTIC FaultManager.Pcyl3_RangeHigh.Action_1_Condition "Fault manager configuration.  Select up to 4 actions for each fault." VALUE 0x8000071D RecordLayout_3 0 CompuMethod_159 0 255 /end CHARACTERISTIC
/begin CHARACTERISTIC FaultManager.Pcyl3_RangeHigh.Action_2 "Fault manager configuration.  Select up to 4 actions for each fault." VALUE 0x8000071E RecordLayout_3 0 CompuMethod_158 0 255 /end CHARACTERISTIC
/begin CHARACTERISTIC FaultManager.Pcyl3_RangeHigh.Action_2_Condition "Fault manager configuration.  Select up to 4 actions for each fault." VALUE 0x8000071F RecordLayout_3 0 CompuMethod_159 0 255 /end CHARACTERISTIC
/begin CHARACTERISTIC FaultManager.Pcyl3_RangeHigh.Action_3 "Fault manager configuration.  Select up to 4 actions for each fault." VALUE 0x80000720 RecordLayout_3 0 CompuMethod_158 0 255 /end CHARACTERISTIC
/begin CHARACTERISTIC FaultManager.Pcyl3_RangeHigh.Action_3_Condition "Fault manager configuration.  Select up to 4 actions for each fault." VALUE 0x80000721 RecordLayout_3 0 CompuMethod_159 0 255 /end CHARACTERISTIC
/begin CHARACTERISTIC FaultManager.Pcyl3_RangeHigh.Action_4 "Fault manager configuration.  Select up to 4 actions for each fault." VALUE 0x80000722 RecordLayout_3 0 CompuMethod_158 0 255 /end CHARACTERISTIC
/begin CHARACTERISTIC FaultManager.Pcyl3_RangeHigh.Action_4_Condition "Fault manager configuration.  Select up to 4 actions for each fault." VALUE 0x80000723 RecordLayout_3 0 CompuMethod_159 0 255 /end CHARACTERISTIC
/begin CHARACTERISTIC FaultManager.Pcyl3_RangeLow.Mode "Fault manager configuration.  Select up to 4 actions for each fault." VALUE 0x80000724 RecordLayout_3 0 CompuMethod_156 0 255 /end CHARACTERISTIC
/begin CHARACTERISTIC FaultManager.Pcyl3_RangeLow.ID "Fault manager configuration.  Select up to 4 actions for each fault." VALUE 0x80000725 RecordLayout_3 0 CompuMethod_1 0 255 /end CHARACTERISTIC
/begin CHARACTERISTIC FaultManager.Pcyl3_RangeLow.Test "Fault manager configuration.  Select up to 4 actions for each fault." VALUE 0x80000726 RecordLayout_3 0 CompuMethod_157 0 255 /end CHARACTERISTIC
/begin CHARACTERISTIC FaultManager.Pcyl3_RangeLow.Faulty_Samples__X_ "Fault manager configuration.  Select up to 4 actions for each fault." VALUE 0x80000727 RecordLayout_3 0 CompuMethod_1 0 255 /end CHARACTERISTIC
/begin CHARACTERISTIC FaultManager.Pcyl3_RangeLow.Total_Samples__Y_ "Fault manager configuration.  Select up to 4 actions for each fault." VALUE 0x80000728 RecordLayout_3 0 CompuMethod_1 0 255 /end CHARACTERISTIC
/begin CHARACTERISTIC FaultManager.Pcyl3_RangeLow.Action_1 "Fault manager configuration.  Select up to 4 actions for each fault." VALUE 0x80000729 RecordLayout_3 0 CompuMethod_158 0 255 /end CHARACTERISTIC
/begin CHARACTERISTIC FaultManager.Pcyl3_RangeLow.Action_1_Condition "Fault manager configuration.  Select up to 4 actions for each fault." VALUE 0x8000072A RecordLayout_3 0 CompuMethod_159 0 255 /end CHARACTERISTIC
/begin CHARACTERISTIC FaultManager.Pcyl3_RangeLow.Action_2 "Fault manager configuration.  Select up to 4 actions for each fault." VALUE 0x8000072B RecordLayout_3 0 CompuMethod_158 0 255 /end CHARACTERISTIC
/begin CHARACTERISTIC FaultManager.Pcyl3_RangeLow.Action_2_Condition "Fault manager configuration.  Select up to 4 actions for each fault." VALUE 0x8000072C RecordLayout_3 0 CompuMethod_159 0 255 /end CHARACTERISTIC
/begin CHARACTERISTIC FaultManager.Pcyl3_RangeLow.Action_3 "Fault manager configuration.  Select up to 4 actions for each fault." VALUE 0x8000072D RecordLayout_3 0 CompuMethod_158 0 255 /end CHARACTERISTIC
/begin CHARACTERISTIC FaultManager.Pcyl3_RangeLow.Action_3_Condition "Fault manager configuration.  Select up to 4 actions for each fault." VALUE 0x8000072E RecordLayout_3 0 CompuMethod_159 0 255 /end CHARACTERISTIC
/begin CHARACTERISTIC FaultManager.Pcyl3_RangeLow.Action_4 "Fault manager configuration.  Select up to 4 actions for each fault." VALUE 0x8000072F RecordLayout_3 0 CompuMethod_158 0 255 /end CHARACTERISTIC
/begin CHARACTERISTIC FaultManager.Pcyl3_RangeLow.Action_4_Condition "Fault manager configuration.  Select up to 4 actions for each fault." VALUE 0x80000730 RecordLayout_3 0 CompuMethod_159 0 255 /end CHARACTERISTIC
/begin CHARACTERISTIC FaultManager.Pcyl4_RangeHigh.Mode "Fault manager configuration.  Select up to 4 actions for each fault." VALUE 0x80000731 RecordLayout_3 0 CompuMethod_156 0 255 /end CHARACTERISTIC
/begin CHARACTERISTIC FaultManager.Pcyl4_RangeHigh.ID "Fault manager configuration.  Select up to 4 actions for each fault." VALUE 0x80000732 RecordLayout_3 0 CompuMethod_1 0 255 /end CHARACTERISTIC
/begin CHARACTERISTIC FaultManager.Pcyl4_RangeHigh.Test "Fault manager configuration.  Select up to 4 actions for each fault." VALUE 0x80000733 RecordLayout_3 0 CompuMethod_157 0 255 /end CHARACTERISTIC
/begin CHARACTERISTIC FaultManager.Pcyl4_RangeHigh.Faulty_Samples__X_ "Fault manager configuration.  Select up to 4 actions for each fault." VALUE 0x80000734 RecordLayout_3 0 CompuMethod_1 0 255 /end CHARACTERISTIC
/begin CHARACTERISTIC FaultManager.Pcyl4_RangeHigh.Total_Samples__Y_ "Fault manager configuration.  Select up to 4 actions for each fault." VALUE 0x80000735 RecordLayout_3 0 CompuMethod_1 0 255 /end CHARACTERISTIC
/begin CHARACTERISTIC FaultManager.Pcyl4_RangeHigh.Action_1 "Fault manager configuration.  Select up to 4 actions for each fault." VALUE 0x80000736 RecordLayout_3 0 CompuMethod_158 0 255 /end CHARACTERISTIC
/begin CHARACTERISTIC FaultManager.Pcyl4_RangeHigh.Action_1_Condition "Fault manager configuration.  Select up to 4 actions for each fault." VALUE 0x80000737 RecordLayout_3 0 CompuMethod_159 0 255 /end CHARACTERISTIC
/begin CHARACTERISTIC FaultManager.Pcyl4_RangeHigh.Action_2 "Fault manager configuration.  Select up to 4 actions for each fault." VALUE 0x80000738 RecordLayout_3 0 CompuMethod_158 0 255 /end CHARACTERISTIC
/begin CHARACTERISTIC FaultManager.Pcyl4_RangeHigh.Action_2_Condition "Fault manager configuration.  Select up to 4 actions for each fault." VALUE 0x80000739 RecordLayout_3 0 CompuMethod_159 0 255 /end CHARACTERISTIC
/begin CHARACTERISTIC FaultManager.Pcyl4_RangeHigh.Action_3 "Fault manager configuration.  Select up to 4 actions for each fault." VALUE 0x8000073A RecordLayout_3 0 CompuMethod_158 0 255 /end CHARACTERISTIC
/begin CHARACTERISTIC FaultManager.Pcyl4_RangeHigh.Action_3_Condition "Fault manager configuration.  Select up to 4 actions for each fault." VALUE 0x8000073B RecordLayout_3 0 CompuMethod_159 0 255 /end CHARACTERISTIC
/begin CHARACTERISTIC FaultManager.Pcyl4_RangeHigh.Action_4 "Fault manager configuration.  Select up to 4 actions for each fault." VALUE 0x8000073C RecordLayout_3 0 CompuMethod_158 0 255 /end CHARACTERISTIC
/begin CHARACTERISTIC FaultManager.Pcyl4_RangeHigh.Action_4_Condition "Fault manager configuration.  Select up to 4 actions for each fault." VALUE 0x8000073D RecordLayout_3 0 CompuMethod_159 0 255 /end CHARACTERISTIC
/begin CHARACTERISTIC FaultManager.Pcyl4_RangeLow.Mode "Fault manager configuration.  Select up to 4 actions for each fault." VALUE 0x8000073E RecordLayout_3 0 CompuMethod_156 0 255 /end CHARACTERISTIC
/begin CHARACTERISTIC FaultManager.Pcyl4_RangeLow.ID "Fault manager configuration.  Select up to 4 actions for each fault." VALUE 0x8000073F RecordLayout_3 0 CompuMethod_1 0 255 /end CHARACTERISTIC
/begin CHARACTERISTIC FaultManager.Pcyl4_RangeLow.Test "Fault manager configuration.  Select up to 4 actions for each fault." VALUE 0x80000740 RecordLayout_3 0 CompuMethod_157 0 255 /end CHARACTERISTIC
/begin CHARACTERISTIC FaultManager.Pcyl4_RangeLow.Faulty_Samples__X_ "Fault manager configuration.  Select up to 4 actions for each fault." VALUE 0x80000741 RecordLayout_3 0 CompuMethod_1 0 255 /end CHARACTERISTIC
/begin CHARACTERISTIC FaultManager.Pcyl4_RangeLow.Total_Samples__Y_ "Fault manager configuration.  Select up to 4 actions for each fault." VALUE 0x80000742 RecordLayout_3 0 CompuMethod_1 0 255 /end CHARACTERISTIC
/begin CHARACTERISTIC FaultManager.Pcyl4_RangeLow.Action_1 "Fault manager configuration.  Select up to 4 actions for each fault." VALUE 0x80000743 RecordLayout_3 0 CompuMethod_158 0 255 /end CHARACTERISTIC
/begin CHARACTERISTIC FaultManager.Pcyl4_RangeLow.Action_1_Condition "Fault manager configuration.  Select up to 4 actions for each fault." VALUE 0x80000744 RecordLayout_3 0 CompuMethod_159 0 255 /end CHARACTERISTIC
/begin CHARACTERISTIC FaultManager.Pcyl4_RangeLow.Action_2 "Fault manager configuration.  Select up to 4 actions for each fault." VALUE 0x80000745 RecordLayout_3 0 CompuMethod_158 0 255 /end CHARACTERISTIC
/begin CHARACTERISTIC FaultManager.Pcyl4_RangeLow.Action_2_Condition "Fault manager configuration.  Select up to 4 actions for each fault." VALUE 0x80000746 RecordLayout_3 0 CompuMethod_159 0 255 /end CHARACTERISTIC
/begin CHARACTERISTIC FaultManager.Pcyl4_RangeLow.Action_3 "Fault manager configuration.  Select up to 4 actions for each fault." VALUE 0x80000747 RecordLayout_3 0 CompuMethod_158 0 255 /end CHARACTERISTIC
/begin CHARACTERISTIC FaultManager.Pcyl4_RangeLow.Action_3_Condition "Fault manager configuration.  Select up to 4 actions for each fault." VALUE 0x80000748 RecordLayout_3 0 CompuMethod_159 0 255 /end CHARACTERISTIC
/begin CHARACTERISTIC FaultManager.Pcyl4_RangeLow.Action_4 "Fault manager configuration.  Select up to 4 actions for each fault." VALUE 0x80000749 RecordLayout_3 0 CompuMethod_158 0 255 /end CHARACTERISTIC
/begin CHARACTERISTIC FaultManager.Pcyl4_RangeLow.Action_4_Condition "Fault manager configuration.  Select up to 4 actions for each fault." VALUE 0x8000074A RecordLayout_3 0 CompuMethod_159 0 255 /end CHARACTERISTIC
/begin CHARACTERISTIC FaultManager.Pcyl5_RangeHigh.Mode "Fault manager configuration.  Select up to 4 actions for each fault." VALUE 0x8000074B RecordLayout_3 0 CompuMethod_156 0 255 /end CHARACTERISTIC
/begin CHARACTERISTIC FaultManager.Pcyl5_RangeHigh.ID "Fault manager configuration.  Select up to 4 actions for each fault." VALUE 0x8000074C RecordLayout_3 0 CompuMethod_1 0 255 /end CHARACTERISTIC
/begin CHARACTERISTIC FaultManager.Pcyl5_RangeHigh.Test "Fault manager configuration.  Select up to 4 actions for each fault." VALUE 0x8000074D RecordLayout_3 0 CompuMethod_157 0 255 /end CHARACTERISTIC
/begin CHARACTERISTIC FaultManager.Pcyl5_RangeHigh.Faulty_Samples__X_ "Fault manager configuration.  Select up to 4 actions for each fault." VALUE 0x8000074E RecordLayout_3 0 CompuMethod_1 0 255 /end CHARACTERISTIC
/begin CHARACTERISTIC FaultManager.Pcyl5_RangeHigh.Total_Samples__Y_ "Fault manager configuration.  Select up to 4 actions for each fault." VALUE 0x8000074F RecordLayout_3 0 CompuMethod_1 0 255 /end CHARACTERISTIC
/begin CHARACTERISTIC FaultManager.Pcyl5_RangeHigh.Action_1 "Fault manager configuration.  Select up to 4 actions for each fault." VALUE 0x80000750 RecordLayout_3 0 CompuMethod_158 0 255 /end CHARACTERISTIC
/begin CHARACTERISTIC FaultManager.Pcyl5_RangeHigh.Action_1_Condition "Fault manager configuration.  Select up to 4 actions for each fault." VALUE 0x80000751 RecordLayout_3 0 CompuMethod_159 0 255 /end CHARACTERISTIC
/begin CHARACTERISTIC FaultManager.Pcyl5_RangeHigh.Action_2 "Fault manager configuration.  Select up to 4 actions for each fault." VALUE 0x80000752 RecordLayout_3 0 CompuMethod_158 0 255 /end CHARACTERISTIC
/begin CHARACTERISTIC FaultManager.Pcyl5_RangeHigh.Action_2_Condition "Fault manager configuration.  Select up to 4 actions for each fault." VALUE 0x80000753 RecordLayout_3 0 CompuMethod_159 0 255 /end CHARACTERISTIC
/begin CHARACTERISTIC FaultManager.Pcyl5_RangeHigh.Action_3 "Fault manager configuration.  Select up to 4 actions for each fault." VALUE 0x80000754 RecordLayout_3 0 CompuMethod_158 0 255 /end CHARACTERISTIC
/begin CHARACTERISTIC FaultManager.Pcyl5_RangeHigh.Action_3_Condition "Fault manager configuration.  Select up to 4 actions for each fault." VALUE 0x80000755 RecordLayout_3 0 CompuMethod_159 0 255 /end CHARACTERISTIC
/begin CHARACTERISTIC FaultManager.Pcyl5_RangeHigh.Action_4 "Fault manager configuration.  Select up to 4 actions for each fault." VALUE 0x80000756 RecordLayout_3 0 CompuMethod_158 0 255 /end CHARACTERISTIC
/begin CHARACTERISTIC FaultManager.Pcyl5_RangeHigh.Action_4_Condition "Fault manager configuration.  Select up to 4 actions for each fault." VALUE 0x80000757 RecordLayout_3 0 CompuMethod_159 0 255 /end CHARACTERISTIC
/begin CHARACTERISTIC FaultManager.Pcyl5_RangeLow.Mode "Fault manager configuration.  Select up to 4 actions for each fault." VALUE 0x80000758 RecordLayout_3 0 CompuMethod_156 0 255 /end CHARACTERISTIC
/begin CHARACTERISTIC FaultManager.Pcyl5_RangeLow.ID "Fault manager configuration.  Select up to 4 actions for each fault." VALUE 0x80000759 RecordLayout_3 0 CompuMethod_1 0 255 /end CHARACTERISTIC
/begin CHARACTERISTIC FaultManager.Pcyl5_RangeLow.Test "Fault manager configuration.  Select up to 4 actions for each fault." VALUE 0x8000075A RecordLayout_3 0 CompuMethod_157 0 255 /end CHARACTERISTIC
/begin CHARACTERISTIC FaultManager.Pcyl5_RangeLow.Faulty_Samples__X_ "Fault manager configuration.  Select up to 4 actions for each fault." VALUE 0x8000075B RecordLayout_3 0 CompuMethod_1 0 255 /end CHARACTERISTIC
/begin CHARACTERISTIC FaultManager.Pcyl5_RangeLow.Total_Samples__Y_ "Fault manager configuration.  Select up to 4 actions for each fault." VALUE 0x8000075C RecordLayout_3 0 CompuMethod_1 0 255 /end CHARACTERISTIC
/begin CHARACTERISTIC FaultManager.Pcyl5_RangeLow.Action_1 "Fault manager configuration.  Select up to 4 actions for each fault." VALUE 0x8000075D RecordLayout_3 0 CompuMethod_158 0 255 /end CHARACTERISTIC
/begin CHARACTERISTIC FaultManager.Pcyl5_RangeLow.Action_1_Condition "Fault manager configuration.  Select up to 4 actions for each fault." VALUE 0x8000075E RecordLayout_3 0 CompuMethod_159 0 255 /end CHARACTERISTIC
/begin CHARACTERISTIC FaultManager.Pcyl5_RangeLow.Action_2 "Fault manager configuration.  Select up to 4 actions for each fault." VALUE 0x8000075F RecordLayout_3 0 CompuMethod_158 0 255 /end CHARACTERISTIC
/begin CHARACTERISTIC FaultManager.Pcyl5_RangeLow.Action_2_Condition "Fault manager configuration.  Select up to 4 actions for each fault." VALUE 0x80000760 RecordLayout_3 0 CompuMethod_159 0 255 /end CHARACTERISTIC
/begin CHARACTERISTIC FaultManager.Pcyl5_RangeLow.Action_3 "Fault manager configuration.  Select up to 4 actions for each fault." VALUE 0x80000761 RecordLayout_3 0 CompuMethod_158 0 255 /end CHARACTERISTIC
/begin CHARACTERISTIC FaultManager.Pcyl5_RangeLow.Action_3_Condition "Fault manager configuration.  Select up to 4 actions for each fault." VALUE 0x80000762 RecordLayout_3 0 CompuMethod_159 0 255 /end CHARACTERISTIC
/begin CHARACTERISTIC FaultManager.Pcyl5_RangeLow.Action_4 "Fault manager configuration.  Select up to 4 actions for each fault." VALUE 0x80000763 RecordLayout_3 0 CompuMethod_158 0 255 /end CHARACTERISTIC
/begin CHARACTERISTIC FaultManager.Pcyl5_RangeLow.Action_4_Condition "Fault manager configuration.  Select up to 4 actions for each fault." VALUE 0x80000764 RecordLayout_3 0 CompuMethod_159 0 255 /end CHARACTERISTIC
/begin CHARACTERISTIC FaultManager.Pcyl6_RangeHigh.Mode "Fault manager configuration.  Select up to 4 actions for each fault." VALUE 0x80000765 RecordLayout_3 0 CompuMethod_156 0 255 /end CHARACTERISTIC
/begin CHARACTERISTIC FaultManager.Pcyl6_RangeHigh.ID "Fault manager configuration.  Select up to 4 actions for each fault." VALUE 0x80000766 RecordLayout_3 0 CompuMethod_1 0 255 /end CHARACTERISTIC
/begin CHARACTERISTIC FaultManager.Pcyl6_RangeHigh.Test "Fault manager configuration.  Select up to 4 actions for each fault." VALUE 0x80000767 RecordLayout_3 0 CompuMethod_157 0 255 /end CHARACTERISTIC
/begin CHARACTERISTIC FaultManager.Pcyl6_RangeHigh.Faulty_Samples__X_ "Fault manager configuration.  Select up to 4 actions for each fault." VALUE 0x80000768 RecordLayout_3 0 CompuMethod_1 0 255 /end CHARACTERISTIC
/begin CHARACTERISTIC FaultManager.Pcyl6_RangeHigh.Total_Samples__Y_ "Fault manager configuration.  Select up to 4 actions for each fault." VALUE 0x80000769 RecordLayout_3 0 CompuMethod_1 0 255 /end CHARACTERISTIC
/begin CHARACTERISTIC FaultManager.Pcyl6_RangeHigh.Action_1 "Fault manager configuration.  Select up to 4 actions for each fault." VALUE 0x8000076A RecordLayout_3 0 CompuMethod_158 0 255 /end CHARACTERISTIC
/begin CHARACTERISTIC FaultManager.Pcyl6_RangeHigh.Action_1_Condition "Fault manager configuration.  Select up to 4 actions for each fault." VALUE 0x8000076B RecordLayout_3 0 CompuMethod_159 0 255 /end CHARACTERISTIC
/begin CHARACTERISTIC FaultManager.Pcyl6_RangeHigh.Action_2 "Fault manager configuration.  Select up to 4 actions for each fault." VALUE 0x8000076C RecordLayout_3 0 CompuMethod_158 0 255 /end CHARACTERISTIC
/begin CHARACTERISTIC FaultManager.Pcyl6_RangeHigh.Action_2_Condition "Fault manager configuration.  Select up to 4 actions for each fault." VALUE 0x8000076D RecordLayout_3 0 CompuMethod_159 0 255 /end CHARACTERISTIC
/begin CHARACTERISTIC FaultManager.Pcyl6_RangeHigh.Action_3 "Fault manager configuration.  Select up to 4 actions for each fault." VALUE 0x8000076E RecordLayout_3 0 CompuMethod_158 0 255 /end CHARACTERISTIC
/begin CHARACTERISTIC FaultManager.Pcyl6_RangeHigh.Action_3_Condition "Fault manager configuration.  Select up to 4 actions for each fault." VALUE 0x8000076F RecordLayout_3 0 CompuMethod_159 0 255 /end CHARACTERISTIC
/begin CHARACTERISTIC FaultManager.Pcyl6_RangeHigh.Action_4 "Fault manager configuration.  Select up to 4 actions for each fault." VALUE 0x80000770 RecordLayout_3 0 CompuMethod_158 0 255 /end CHARACTERISTIC
/begin CHARACTERISTIC FaultManager.Pcyl6_RangeHigh.Action_4_Condition "Fault manager configuration.  Select up to 4 actions for each fault." VALUE 0x80000771 RecordLayout_3 0 CompuMethod_159 0 255 /end CHARACTERISTIC
/begin CHARACTERISTIC FaultManager.Pcyl6_RangeLow.Mode "Fault manager configuration.  Select up to 4 actions for each fault." VALUE 0x80000772 RecordLayout_3 0 CompuMethod_156 0 255 /end CHARACTERISTIC
/begin CHARACTERISTIC FaultManager.Pcyl6_RangeLow.ID "Fault manager configuration.  Select up to 4 actions for each fault." VALUE 0x80000773 RecordLayout_3 0 CompuMethod_1 0 255 /end CHARACTERISTIC
/begin CHARACTERISTIC FaultManager.Pcyl6_RangeLow.Test "Fault manager configuration.  Select up to 4 actions for each fault." VALUE 0x80000774 RecordLayout_3 0 CompuMethod_157 0 255 /end CHARACTERISTIC
/begin CHARACTERISTIC FaultManager.Pcyl6_RangeLow.Faulty_Samples__X_ "Fault manager configuration.  Select up to 4 actions for each fault." VALUE 0x80000775 RecordLayout_3 0 CompuMethod_1 0 255 /end CHARACTERISTIC
/begin CHARACTERISTIC FaultManager.Pcyl6_RangeLow.Total_Samples__Y_ "Fault manager configuration.  Select up to 4 actions for each fault." VALUE 0x80000776 RecordLayout_3 0 CompuMethod_1 0 255 /end CHARACTERISTIC
/begin CHARACTERISTIC FaultManager.Pcyl6_RangeLow.Action_1 "Fault manager configuration.  Select up to 4 actions for each fault." VALUE 0x80000777 RecordLayout_3 0 CompuMethod_158 0 255 /end CHARACTERISTIC
/begin CHARACTERISTIC FaultManager.Pcyl6_RangeLow.Action_1_Condition "Fault manager configuration.  Select up to 4 actions for each fault." VALUE 0x80000778 RecordLayout_3 0 CompuMethod_159 0 255 /end CHARACTERISTIC
/begin CHARACTERISTIC FaultManager.Pcyl6_RangeLow.Action_2 "Fault manager configuration.  Select up to 4 actions for each fault." VALUE 0x80000779 RecordLayout_3 0 CompuMethod_158 0 255 /end CHARACTERISTIC
/begin CHARACTERISTIC FaultManager.Pcyl6_RangeLow.Action_2_Condition "Fault manager configuration.  Select up to 4 actions for each fault." VALUE 0x8000077A RecordLayout_3 0 CompuMethod_159 0 255 /end CHARACTERISTIC
/begin CHARACTERISTIC FaultManager.Pcyl6_RangeLow.Action_3 "Fault manager configuration.  Select up to 4 actions for each fault." VALUE 0x8000077B RecordLayout_3 0 CompuMethod_158 0 255 /end CHARACTERISTIC
/begin CHARACTERISTIC FaultManager.Pcyl6_RangeLow.Action_3_Condition "Fault manager configuration.  Select up to 4 actions for each fault." VALUE 0x8000077C RecordLayout_3 0 CompuMethod_159 0 255 /end CHARACTERISTIC
/begin CHARACTERISTIC FaultManager.Pcyl6_RangeLow.Action_4 "Fault manager configuration.  Select up to 4 actions for each fault." VALUE 0x8000077D RecordLayout_3 0 CompuMethod_158 0 255 /end CHARACTERISTIC
/begin CHARACTERISTIC FaultManager.Pcyl6_RangeLow.Action_4_Condition "Fault manager configuration.  Select up to 4 actions for each fault." VALUE 0x8000077E RecordLayout_3 0 CompuMethod_159 0 255 /end CHARACTERISTIC
/begin CHARACTERISTIC FaultManager.Pcyl7_RangeHigh.Mode "Fault manager configuration.  Select up to 4 actions for each fault." VALUE 0x8000077F RecordLayout_3 0 CompuMethod_156 0 255 /end CHARACTERISTIC
/begin CHARACTERISTIC FaultManager.Pcyl7_RangeHigh.ID "Fault manager configuration.  Select up to 4 actions for each fault." VALUE 0x80000780 RecordLayout_3 0 CompuMethod_1 0 255 /end CHARACTERISTIC
/begin CHARACTERISTIC FaultManager.Pcyl7_RangeHigh.Test "Fault manager configuration.  Select up to 4 actions for each fault." VALUE 0x80000781 RecordLayout_3 0 CompuMethod_157 0 255 /end CHARACTERISTIC
/begin CHARACTERISTIC FaultManager.Pcyl7_RangeHigh.Faulty_Samples__X_ "Fault manager configuration.  Select up to 4 actions for each fault." VALUE 0x80000782 RecordLayout_3 0 CompuMethod_1 0 255 /end CHARACTERISTIC
/begin CHARACTERISTIC FaultManager.Pcyl7_RangeHigh.Total_Samples__Y_ "Fault manager configuration.  Select up to 4 actions for each fault." VALUE 0x80000783 RecordLayout_3 0 CompuMethod_1 0 255 /end CHARACTERISTIC
/begin CHARACTERISTIC FaultManager.Pcyl7_RangeHigh.Action_1 "Fault manager configuration.  Select up to 4 actions for each fault." VALUE 0x80000784 RecordLayout_3 0 CompuMethod_158 0 255 /end CHARACTERISTIC
/begin CHARACTERISTIC FaultManager.Pcyl7_RangeHigh.Action_1_Condition "Fault manager configuration.  Select up to 4 actions for each fault." VALUE 0x80000785 RecordLayout_3 0 CompuMethod_159 0 255 /end CHARACTERISTIC
/begin CHARACTERISTIC FaultManager.Pcyl7_RangeHigh.Action_2 "Fault manager configuration.  Select up to 4 actions for each fault." VALUE 0x80000786 RecordLayout_3 0 CompuMethod_158 0 255 /end CHARACTERISTIC
/begin CHARACTERISTIC FaultManager.Pcyl7_RangeHigh.Action_2_Condition "Fault manager configuration.  Select up to 4 actions for each fault." VALUE 0x80000787 RecordLayout_3 0 CompuMethod_159 0 255 /end CHARACTERISTIC
/begin CHARACTERISTIC FaultManager.Pcyl7_RangeHigh.Action_3 "Fault manager configuration.  Select up to 4 actions for each fault." VALUE 0x80000788 RecordLayout_3 0 CompuMethod_158 0 255 /end CHARACTERISTIC
/begin CHARACTERISTIC FaultManager.Pcyl7_RangeHigh.Action_3_Condition "Fault manager configuration.  Select up to 4 actions for each fault." VALUE 0x80000789 RecordLayout_3 0 CompuMethod_159 0 255 /end CHARACTERISTIC
/begin CHARACTERISTIC FaultManager.Pcyl7_RangeHigh.Action_4 "Fault manager configuration.  Select up to 4 actions for each fault." VALUE 0x8000078A RecordLayout_3 0 CompuMethod_158 0 255 /end CHARACTERISTIC
/begin CHARACTERISTIC FaultManager.Pcyl7_RangeHigh.Action_4_Condition "Fault manager configuration.  Select up to 4 actions for each fault." VALUE 0x8000078B RecordLayout_3 0 CompuMethod_159 0 255 /end CHARACTERISTIC
/begin CHARACTERISTIC FaultManager.Pcyl7_RangeLow.Mode "Fault manager configuration.  Select up to 4 actions for each fault." VALUE 0x8000078C RecordLayout_3 0 CompuMethod_156 0 255 /end CHARACTERISTIC
/begin CHARACTERISTIC FaultManager.Pcyl7_RangeLow.ID "Fault manager configuration.  Select up to 4 actions for each fault." VALUE 0x8000078D RecordLayout_3 0 CompuMethod_1 0 255 /end CHARACTERISTIC
/begin CHARACTERISTIC FaultManager.Pcyl7_RangeLow.Test "Fault manager configuration.  Select up to 4 actions for each fault." VALUE 0x8000078E RecordLayout_3 0 CompuMethod_157 0 255 /end CHARACTERISTIC
/begin CHARACTERISTIC FaultManager.Pcyl7_RangeLow.Faulty_Samples__X_ "Fault manager configuration.  Select up to 4 actions for each fault." VALUE 0x8000078F RecordLayout_3 0 CompuMethod_1 0 255 /end CHARACTERISTIC
/begin CHARACTERISTIC FaultManager.Pcyl7_RangeLow.Total_Samples__Y_ "Fault manager configuration.  Select up to 4 actions for each fault." VALUE 0x80000790 RecordLayout_3 0 CompuMethod_1 0 255 /end CHARACTERISTIC
/begin CHARACTERISTIC FaultManager.Pcyl7_RangeLow.Action_1 "Fault manager configuration.  Select up to 4 actions for each fault." VALUE 0x80000791 RecordLayout_3 0 CompuMethod_158 0 255 /end CHARACTERISTIC
/begin CHARACTERISTIC FaultManager.Pcyl7_RangeLow.Action_1_Condition "Fault manager configuration.  Select up to 4 actions for each fault." VALUE 0x80000792 RecordLayout_3 0 CompuMethod_159 0 255 /end CHARACTERISTIC
/begin CHARACTERISTIC FaultManager.Pcyl7_RangeLow.Action_2 "Fault manager configuration.  Select up to 4 actions for each fault." VALUE 0x80000793 RecordLayout_3 0 CompuMethod_158 0 255 /end CHARACTERISTIC
/begin CHARACTERISTIC FaultManager.Pcyl7_RangeLow.Action_2_Condition "Fault manager configuration.  Select up to 4 actions for each fault." VALUE 0x80000794 RecordLayout_3 0 CompuMethod_159 0 255 /end CHARACTERISTIC
/begin CHARACTERISTIC FaultManager.Pcyl7_RangeLow.Action_3 "Fault manager configuration.  Select up to 4 actions for each fault." VALUE 0x80000795 RecordLayout_3 0 CompuMethod_158 0 255 /end CHARACTERISTIC
/begin CHARACTERISTIC FaultManager.Pcyl7_RangeLow.Action_3_Condition "Fault manager configuration.  Select up to 4 actions for each fault." VALUE 0x80000796 RecordLayout_3 0 CompuMethod_159 0 255 /end CHARACTERISTIC
/begin CHARACTERISTIC FaultManager.Pcyl7_RangeLow.Action_4 "Fault manager configuration.  Select up to 4 actions for each fault." VALUE 0x80000797 RecordLayout_3 0 CompuMethod_158 0 255 /end CHARACTERISTIC
/begin CHARACTERISTIC FaultManager.Pcyl7_RangeLow.Action_4_Condition "Fault manager configuration.  Select up to 4 actions for each fault." VALUE 0x80000798 RecordLayout_3 0 CompuMethod_159 0 255 /end CHARACTERISTIC
/begin CHARACTERISTIC FaultManager.Pcyl8_RangeHigh.Mode "Fault manager configuration.  Select up to 4 actions for each fault." VALUE 0x80000799 RecordLayout_3 0 CompuMethod_156 0 255 /end CHARACTERISTIC
/begin CHARACTERISTIC FaultManager.Pcyl8_RangeHigh.ID "Fault manager configuration.  Select up to 4 actions for each fault." VALUE 0x8000079A RecordLayout_3 0 CompuMethod_1 0 255 /end CHARACTERISTIC
/begin CHARACTERISTIC FaultManager.Pcyl8_RangeHigh.Test "Fault manager configuration.  Select up to 4 actions for each fault." VALUE 0x8000079B RecordLayout_3 0 CompuMethod_157 0 255 /end CHARACTERISTIC
/begin CHARACTERISTIC FaultManager.Pcyl8_RangeHigh.Faulty_Samples__X_ "Fault manager configuration.  Select up to 4 actions for each fault." VALUE 0x8000079C RecordLayout_3 0 CompuMethod_1 0 255 /end CHARACTERISTIC
/begin CHARACTERISTIC FaultManager.Pcyl8_RangeHigh.Total_Samples__Y_ "Fault manager configuration.  Select up to 4 actions for each fault." VALUE 0x8000079D RecordLayout_3 0 CompuMethod_1 0 255 /end CHARACTERISTIC
/begin CHARACTERISTIC FaultManager.Pcyl8_RangeHigh.Action_1 "Fault manager configuration.  Select up to 4 actions for each fault." VALUE 0x8000079E RecordLayout_3 0 CompuMethod_158 0 255 /end CHARACTERISTIC
/begin CHARACTERISTIC FaultManager.Pcyl8_RangeHigh.Action_1_Condition "Fault manager configuration.  Select up to 4 actions for each fault." VALUE 0x8000079F RecordLayout_3 0 CompuMethod_159 0 255 /end CHARACTERISTIC
/begin CHARACTERISTIC FaultManager.Pcyl8_RangeHigh.Action_2 "Fault manager configuration.  Select up to 4 actions for each fault." VALUE 0x800007A0 RecordLayout_3 0 CompuMethod_158 0 255 /end CHARACTERISTIC
/begin CHARACTERISTIC FaultManager.Pcyl8_RangeHigh.Action_2_Condition "Fault manager configuration.  Select up to 4 actions for each fault." VALUE 0x800007A1 RecordLayout_3 0 CompuMethod_159 0 255 /end CHARACTERISTIC
/begin CHARACTERISTIC FaultManager.Pcyl8_RangeHigh.Action_3 "Fault manager configuration.  Select up to 4 actions for each fault." VALUE 0x800007A2 RecordLayout_3 0 CompuMethod_158 0 255 /end CHARACTERISTIC
/begin CHARACTERISTIC FaultManager.Pcyl8_RangeHigh.Action_3_Condition "Fault manager configuration.  Select up to 4 actions for each fault." VALUE 0x800007A3 RecordLayout_3 0 CompuMethod_159 0 255 /end CHARACTERISTIC
/begin CHARACTERISTIC FaultManager.Pcyl8_RangeHigh.Action_4 "Fault manager configuration.  Select up to 4 actions for each fault." VALUE 0x800007A4 RecordLayout_3 0 CompuMethod_158 0 255 /end CHARACTERISTIC
/begin CHARACTERISTIC FaultManager.Pcyl8_RangeHigh.Action_4_Condition "Fault manager configuration.  Select up to 4 actions for each fault." VALUE 0x800007A5 RecordLayout_3 0 CompuMethod_159 0 255 /end CHARACTERISTIC
/begin CHARACTERISTIC FaultManager.Pcyl8_RangeLow.Mode "Fault manager configuration.  Select up to 4 actions for each fault." VALUE 0x800007A6 RecordLayout_3 0 CompuMethod_156 0 255 /end CHARACTERISTIC
/begin CHARACTERISTIC FaultManager.Pcyl8_RangeLow.ID "Fault manager configuration.  Select up to 4 actions for each fault." VALUE 0x800007A7 RecordLayout_3 0 CompuMethod_1 0 255 /end CHARACTERISTIC
/begin CHARACTERISTIC FaultManager.Pcyl8_RangeLow.Test "Fault manager configuration.  Select up to 4 actions for each fault." VALUE 0x800007A8 RecordLayout_3 0 CompuMethod_157 0 255 /end CHARACTERISTIC
/begin CHARACTERISTIC FaultManager.Pcyl8_RangeLow.Faulty_Samples__X_ "Fault manager configuration.  Select up to 4 actions for each fault." VALUE 0x800007A9 RecordLayout_3 0 CompuMethod_1 0 255 /end CHARACTERISTIC
/begin CHARACTERISTIC FaultManager.Pcyl8_RangeLow.Total_Samples__Y_ "Fault manager configuration.  Select up to 4 actions for each fault." VALUE 0x800007AA RecordLayout_3 0 CompuMethod_1 0 255 /end CHARACTERISTIC
/begin CHARACTERISTIC FaultManager.Pcyl8_RangeLow.Action_1 "Fault manager configuration.  Select up to 4 actions for each fault." VALUE 0x800007AB RecordLayout_3 0 CompuMethod_158 0 255 /end CHARACTERISTIC
/begin CHARACTERISTIC FaultManager.Pcyl8_RangeLow.Action_1_Condition "Fault manager configuration.  Select up to 4 actions for each fault." VALUE 0x800007AC RecordLayout_3 0 CompuMethod_159 0 255 /end CHARACTERISTIC
/begin CHARACTERISTIC FaultManager.Pcyl8_RangeLow.Action_2 "Fault manager configuration.  Select up to 4 actions for each fault." VALUE 0x800007AD RecordLayout_3 0 CompuMethod_158 0 255 /end CHARACTERISTIC
/begin CHARACTERISTIC FaultManager.Pcyl8_RangeLow.Action_2_Condition "Fault manager configuration.  Select up to 4 actions for each fault." VALUE 0x800007AE RecordLayout_3 0 CompuMethod_159 0 255 /end CHARACTERISTIC
/begin CHARACTERISTIC FaultManager.Pcyl8_RangeLow.Action_3 "Fault manager configuration.  Select up to 4 actions for each fault." VALUE 0x800007AF RecordLayout_3 0 CompuMethod_158 0 255 /end CHARACTERISTIC
/begin CHARACTERISTIC FaultManager.Pcyl8_RangeLow.Action_3_Condition "Fault manager configuration.  Select up to 4 actions for each fault." VALUE 0x800007B0 RecordLayout_3 0 CompuMethod_159 0 255 /end CHARACTERISTIC
/begin CHARACTERISTIC FaultManager.Pcyl8_RangeLow.Action_4 "Fault manager configuration.  Select up to 4 actions for each fault." VALUE 0x800007B1 RecordLayout_3 0 CompuMethod_158 0 255 /end CHARACTERISTIC
/begin CHARACTERISTIC FaultManager.Pcyl8_RangeLow.Action_4_Condition "Fault manager configuration.  Select up to 4 actions for each fault." VALUE 0x800007B2 RecordLayout_3 0 CompuMethod_159 0 255 /end CHARACTERISTIC
/begin RECORD_LAYOUT RecordLayout_3 FNC_VALUES 1 UBYTE ROW_DIR DIRECT /end RECORD_LAYOUT
/*~~~~~~~~~ 6.3.31 COMPU_METHODs ~~~~~~~~~*/
/begin COMPU_METHOD CompuMethod_1 "" RAT_FUNC "%3.0" "" COEFFS 0 1 0 0 0 1 /end COMPU_METHOD
/begin COMPU_METHOD CompuMethod_154 "" TAB_VERB "%3.0" "" COMPU_TAB_REF CompuVtab_120 /end COMPU_METHOD
/begin COMPU_METHOD CompuMethod_155 "" TAB_VERB "%3.0" "" COMPU_TAB_REF CompuVtab_121 /end COMPU_METHOD
/begin COMPU_METHOD CompuMethod_156 "" TAB_VERB "%3.0" "" COMPU_TAB_REF CompuVtab_122 /end COMPU_METHOD
/begin COMPU_METHOD CompuMethod_157 "" TAB_VERB "%3.0" "" COMPU_TAB_REF CompuVtab_123 /end COMPU_METHOD
/begin COMPU_METHOD CompuMethod_158 "" TAB_VERB "%3.0" "" COMPU_TAB_REF CompuVtab_124 /end COMPU_METHOD
/begin COMPU_METHOD CompuMethod_159 "" TAB_VERB "%3.0" "" COMPU_TAB_REF CompuVtab_125 /end COMPU_METHOD
/begin COMPU_VTAB CompuVtab_120 "" TAB_VERB 61 0 "APP_RangeHigh" 1 "APP_RangeLow" 2 "Airflow2_RangeHigh" 3 "Airflow2_RangeLow" 4 "Airflow3_RangeHigh" 5 "Airflow3_RangeLow" 6 "Airflow_RangeHigh" 7 "Airflow_RangeLow" 8 "CCVS_Stale" 9 "COOLT_RangeHigh" 10 "COOLT_RangeLow" 11 "CoolP_RangeHigh" 12 "CoolP_RangeLow" 13 "DRVP_RangeHigh" 14 "DRVP_RangeLow" 15 "ECUP_RangeHigh" 16 "ECUP_RangeLow" 17 "ETCPosA_RangeHigh" 18 "ETCPosA_RangeLow" 19 "ETCPosB_RangeHigh" 20 "ETCPosB_RangeLow" 21 "ExT1_RangeHigh" 22 "ExT1_RangeLow" 23 "ExT2_RangeHigh" 24 "ExT2_RangeLow" 25 "FUELT_RangeHigh" 26 "FUELT_RangeLow" 27 "FuelP_RangeHigh" 28 "FuelP_RangeLow" 29 "IMP_RangeHigh" 30 "IMP_RangeLow" 31 "IMT_RangeHigh" 32 "IMT_RangeLow" 33 "Idle_CPU" 34 "O2A_RangeHigh" 35 "O2A_RangeLow" 36 "O2B_RangeHigh" 37 "O2B_RangeLow" 38 "O2C_RangeHigh" 39 "O2C_RangeLow" 40 "O2D_RangeHigh" 41 "O2D_RangeLow" 42 "OilP_RangeHigh" 43 "OilP_RangeLow" 44 "Pcyl1_RangeHigh" 45 "Pcyl1_RangeLow" 46 "Pcyl2_RangeHigh" 47 "Pcyl2_RangeLow" 48 "Pcyl3_RangeHigh" 49 "Pcyl3_RangeLow" 50 "Pcyl4_RangeHigh" 51 "Pcyl4_RangeLow" 52 "Pcyl5_RangeHigh" 53 "Pcyl5_RangeLow" 54 "Pcyl6_RangeHigh" 55 "Pcyl6_RangeLow" 56 "Pcyl7_RangeHigh" 57 "Pcyl7_RangeLow" 58 "Pcyl8_RangeHigh" 59 "Pcyl8_RangeLow" 60 "(None)" /end COMPU_VTAB
/begin COMPU_VTAB CompuVtab_121 "" TAB_VERB 2 0 "-" 1 "Clear All Faults" /end COMPU_VTAB
/begin COMPU_VTAB CompuVtab_122 "" TAB_VERB 6 0 "Disabled" 1 "Enabled" 2 "Sticky" 3 "Enabled - Persistent" 4 "Sticky - Persistent" 5 "Save Occurred" /end COMPU_VTAB
/begin COMPU_VTAB CompuVtab_123 "" TAB_VERB 2 0 "-" 1 "Test" /end COMPU_VTAB
/begin COMPU_VTAB CompuVtab_124 "" TAB_VERB 6 0 "DisableFuel" 1 "DisableIAC" 2 "DisableSpark" 3 "DisableThrottle" 4 "IlluminateMIL" 5 "(None)" /end COMPU_VTAB
/begin COMPU_VTAB CompuVtab_125 "" TAB_VERB 8 0 "(None)" 1 "Suspected" 2 "Active" 3 "Suspected or Active" 4 "Occurred" 5 "Suspected or Occurred" 6 "Active or Occurred" 7 "Suspected or Active or Occurred" /end COMPU_VTAB
/begin FUNCTION Faults ""
 /begin DEF_CHARACTERISTIC FaultCommand FaultManager.APP_RangeHigh.Mode FaultManager.APP_RangeHigh.ID FaultManager.APP_RangeHigh.Test FaultManager.APP_RangeHigh.Faulty_Samples__X_ FaultManager.APP_RangeHigh.Total_Samples__Y_ FaultManager.APP_RangeHigh.Action_1 FaultManager.APP_RangeHigh.Action_1_Condition FaultManager.APP_RangeHigh.Action_2 FaultManager.APP_RangeHigh.Action_2_Condition FaultManager.APP_RangeHigh.Action_3 FaultManager.APP_RangeHigh.Action_3_Condition FaultManager.APP_RangeHigh.Action_4 FaultManager.APP_RangeHigh.Action_4_Condition FaultManager.APP_RangeLow.Mode FaultManager.APP_RangeLow.ID FaultManager.APP_RangeLow.Test FaultManager.APP_RangeLow.Faulty_Samples__X_ FaultManager.APP_RangeLow.Total_Samples__Y_ FaultManager.APP_RangeLow.Action_1 FaultManager.APP_RangeLow.Action_1_Condition FaultManager.APP_RangeLow.Action_2 FaultManager.APP_RangeLow.Action_2_Condition FaultManager.APP_RangeLow.Action_3 FaultManager.APP_RangeLow.Action_3_Condition FaultManager.APP_RangeLow.Action_4 FaultManager.APP_RangeLow.Action_4_Condition FaultManager.Airflow2_RangeHigh.Mode FaultManager.Airflow2_RangeHigh.ID FaultManager.Airflow2_RangeHigh.Test FaultManager.Airflow2_RangeHigh.Faulty_Samples__X_ FaultManager.Airflow2_RangeHigh.Total_Samples__Y_ FaultManager.Airflow2_RangeHigh.Action_1 FaultManager.Airflow2_RangeHigh.Action_1_Condition FaultManager.Airflow2_RangeHigh.Action_2 FaultManager.Airflow2_RangeHigh.Action_2_Condition FaultManager.Airflow2_RangeHigh.Action_3 FaultManager.Airflow2_RangeHigh.Action_3_Condition FaultManager.Airflow2_RangeHigh.Action_4 FaultManager.Airflow2_RangeHigh.Action_4_Condition FaultManager.Airflow2_RangeLow.Mode FaultManager.Airflow2_RangeLow.ID FaultManager.Airflow2_RangeLow.Test FaultManager.Airflow2_RangeLow.Faulty_Samples__X_ FaultManager.Airflow2_RangeLow.Total_Samples__Y_ FaultManager.Airflow2_RangeLow.Action_1 FaultManager.Airflow2_RangeLow.Action_1_Condition FaultManager.Airflow2_RangeLow.Action_2 FaultManager.Airflow2_RangeLow.Action_2_Condition FaultManager.Airflow2_RangeLow.Action_3 FaultManager.Airflow2_RangeLow.Action_3_Condition FaultManager.Airflow2_RangeLow.Action_4 FaultManager.Airflow2_RangeLow.Action_4_Condition FaultManager.Airflow3_RangeHigh.Mode FaultManager.Airflow3_RangeHigh.ID FaultManager.Airflow3_RangeHigh.Test FaultManager.Airflow3_RangeHigh.Faulty_Samples__X_ FaultManager.Airflow3_RangeHigh.Total_Samples__Y_ FaultManager.Airflow3_RangeHigh.Action_1 FaultManager.Airflow3_RangeHigh.Action_1_Condition FaultManager.Airflow3_RangeHigh.Action_2 FaultManager.Airflow3_RangeHigh.Action_2_Condition FaultManager.Airflow3_RangeHigh.Action_3 FaultManager.Airflow3_RangeHigh.Action_3_Condition FaultManager.Airflow3_RangeHigh.Action_4 FaultManager.Airflow3_RangeHigh.Action_4_Condition FaultManager.Airflow3_RangeLow.Mode FaultManager.Airflow3_RangeLow.ID FaultManager.Airflow3_RangeLow.Test FaultManager.Airflow3_RangeLow.Faulty_Samples__X_ FaultManager.Airflow3_RangeLow.Total_Samples__Y_ FaultManager.Airflow3_RangeLow.Action_1 FaultManager.Airflow3_RangeLow.Action_1_Condition FaultManager.Airflow3_RangeLow.Action_2 FaultManager.Airflow3_RangeLow.Action_2_Condition FaultManager.Airflow3_RangeLow.Action_3 FaultManager.Airflow3_RangeLow.Action_3_Condition FaultManager.Airflow3_RangeLow.Action_4 FaultManager.Airflow3_RangeLow.Action_4_Condition FaultManager.Airflow_RangeHigh.Mode FaultManager.Airflow_RangeHigh.ID FaultManager.Airflow_RangeHigh.Test FaultManager.Airflow_RangeHigh.Faulty_Samples__X_ FaultManager.Airflow_RangeHigh.Total_Samples__Y_ FaultManager.Airflow_RangeHigh.Action_1 FaultManager.Airflow_RangeHigh.Action_1_Condition FaultManager.Airflow_RangeHigh.Action_2 FaultManager.Airflow_RangeHigh.Action_2_Condition FaultManager.Airflow_RangeHigh.Action_3 FaultManager.Airflow_RangeHigh.Action_3_Condition FaultManager.Airflow_RangeHigh.Action_4 FaultManager.Airflow_RangeHigh.Action_4_Condition FaultManager.Airflow_RangeLow.Mode FaultManager.Airflow_RangeLow.ID FaultManager.Airflow_RangeLow.Test FaultManager.Airflow_RangeLow.Faulty_Samples__X_ FaultManager.Airflow_RangeLow.Total_Samples__Y_ FaultManager.Airflow_RangeLow.Action_1 FaultManager.Airflow_RangeLow.Action_1_Condition FaultManager.Airflow_RangeLow.Action_2 FaultManager.Airflow_RangeLow.Action_2_Condition FaultManager.Airflow_RangeLow.Action_3 FaultManager.Airflow_RangeLow.Action_3_Condition FaultManager.Airflow_RangeLow.Action_4 FaultManager.Airflow_RangeLow.Action_4_Condition FaultManager.CCVS_Stale.Mode FaultManager.CCVS_Stale.ID FaultManager.CCVS_Stale.Test FaultManager.CCVS_Stale.Faulty_Samples__X_ FaultManager.CCVS_Stale.Total_Samples__Y_ FaultManager.CCVS_Stale.Action_1 FaultManager.CCVS_Stale.Action_1_Condition FaultManager.CCVS_Stale.Action_2 FaultManager.CCVS_Stale.Action_2_Condition FaultManager.CCVS_Stale.Action_3 FaultManager.CCVS_Stale.Action_3_Condition FaultManager.CCVS_Stale.Action_4 FaultManager.CCVS_Stale.Action_4_Condition FaultManager.COOLT_RangeHigh.Mode FaultManager.COOLT_RangeHigh.ID FaultManager.COOLT_RangeHigh.Test FaultManager.COOLT_RangeHigh.Faulty_Samples__X_ FaultManager.COOLT_RangeHigh.Total_Samples__Y_ FaultManager.COOLT_RangeHigh.Action_1 FaultManager.COOLT_RangeHigh.Action_1_Condition FaultManager.COOLT_RangeHigh.Action_2 FaultManager.COOLT_RangeHigh.Action_2_Condition FaultManager.COOLT_RangeHigh.Action_3 FaultManager.COOLT_RangeHigh.Action_3_Condition FaultManager.COOLT_RangeHigh.Action_4 FaultManager.COOLT_RangeHigh.Action_4_Condition FaultManager.COOLT_RangeLow.Mode FaultManager.COOLT_RangeLow.ID FaultManager.COOLT_RangeLow.Test FaultManager.COOLT_RangeLow.Faulty_Samples__X_ FaultManager.COOLT_RangeLow.Total_Samples__Y_ FaultManager.COOLT_RangeLow.Action_1 FaultManager.COOLT_RangeLow.Action_1_Condition FaultManager.COOLT_RangeLow.Action_2 FaultManager.COOLT_RangeLow.Action_2_Condition FaultManager.COOLT_RangeLow.Action_3 FaultManager.COOLT_RangeLow.Action_3_Condition FaultManager.COOLT_RangeLow.Action_4 FaultManager.COOLT_RangeLow.Action_4_Condition FaultManager.CoolP_RangeHigh.Mode FaultManager.CoolP_RangeHigh.ID FaultManager.CoolP_RangeHigh.Test FaultManager.CoolP_RangeHigh.Faulty_Samples__X_ FaultManager.CoolP_RangeHigh.Total_Samples__Y_ FaultManager.CoolP_RangeHigh.Action_1 FaultManager.CoolP_RangeHigh.Action_1_Condition FaultManager.CoolP_RangeHigh.Action_2 FaultManager.CoolP_RangeHigh.Action_2_Condition FaultManager.CoolP_RangeHigh.Action_3 FaultManager.CoolP_RangeHigh.Action_3_Condition FaultManager.CoolP_RangeHigh.Action_4 FaultManager.CoolP_RangeHigh.Action_4_Condition FaultManager.CoolP_RangeLow.Mode FaultManager.CoolP_RangeLow.ID FaultManager.CoolP_RangeLow.Test FaultManager.CoolP_RangeLow.Faulty_Samples__X_ FaultManager.CoolP_RangeLow.Total_Samples__Y_ FaultManager.CoolP_RangeLow.Action_1 FaultManager.CoolP_RangeLow.Action_1_Condition FaultManager.CoolP_RangeLow.Action_2 FaultManager.CoolP_RangeLow.Action_2_Condition FaultManager.CoolP_RangeLow.Action_3 FaultManager.CoolP_RangeLow.Action_3_Condition FaultManager.CoolP_RangeLow.Action_4 FaultManager.CoolP_RangeLow.Action_4_Condition FaultManager.DRVP_RangeHigh.Mode FaultManager.DRVP_RangeHigh.ID FaultManager.DRVP_RangeHigh.Test FaultManager.DRVP_RangeHigh.Faulty_Samples__X_ FaultManager.DRVP_RangeHigh.Total_Samples__Y_ FaultManager.DRVP_RangeHigh.Action_1 FaultManager.DRVP_RangeHigh.Action_1_Condition FaultManager.DRVP_RangeHigh.Action_2 FaultManager.DRVP_RangeHigh.Action_2_Condition FaultManager.DRVP_RangeHigh.Action_3 FaultManager.DRVP_RangeHigh.Action_3_Condition FaultManager.DRVP_RangeHigh.Action_4 FaultManager.DRVP_RangeHigh.Action_4_Condition FaultManager.DRVP_RangeLow.Mode FaultManager.DRVP_RangeLow.ID FaultManager.DRVP_RangeLow.Test FaultManager.DRVP_RangeLow.Faulty_Samples__X_ FaultManager.DRVP_RangeLow.Total_Samples__Y_ FaultManager.DRVP_RangeLow.Action_1 FaultManager.DRVP_RangeLow.Action_1_Condition FaultManager.DRVP_RangeLow.Action_2 FaultManager.DRVP_RangeLow.Action_2_Condition FaultManager.DRVP_RangeLow.Action_3 FaultManager.DRVP_RangeLow.Action_3_Condition FaultManager.DRVP_RangeLow.Action_4 FaultManager.DRVP_RangeLow.Action_4_Condition FaultManager.ECUP_RangeHigh.Mode FaultManager.ECUP_RangeHigh.ID FaultManager.ECUP_RangeHigh.Test FaultManager.ECUP_RangeHigh.Faulty_Samples__X_ FaultManager.ECUP_RangeHigh.Total_Samples__Y_ FaultManager.ECUP_RangeHigh.Action_1 FaultManager.ECUP_RangeHigh.Action_1_Condition FaultManager.ECUP_RangeHigh.Action_2 FaultManager.ECUP_RangeHigh.Action_2_Condition FaultManager.ECUP_RangeHigh.Action_3 FaultManager.ECUP_RangeHigh.Action_3_Condition FaultManager.ECUP_RangeHigh.Action_4 FaultManager.ECUP_RangeHigh.Action_4_Condition FaultManager.ECUP_RangeLow.Mode FaultManager.ECUP_RangeLow.ID FaultManager.ECUP_RangeLow.Test FaultManager.ECUP_RangeLow.Faulty_Samples__X_ FaultManager.ECUP_RangeLow.Total_Samples__Y_ FaultManager.ECUP_RangeLow.Action_1 FaultManager.ECUP_RangeLow.Action_1_Condition FaultManager.ECUP_RangeLow.Action_2 FaultManager.ECUP_RangeLow.Action_2_Condition FaultManager.ECUP_RangeLow.Action_3 FaultManager.ECUP_RangeLow.Action_3_Condition FaultManager.ECUP_RangeLow.Action_4 FaultManager.ECUP_RangeLow.Action_4_Condition FaultManager.ETCPosA_RangeHigh.Mode FaultManager.ETCPosA_RangeHigh.ID FaultManager.ETCPosA_RangeHigh.Test FaultManager.ETCPosA_RangeHigh.Faulty_Samples__X_ FaultManager.ETCPosA_RangeHigh.Total_Samples__Y_ FaultManager.ETCPosA_RangeHigh.Action_1 FaultManager.ETCPosA_RangeHigh.Action_1_Condition FaultManager.ETCPosA_RangeHigh.Action_2 FaultManager.ETCPosA_RangeHigh.Action_2_Condition FaultManager.ETCPosA_RangeHigh.Action_3 FaultManager.ETCPosA_RangeHigh.Action_3_Condition FaultManager.ETCPosA_RangeHigh.Action_4 FaultManager.ETCPosA_RangeHigh.Action_4_Condition FaultManager.ETCPosA_RangeLow.Mode FaultManager.ETCPosA_RangeLow.ID FaultManager.ETCPosA_RangeLow.Test FaultManager.ETCPosA_RangeLow.Faulty_Samples__X_ FaultManager.ETCPosA_RangeLow.Total_Samples__Y_ FaultManager.ETCPosA_RangeLow.Action_1 FaultManager.ETCPosA_RangeLow.Action_1_Condition FaultManager.ETCPosA_RangeLow.Action_2 FaultManager.ETCPosA_RangeLow.Action_2_Condition FaultManager.ETCPosA_RangeLow.Action_3 FaultManager.ETCPosA_RangeLow.Action_3_Condition FaultManager.ETCPosA_RangeLow.Action_4 FaultManager.ETCPosA_RangeLow.Action_4_Condition FaultManager.ETCPosB_RangeHigh.Mode FaultManager.ETCPosB_RangeHigh.ID FaultManager.ETCPosB_RangeHigh.Test FaultManager.ETCPosB_RangeHigh.Faulty_Samples__X_ FaultManager.ETCPosB_RangeHigh.Total_Samples__Y_ FaultManager.ETCPosB_RangeHigh.Action_1 FaultManager.ETCPosB_RangeHigh.Action_1_Condition FaultManager.ETCPosB_RangeHigh.Action_2 FaultManager.ETCPosB_RangeHigh.Action_2_Condition FaultManager.ETCPosB_RangeHigh.Action_3 FaultManager.ETCPosB_RangeHigh.Action_3_Condition FaultManager.ETCPosB_RangeHigh.Action_4 FaultManager.ETCPosB_RangeHigh.Action_4_Condition FaultManager.ETCPosB_RangeLow.Mode FaultManager.ETCPosB_RangeLow.ID FaultManager.ETCPosB_RangeLow.Test FaultManager.ETCPosB_RangeLow.Faulty_Samples__X_ FaultManager.ETCPosB_RangeLow.Total_Samples__Y_ FaultManager.ETCPosB_RangeLow.Action_1 FaultManager.ETCPosB_RangeLow.Action_1_Condition FaultManager.ETCPosB_RangeLow.Action_2 FaultManager.ETCPosB_RangeLow.Action_2_Condition FaultManager.ETCPosB_RangeLow.Action_3 FaultManager.ETCPosB_RangeLow.Action_3_Condition FaultManager.ETCPosB_RangeLow.Action_4 FaultManager.ETCPosB_RangeLow.Action_4_Condition FaultManager.ExT1_RangeHigh.Mode FaultManager.ExT1_RangeHigh.ID FaultManager.ExT1_RangeHigh.Test FaultManager.ExT1_RangeHigh.Faulty_Samples__X_ FaultManager.ExT1_RangeHigh.Total_Samples__Y_ FaultManager.ExT1_RangeHigh.Action_1 FaultManager.ExT1_RangeHigh.Action_1_Condition FaultManager.ExT1_RangeHigh.Action_2 FaultManager.ExT1_RangeHigh.Action_2_Condition FaultManager.ExT1_RangeHigh.Action_3 FaultManager.ExT1_RangeHigh.Action_3_Condition FaultManager.ExT1_RangeHigh.Action_4 FaultManager.ExT1_RangeHigh.Action_4_Condition FaultManager.ExT1_RangeLow.Mode FaultManager.ExT1_RangeLow.ID FaultManager.ExT1_RangeLow.Test FaultManager.ExT1_RangeLow.Faulty_Samples__X_ FaultManager.ExT1_RangeLow.Total_Samples__Y_ FaultManager.ExT1_RangeLow.Action_1 FaultManager.ExT1_RangeLow.Action_1_Condition FaultManager.ExT1_RangeLow.Action_2 FaultManager.ExT1_RangeLow.Action_2_Condition FaultManager.ExT1_RangeLow.Action_3 FaultManager.ExT1_RangeLow.Action_3_Condition FaultManager.ExT1_RangeLow.Action_4 FaultManager.ExT1_RangeLow.Action_4_Condition FaultManager.ExT2_RangeHigh.Mode FaultManager.ExT2_RangeHigh.ID FaultManager.ExT2_RangeHigh.Test FaultManager.ExT2_RangeHigh.Faulty_Samples__X_ FaultManager.ExT2_RangeHigh.Total_Samples__Y_ FaultManager.ExT2_RangeHigh.Action_1 FaultManager.ExT2_RangeHigh.Action_1_Condition FaultManager.ExT2_RangeHigh.Action_2 FaultManager.ExT2_RangeHigh.Action_2_Condition FaultManager.ExT2_RangeHigh.Action_3 FaultManager.ExT2_RangeHigh.Action_3_Condition FaultManager.ExT2_RangeHigh.Action_4 FaultManager.ExT2_RangeHigh.Action_4_Condition FaultManager.ExT2_RangeLow.Mode FaultManager.ExT2_RangeLow.ID FaultManager.ExT2_RangeLow.Test FaultManager.ExT2_RangeLow.Faulty_Samples__X_ FaultManager.ExT2_RangeLow.Total_Samples__Y_ FaultManager.ExT2_RangeLow.Action_1 FaultManager.ExT2_RangeLow.Action_1_Condition FaultManager.ExT2_RangeLow.Action_2 FaultManager.ExT2_RangeLow.Action_2_Condition FaultManager.ExT2_RangeLow.Action_3 FaultManager.ExT2_RangeLow.Action_3_Condition FaultManager.ExT2_RangeLow.Action_4 FaultManager.ExT2_RangeLow.Action_4_Condition FaultManager.FUELT_RangeHigh.Mode FaultManager.FUELT_RangeHigh.ID FaultManager.FUELT_RangeHigh.Test FaultManager.FUELT_RangeHigh.Faulty_Samples__X_ FaultManager.FUELT_RangeHigh.Total_Samples__Y_ FaultManager.FUELT_RangeHigh.Action_1 FaultManager.FUELT_RangeHigh.Action_1_Condition FaultManager.FUELT_RangeHigh.Action_2 FaultManager.FUELT_RangeHigh.Action_2_Condition FaultManager.FUELT_RangeHigh.Action_3 FaultManager.FUELT_RangeHigh.Action_3_Condition FaultManager.FUELT_RangeHigh.Action_4 FaultManager.FUELT_RangeHigh.Action_4_Condition FaultManager.FUELT_RangeLow.Mode FaultManager.FUELT_RangeLow.ID FaultManager.FUELT_RangeLow.Test FaultManager.FUELT_RangeLow.Faulty_Samples__X_ FaultManager.FUELT_RangeLow.Total_Samples__Y_ FaultManager.FUELT_RangeLow.Action_1 FaultManager.FUELT_RangeLow.Action_1_Condition FaultManager.FUELT_RangeLow.Action_2 FaultManager.FUELT_RangeLow.Action_2_Condition FaultManager.FUELT_RangeLow.Action_3 FaultManager.FUELT_RangeLow.Action_3_Condition FaultManager.FUELT_RangeLow.Action_4 FaultManager.FUELT_RangeLow.Action_4_Condition FaultManager.FuelP_RangeHigh.Mode FaultManager.FuelP_RangeHigh.ID FaultManager.FuelP_RangeHigh.Test FaultManager.FuelP_RangeHigh.Faulty_Samples__X_ FaultManager.FuelP_RangeHigh.Total_Samples__Y_ FaultManager.FuelP_RangeHigh.Action_1 FaultManager.FuelP_RangeHigh.Action_1_Condition FaultManager.FuelP_RangeHigh.Action_2 FaultManager.FuelP_RangeHigh.Action_2_Condition FaultManager.FuelP_RangeHigh.Action_3 FaultManager.FuelP_RangeHigh.Action_3_Condition FaultManager.FuelP_RangeHigh.Action_4 FaultManager.FuelP_RangeHigh.Action_4_Condition FaultManager.FuelP_RangeLow.Mode FaultManager.FuelP_RangeLow.ID FaultManager.FuelP_RangeLow.Test FaultManager.FuelP_RangeLow.Faulty_Samples__X_ FaultManager.FuelP_RangeLow.Total_Samples__Y_ FaultManager.FuelP_RangeLow.Action_1 FaultManager.FuelP_RangeLow.Action_1_Condition FaultManager.FuelP_RangeLow.Action_2 FaultManager.FuelP_RangeLow.Action_2_Condition FaultManager.FuelP_RangeLow.Action_3 FaultManager.FuelP_RangeLow.Action_3_Condition FaultManager.FuelP_RangeLow.Action_4 FaultManager.FuelP_RangeLow.Action_4_Condition FaultManager.IMP_RangeHigh.Mode FaultManager.IMP_RangeHigh.ID FaultManager.IMP_RangeHigh.Test FaultManager.IMP_RangeHigh.Faulty_Samples__X_ FaultManager.IMP_RangeHigh.Total_Samples__Y_ FaultManager.IMP_RangeHigh.Action_1 FaultManager.IMP_RangeHigh.Action_1_Condition FaultManager.IMP_RangeHigh.Action_2 FaultManager.IMP_RangeHigh.Action_2_Condition FaultManager.IMP_RangeHigh.Action_3 FaultManager.IMP_RangeHigh.Action_3_Condition FaultManager.IMP_RangeHigh.Action_4 FaultManager.IMP_RangeHigh.Action_4_Condition FaultManager.IMP_RangeLow.Mode FaultManager.IMP_RangeLow.ID FaultManager.IMP_RangeLow.Test FaultManager.IMP_RangeLow.Faulty_Samples__X_ FaultManager.IMP_RangeLow.Total_Samples__Y_ FaultManager.IMP_RangeLow.Action_1 FaultManager.IMP_RangeLow.Action_1_Condition FaultManager.IMP_RangeLow.Action_2 FaultManager.IMP_RangeLow.Action_2_Condition FaultManager.IMP_RangeLow.Action_3 FaultManager.IMP_RangeLow.Action_3_Condition FaultManager.IMP_RangeLow.Action_4 FaultManager.IMP_RangeLow.Action_4_Condition FaultManager.IMT_RangeHigh.Mode FaultManager.IMT_RangeHigh.ID FaultManager.IMT_RangeHigh.Test FaultManager.IMT_RangeHigh.Faulty_Samples__X_ FaultManager.IMT_RangeHigh.Total_Samples__Y_ FaultManager.IMT_RangeHigh.Action_1 FaultManager.IMT_RangeHigh.Action_1_Condition FaultManager.IMT_RangeHigh.Action_2 FaultManager.IMT_RangeHigh.Action_2_Condition FaultManager.IMT_RangeHigh.Action_3 FaultManager.IMT_RangeHigh.Action_3_Condition FaultManager.IMT_RangeHigh.Action_4 FaultManager.IMT_RangeHigh.Action_4_Condition FaultManager.IMT_RangeLow.Mode FaultManager.IMT_RangeLow.ID FaultManager.IMT_RangeLow.Test FaultManager.IMT_RangeLow.Faulty_Samples__X_ FaultManager.IMT_RangeLow.Total_Samples__Y_ FaultManager.IMT_RangeLow.Action_1 FaultManager.IMT_RangeLow.Action_1_Condition FaultManager.IMT_RangeLow.Action_2 FaultManager.IMT_RangeLow.Action_2_Condition FaultManager.IMT_RangeLow.Action_3 FaultManager.IMT_RangeLow.Action_3_Condition FaultManager.IMT_RangeLow.Action_4 FaultManager.IMT_RangeLow.Action_4_Condition FaultManager.Idle_CPU.Mode FaultManager.Idle_CPU.ID FaultManager.Idle_CPU.Test FaultManager.Idle_CPU.Faulty_Samples__X_ FaultManager.Idle_CPU.Total_Samples__Y_ FaultManager.Idle_CPU.Action_1 FaultManager.Idle_CPU.Action_1_Condition FaultManager.Idle_CPU.Action_2 FaultManager.Idle_CPU.Action_2_Condition FaultManager.Idle_CPU.Action_3 FaultManager.Idle_CPU.Action_3_Condition FaultManager.Idle_CPU.Action_4 FaultManager.Idle_CPU.Action_4_Condition FaultManager.O2A_RangeHigh.Mode FaultManager.O2A_RangeHigh.ID FaultManager.O2A_RangeHigh.Test FaultManager.O2A_RangeHigh.Faulty_Samples__X_ FaultManager.O2A_RangeHigh.Total_Samples__Y_ FaultManager.O2A_RangeHigh.Action_1 FaultManager.O2A_RangeHigh.Action_1_Condition FaultManager.O2A_RangeHigh.Action_2 FaultManager.O2A_RangeHigh.Action_2_Condition FaultManager.O2A_RangeHigh.Action_3 FaultManager.O2A_RangeHigh.Action_3_Condition FaultManager.O2A_RangeHigh.Action_4 FaultManager.O2A_RangeHigh.Action_4_Condition FaultManager.O2A_RangeLow.Mode FaultManager.O2A_RangeLow.ID FaultManager.O2A_RangeLow.Test FaultManager.O2A_RangeLow.Faulty_Samples__X_ FaultManager.O2A_RangeLow.Total_Samples__Y_ FaultManager.O2A_RangeLow.Action_1 FaultManager.O2A_RangeLow.Action_1_Condition FaultManager.O2A_RangeLow.Action_2 FaultManager.O2A_RangeLow.Action_2_Condition FaultManager.O2A_RangeLow.Action_3 FaultManager.O2A_RangeLow.Action_3_Condition FaultManager.O2A_RangeLow.Action_4 FaultManager.O2A_RangeLow.Action_4_Condition FaultManager.O2B_RangeHigh.Mode FaultManager.O2B_RangeHigh.ID FaultManager.O2B_RangeHigh.Test FaultManager.O2B_RangeHigh.Faulty_Samples__X_ FaultManager.O2B_RangeHigh.Total_Samples__Y_ FaultManager.O2B_RangeHigh.Action_1 FaultManager.O2B_RangeHigh.Action_1_Condition FaultManager.O2B_RangeHigh.Action_2 FaultManager.O2B_RangeHigh.Action_2_Condition FaultManager.O2B_RangeHigh.Action_3 FaultManager.O2B_RangeHigh.Action_3_Condition FaultManager.O2B_RangeHigh.Action_4 FaultManager.O2B_RangeHigh.Action_4_Condition FaultManager.O2B_RangeLow.Mode FaultManager.O2B_RangeLow.ID FaultManager.O2B_RangeLow.Test FaultManager.O2B_RangeLow.Faulty_Samples__X_ FaultManager.O2B_RangeLow.Total_Samples__Y_ FaultManager.O2B_RangeLow.Action_1 FaultManager.O2B_RangeLow.Action_1_Condition FaultManager.O2B_RangeLow.Action_2 FaultManager.O2B_RangeLow.Action_2_Condition FaultManager.O2B_RangeLow.Action_3 FaultManager.O2B_RangeLow.Action_3_Condition FaultManager.O2B_RangeLow.Action_4 FaultManager.O2B_RangeLow.Action_4_Condition FaultManager.O2C_RangeHigh.Mode FaultManager.O2C_RangeHigh.ID FaultManager.O2C_RangeHigh.Test FaultManager.O2C_RangeHigh.Faulty_Samples__X_ FaultManager.O2C_RangeHigh.Total_Samples__Y_ FaultManager.O2C_RangeHigh.Action_1 FaultManager.O2C_RangeHigh.Action_1_Condition FaultManager.O2C_RangeHigh.Action_2 FaultManager.O2C_RangeHigh.Action_2_Condition FaultManager.O2C_RangeHigh.Action_3 FaultManager.O2C_RangeHigh.Action_3_Condition FaultManager.O2C_RangeHigh.Action_4 FaultManager.O2C_RangeHigh.Action_4_Condition FaultManager.O2C_RangeLow.Mode FaultManager.O2C_RangeLow.ID FaultManager.O2C_RangeLow.Test FaultManager.O2C_RangeLow.Faulty_Samples__X_ FaultManager.O2C_RangeLow.Total_Samples__Y_ FaultManager.O2C_RangeLow.Action_1 FaultManager.O2C_RangeLow.Action_1_Condition FaultManager.O2C_RangeLow.Action_2 FaultManager.O2C_RangeLow.Action_2_Condition FaultManager.O2C_RangeLow.Action_3 FaultManager.O2C_RangeLow.Action_3_Condition FaultManager.O2C_RangeLow.Action_4 FaultManager.O2C_RangeLow.Action_4_Condition FaultManager.O2D_RangeHigh.Mode FaultManager.O2D_RangeHigh.ID FaultManager.O2D_RangeHigh.Test FaultManager.O2D_RangeHigh.Faulty_Samples__X_ FaultManager.O2D_RangeHigh.Total_Samples__Y_ FaultManager.O2D_RangeHigh.Action_1 FaultManager.O2D_RangeHigh.Action_1_Condition FaultManager.O2D_RangeHigh.Action_2 FaultManager.O2D_RangeHigh.Action_2_Condition FaultManager.O2D_RangeHigh.Action_3 FaultManager.O2D_RangeHigh.Action_3_Condition FaultManager.O2D_RangeHigh.Action_4 FaultManager.O2D_RangeHigh.Action_4_Condition FaultManager.O2D_RangeLow.Mode FaultManager.O2D_RangeLow.ID FaultManager.O2D_RangeLow.Test FaultManager.O2D_RangeLow.Faulty_Samples__X_ FaultManager.O2D_RangeLow.Total_Samples__Y_ FaultManager.O2D_RangeLow.Action_1 FaultManager.O2D_RangeLow.Action_1_Condition FaultManager.O2D_RangeLow.Action_2 FaultManager.O2D_RangeLow.Action_2_Condition FaultManager.O2D_RangeLow.Action_3 FaultManager.O2D_RangeLow.Action_3_Condition FaultManager.O2D_RangeLow.Action_4 FaultManager.O2D_RangeLow.Action_4_Condition FaultManager.OilP_RangeHigh.Mode FaultManager.OilP_RangeHigh.ID FaultManager.OilP_RangeHigh.Test FaultManager.OilP_RangeHigh.Faulty_Samples__X_ FaultManager.OilP_RangeHigh.Total_Samples__Y_ FaultManager.OilP_RangeHigh.Action_1 FaultManager.OilP_RangeHigh.Action_1_Condition FaultManager.OilP_RangeHigh.Action_2 FaultManager.OilP_RangeHigh.Action_2_Condition FaultManager.OilP_RangeHigh.Action_3 FaultManager.OilP_RangeHigh.Action_3_Condition FaultManager.OilP_RangeHigh.Action_4 FaultManager.OilP_RangeHigh.Action_4_Condition FaultManager.OilP_RangeLow.Mode FaultManager.OilP_RangeLow.ID FaultManager.OilP_RangeLow.Test FaultManager.OilP_RangeLow.Faulty_Samples__X_ FaultManager.OilP_RangeLow.Total_Samples__Y_ FaultManager.OilP_RangeLow.Action_1 FaultManager.OilP_RangeLow.Action_1_Condition FaultManager.OilP_RangeLow.Action_2 FaultManager.OilP_RangeLow.Action_2_Condition FaultManager.OilP_RangeLow.Action_3 FaultManager.OilP_RangeLow.Action_3_Condition FaultManager.OilP_RangeLow.Action_4 FaultManager.OilP_RangeLow.Action_4_Condition FaultManager.Pcyl1_RangeHigh.Mode FaultManager.Pcyl1_RangeHigh.ID FaultManager.Pcyl1_RangeHigh.Test FaultManager.Pcyl1_RangeHigh.Faulty_Samples__X_ FaultManager.Pcyl1_RangeHigh.Total_Samples__Y_ FaultManager.Pcyl1_RangeHigh.Action_1 FaultManager.Pcyl1_RangeHigh.Action_1_Condition FaultManager.Pcyl1_RangeHigh.Action_2 FaultManager.Pcyl1_RangeHigh.Action_2_Condition FaultManager.Pcyl1_RangeHigh.Action_3 FaultManager.Pcyl1_RangeHigh.Action_3_Condition FaultManager.Pcyl1_RangeHigh.Action_4 FaultManager.Pcyl1_RangeHigh.Action_4_Condition FaultManager.Pcyl1_RangeLow.Mode FaultManager.Pcyl1_RangeLow.ID FaultManager.Pcyl1_RangeLow.Test FaultManager.Pcyl1_RangeLow.Faulty_Samples__X_ FaultManager.Pcyl1_RangeLow.Total_Samples__Y_ FaultManager.Pcyl1_RangeLow.Action_1 FaultManager.Pcyl1_RangeLow.Action_1_Condition FaultManager.Pcyl1_RangeLow.Action_2 FaultManager.Pcyl1_RangeLow.Action_2_Condition FaultManager.Pcyl1_RangeLow.Action_3 FaultManager.Pcyl1_RangeLow.Action_3_Condition FaultManager.Pcyl1_RangeLow.Action_4 FaultManager.Pcyl1_RangeLow.Action_4_Condition FaultManager.Pcyl2_RangeHigh.Mode FaultManager.Pcyl2_RangeHigh.ID FaultManager.Pcyl2_RangeHigh.Test FaultManager.Pcyl2_RangeHigh.Faulty_Samples__X_ FaultManager.Pcyl2_RangeHigh.Total_Samples__Y_ FaultManager.Pcyl2_RangeHigh.Action_1 FaultManager.Pcyl2_RangeHigh.Action_1_Condition FaultManager.Pcyl2_RangeHigh.Action_2 FaultManager.Pcyl2_RangeHigh.Action_2_Condition FaultManager.Pcyl2_RangeHigh.Action_3 FaultManager.Pcyl2_RangeHigh.Action_3_Condition FaultManager.Pcyl2_RangeHigh.Action_4 FaultManager.Pcyl2_RangeHigh.Action_4_Condition FaultManager.Pcyl2_RangeLow.Mode FaultManager.Pcyl2_RangeLow.ID FaultManager.Pcyl2_RangeLow.Test FaultManager.Pcyl2_RangeLow.Faulty_Samples__X_ FaultManager.Pcyl2_RangeLow.Total_Samples__Y_ FaultManager.Pcyl2_RangeLow.Action_1 FaultManager.Pcyl2_RangeLow.Action_1_Condition FaultManager.Pcyl2_RangeLow.Action_2 FaultManager.Pcyl2_RangeLow.Action_2_Condition FaultManager.Pcyl2_RangeLow.Action_3 FaultManager.Pcyl2_RangeLow.Action_3_Condition FaultManager.Pcyl2_RangeLow.Action_4 FaultManager.Pcyl2_RangeLow.Action_4_Condition FaultManager.Pcyl3_RangeHigh.Mode FaultManager.Pcyl3_RangeHigh.ID FaultManager.Pcyl3_RangeHigh.Test FaultManager.Pcyl3_RangeHigh.Faulty_Samples__X_ FaultManager.Pcyl3_RangeHigh.Total_Samples__Y_ FaultManager.Pcyl3_RangeHigh.Action_1 FaultManager.Pcyl3_RangeHigh.Action_1_Condition FaultManager.Pcyl3_RangeHigh.Action_2 FaultManager.Pcyl3_RangeHigh.Action_2_Condition FaultManager.Pcyl3_RangeHigh.Action_3 FaultManager.Pcyl3_RangeHigh.Action_3_Condition FaultManager.Pcyl3_RangeHigh.Action_4 FaultManager.Pcyl3_RangeHigh.Action_4_Condition FaultManager.Pcyl3_RangeLow.Mode FaultManager.Pcyl3_RangeLow.ID FaultManager.Pcyl3_RangeLow.Test FaultManager.Pcyl3_RangeLow.Faulty_Samples__X_ FaultManager.Pcyl3_RangeLow.Total_Samples__Y_ FaultManager.Pcyl3_RangeLow.Action_1 FaultManager.Pcyl3_RangeLow.Action_1_Condition FaultManager.Pcyl3_RangeLow.Action_2 FaultManager.Pcyl3_RangeLow.Action_2_Condition FaultManager.Pcyl3_RangeLow.Action_3 FaultManager.Pcyl3_RangeLow.Action_3_Condition FaultManager.Pcyl3_RangeLow.Action_4 FaultManager.Pcyl3_RangeLow.Action_4_Condition FaultManager.Pcyl4_RangeHigh.Mode FaultManager.Pcyl4_RangeHigh.ID FaultManager.Pcyl4_RangeHigh.Test FaultManager.Pcyl4_RangeHigh.Faulty_Samples__X_ FaultManager.Pcyl4_RangeHigh.Total_Samples__Y_ FaultManager.Pcyl4_RangeHigh.Action_1 FaultManager.Pcyl4_RangeHigh.Action_1_Condition FaultManager.Pcyl4_RangeHigh.Action_2 FaultManager.Pcyl4_RangeHigh.Action_2_Condition FaultManager.Pcyl4_RangeHigh.Action_3 FaultManager.Pcyl4_RangeHigh.Action_3_Condition FaultManager.Pcyl4_RangeHigh.Action_4 FaultManager.Pcyl4_RangeHigh.Action_4_Condition FaultManager.Pcyl4_RangeLow.Mode FaultManager.Pcyl4_RangeLow.ID FaultManager.Pcyl4_RangeLow.Test FaultManager.Pcyl4_RangeLow.Faulty_Samples__X_ FaultManager.Pcyl4_RangeLow.Total_Samples__Y_ FaultManager.Pcyl4_RangeLow.Action_1 FaultManager.Pcyl4_RangeLow.Action_1_Condition FaultManager.Pcyl4_RangeLow.Action_2 FaultManager.Pcyl4_RangeLow.Action_2_Condition FaultManager.Pcyl4_RangeLow.Action_3 FaultManager.Pcyl4_RangeLow.Action_3_Condition FaultManager.Pcyl4_RangeLow.Action_4 FaultManager.Pcyl4_RangeLow.Action_4_Condition FaultManager.Pcyl5_RangeHigh.Mode FaultManager.Pcyl5_RangeHigh.ID FaultManager.Pcyl5_RangeHigh.Test FaultManager.Pcyl5_RangeHigh.Faulty_Samples__X_ FaultManager.Pcyl5_RangeHigh.Total_Samples__Y_ FaultManager.Pcyl5_RangeHigh.Action_1 FaultManager.Pcyl5_RangeHigh.Action_1_Condition FaultManager.Pcyl5_RangeHigh.Action_2 FaultManager.Pcyl5_RangeHigh.Action_2_Condition FaultManager.Pcyl5_RangeHigh.Action_3 FaultManager.Pcyl5_RangeHigh.Action_3_Condition FaultManager.Pcyl5_RangeHigh.Action_4 FaultManager.Pcyl5_RangeHigh.Action_4_Condition FaultManager.Pcyl5_RangeLow.Mode FaultManager.Pcyl5_RangeLow.ID FaultManager.Pcyl5_RangeLow.Test FaultManager.Pcyl5_RangeLow.Faulty_Samples__X_ FaultManager.Pcyl5_RangeLow.Total_Samples__Y_ FaultManager.Pcyl5_RangeLow.Action_1 FaultManager.Pcyl5_RangeLow.Action_1_Condition FaultManager.Pcyl5_RangeLow.Action_2 FaultManager.Pcyl5_RangeLow.Action_2_Condition FaultManager.Pcyl5_RangeLow.Action_3 FaultManager.Pcyl5_RangeLow.Action_3_Condition FaultManager.Pcyl5_RangeLow.Action_4 FaultManager.Pcyl5_RangeLow.Action_4_Condition FaultManager.Pcyl6_RangeHigh.Mode FaultManager.Pcyl6_RangeHigh.ID FaultManager.Pcyl6_RangeHigh.Test FaultManager.Pcyl6_RangeHigh.Faulty_Samples__X_ FaultManager.Pcyl6_RangeHigh.Total_Samples__Y_ FaultManager.Pcyl6_RangeHigh.Action_1 FaultManager.Pcyl6_RangeHigh.Action_1_Condition FaultManager.Pcyl6_RangeHigh.Action_2 FaultManager.Pcyl6_RangeHigh.Action_2_Condition FaultManager.Pcyl6_RangeHigh.Action_3 FaultManager.Pcyl6_RangeHigh.Action_3_Condition FaultManager.Pcyl6_RangeHigh.Action_4 FaultManager.Pcyl6_RangeHigh.Action_4_Condition FaultManager.Pcyl6_RangeLow.Mode FaultManager.Pcyl6_RangeLow.ID FaultManager.Pcyl6_RangeLow.Test FaultManager.Pcyl6_RangeLow.Faulty_Samples__X_ FaultManager.Pcyl6_RangeLow.Total_Samples__Y_ FaultManager.Pcyl6_RangeLow.Action_1 FaultManager.Pcyl6_RangeLow.Action_1_Condition FaultManager.Pcyl6_RangeLow.Action_2 FaultManager.Pcyl6_RangeLow.Action_2_Condition FaultManager.Pcyl6_RangeLow.Action_3 FaultManager.Pcyl6_RangeLow.Action_3_Condition FaultManager.Pcyl6_RangeLow.Action_4 FaultManager.Pcyl6_RangeLow.Action_4_Condition FaultManager.Pcyl7_RangeHigh.Mode FaultManager.Pcyl7_RangeHigh.ID FaultManager.Pcyl7_RangeHigh.Test FaultManager.Pcyl7_RangeHigh.Faulty_Samples__X_ FaultManager.Pcyl7_RangeHigh.Total_Samples__Y_ FaultManager.Pcyl7_RangeHigh.Action_1 FaultManager.Pcyl7_RangeHigh.Action_1_Condition FaultManager.Pcyl7_RangeHigh.Action_2 FaultManager.Pcyl7_RangeHigh.Action_2_Condition FaultManager.Pcyl7_RangeHigh.Action_3 FaultManager.Pcyl7_RangeHigh.Action_3_Condition FaultManager.Pcyl7_RangeHigh.Action_4 FaultManager.Pcyl7_RangeHigh.Action_4_Condition FaultManager.Pcyl7_RangeLow.Mode FaultManager.Pcyl7_RangeLow.ID FaultManager.Pcyl7_RangeLow.Test FaultManager.Pcyl7_RangeLow.Faulty_Samples__X_ FaultManager.Pcyl7_RangeLow.Total_Samples__Y_ FaultManager.Pcyl7_RangeLow.Action_1 FaultManager.Pcyl7_RangeLow.Action_1_Condition FaultManager.Pcyl7_RangeLow.Action_2 FaultManager.Pcyl7_RangeLow.Action_2_Condition FaultManager.Pcyl7_RangeLow.Action_3 FaultManager.Pcyl7_RangeLow.Action_3_Condition FaultManager.Pcyl7_RangeLow.Action_4 FaultManager.Pcyl7_RangeLow.Action_4_Condition FaultManager.Pcyl8_RangeHigh.Mode FaultManager.Pcyl8_RangeHigh.ID FaultManager.Pcyl8_RangeHigh.Test FaultManager.Pcyl8_RangeHigh.Faulty_Samples__X_ FaultManager.Pcyl8_RangeHigh.Total_Samples__Y_ FaultManager.Pcyl8_RangeHigh.Action_1 FaultManager.Pcyl8_RangeHigh.Action_1_Condition FaultManager.Pcyl8_RangeHigh.Action_2 FaultManager.Pcyl8_RangeHigh.Action_2_Condition FaultManager.Pcyl8_RangeHigh.Action_3 FaultManager.Pcyl8_RangeHigh.Action_3_Condition FaultManager.Pcyl8_RangeHigh.Action_4 FaultManager.Pcyl8_RangeHigh.Action_4_Condition FaultManager.Pcyl8_RangeLow.Mode FaultManager.Pcyl8_RangeLow.ID FaultManager.Pcyl8_RangeLow.Test FaultManager.Pcyl8_RangeLow.Faulty_Samples__X_ FaultManager.Pcyl8_RangeLow.Total_Samples__Y_ FaultManager.Pcyl8_RangeLow.Action_1 FaultManager.Pcyl8_RangeLow.Action_1_Condition FaultManager.Pcyl8_RangeLow.Action_2 FaultManager.Pcyl8_RangeLow.Action_2_Condition FaultManager.Pcyl8_RangeLow.Action_3 FaultManager.Pcyl8_RangeLow.Action_3_Condition FaultManager.Pcyl8_RangeLow.Action_4 FaultManager.Pcyl8_RangeLow.Action_4_Condition /end DEF_CHARACTERISTIC
 /begin OUT_MEASUREMENT FaultMarquees.FaultMarquees.Current_Suspected FaultMarquees.FaultMarquees.Current_Active FaultMarquees.FaultMarquees.Current_Occurred /end OUT_MEASUREMENT
 /begin SUB_FUNCTION Action_Reasons /end SUB_FUNCTION
/end FUNCTION
/end MODULE
/end PROJECT

ASAP2_VERSION 1 51
/begin PROJECT Project ""
/begin MODULE niihil14_037 ""
/begin MOD_COMMON /* MOD_COMMON Comment */ "" BYTE_ORDER MSB_FIRST ALIGNMENT_BYTE 1 ALIGNMENT_FLOAT32_IEEE 1 ALIGNMENT_FLOAT64_IEEE 1 ALIGNMENT_LONG 1 ALIGNMENT_WORD 1 /end MOD_COMMON
/begin MEASUREMENT FuelFlow_kgpercyl "" FLOAT32_IEEE CompuMethod_2 1 0 -1E+17 1E+17 ECU_ADDRESS 0x400002F0 /end MEASUREMENT
/begin MEASUREMENT FuelFlow_kgpersec "" FLOAT32_IEEE CompuMethod_2 1 0 -1E+17 1E+17 ECU_ADDRESS 0x400002F4 /end MEASUREMENT
/begin MEASUREMENT FuelP "Final value after Linear Sensor Characterization" FLOAT32_IEEE CompuMethod_143 1 0 -1E+17 1E+17 ECU_ADDRESS 0x400002F8 /end MEASUREMENT
/begin MEASUREMENT FuelP_ADC "Signal measured directly from sensor" UWORD CompuMethod_15 1 0 0 65535 ECU_ADDRESS 0x400002FC /end MEASUREMENT
/begin MEASUREMENT FuelP_Raw "After conversion to engineering units, before range checking" FLOAT32_IEEE CompuMethod_143 1 0 -1E+17 1E+17 ECU_ADDRESS 0x400002FE /end MEASUREMENT
/begin MEASUREMENT FuelPIdx "" UWORD CompuMethod_16 1 0 0 127.998 ECU_ADDRESS 0x40000302 /end MEASUREMENT
/begin MEASUREMENT FuelPump "" UBYTE CompuMethod_13 1 0 0 1 ECU_ADDRESS 0x40000304 /end MEASUREMENT
/begin MEASUREMENT FUELT "Final value after Linear Sensor Characterization" FLOAT32_IEEE CompuMethod_144 1 0 -1E+17 1E+17 ECU_ADDRESS 0x40000305 /end MEASUREMENT
/begin MEASUREMENT FUELT_ADC "Signal measured directly from sensor" UWORD CompuMethod_15 1 0 0 65535 ECU_ADDRESS 0x40000309 /end MEASUREMENT
/begin MEASUREMENT FUELT_Raw "After conversion to engineering units, before range checking" FLOAT32_IEEE CompuMethod_144 1 0 -1E+17 1E+17 ECU_ADDRESS 0x4000030B /end MEASUREMENT
/begin MEASUREMENT FUELTIdx "" UWORD CompuMethod_16 1 0 0 127.998 ECU_ADDRESS 0x4000030F /end MEASUREMENT
/begin MEASUREMENT IAC "" FLOAT32_IEEE CompuMethod_2 1 0 -1E+17 1E+17 ECU_ADDRESS 0x40000315 /end MEASUREMENT
/begin MEASUREMENT IgnitionAng "ECU ignition angle described as angle before top dead centre based" FLOAT32_IEEE CompuMethod_161 1 0 -5.72958E+18 5.72958E+18 ECU_ADDRESS 0x4000031B /end MEASUREMENT
/begin MEASUREMENT IgnitionAngColIdx "ECU ignition angle described as angle before top dead centre based" UWORD CompuMethod_16 1 0 0 127.998 ECU_ADDRESS 0x4000031F /end MEASUREMENT
/begin MEASUREMENT IgnitionAngColIn "ECU ignition angle described as angle before top dead centre based" FLOAT32_IEEE CompuMethod_162 1 0 -1E+17 1E+17 ECU_ADDRESS 0x40000321 /end MEASUREMENT
/begin MEASUREMENT IgnitionAngles_dbtdc.Start_Angle._ "" FLOAT32_IEEE CompuMethod_2 1 0 -1E+17 1E+17 ECU_ADDRESS 0x40000325 /end MEASUREMENT
/begin MEASUREMENT IgnitionAngles_dbtdc.End_Angle._ "" FLOAT32_IEEE CompuMethod_2 1 0 -1E+17 1E+17 ECU_ADDRESS 0x40000329 /end MEASUREMENT
/begin MEASUREMENT IgnitionAngRowIdx "ECU ignition angle described as angle before top dead centre based" UWORD CompuMethod_16 1 0 0 127.998 ECU_ADDRESS 0x4000032D /end MEASUREMENT
/begin MEASUREMENT IgnitionAngRowIn "ECU ignition angle described as angle before top dead centre based" FLOAT32_IEEE CompuMethod_163 1 0 -1E+17 1E+17 ECU_ADDRESS 0x4000032F /end MEASUREMENT
/begin MEASUREMENT IMP "Final value after Linear Sensor Characterization" FLOAT32_IEEE CompuMethod_143 1 0 -1E+17 1E+17 ECU_ADDRESS 0x40000333 /end MEASUREMENT
/begin MEASUREMENT IMP_ADC "Signal measured directly from sensor" UWORD CompuMethod_15 1 0 0 65535 ECU_ADDRESS 0x40000337 /end MEASUREMENT
/begin MEASUREMENT IMP_Raw "After conversion to engineering units, before range checking" FLOAT32_IEEE CompuMethod_143 1 0 -1E+17 1E+17 ECU_ADDRESS 0x40000339 /end MEASUREMENT
/begin MEASUREMENT IMPIdx "" UWORD CompuMethod_16 1 0 0 127.998 ECU_ADDRESS 0x4000033D /end MEASUREMENT
/begin MEASUREMENT IMT "Final value after Linear Sensor Characterization" FLOAT32_IEEE CompuMethod_144 1 0 -1E+17 1E+17 ECU_ADDRESS 0x4000033F /end MEASUREMENT
/begin MEASUREMENT IMT_ADC "Signal measured directly from sensor" UWORD CompuMethod_15 1 0 0 65535 ECU_ADDRESS 0x40000343 /end MEASUREMENT
/begin MEASUREMENT IMT_Raw "After conversion to engineering units, before range checking" FLOAT32_IEEE CompuMethod_144 1 0 -1E+17 1E+17 ECU_ADDRESS 0x40000345 /end MEASUREMENT
/begin MEASUREMENT IMTIdx "" UWORD CompuMethod_16 1 0 0 127.998 ECU_ADDRESS 0x40000349 /end MEASUREMENT
/begin MEASUREMENT InjectionTime "Duration of injection signal without time delay to reach the desired injected fuel " FLOAT32_IEEE CompuMethod_165 1 0 -1E+17 1E+17 ECU_ADDRESS 0x4000034B /end MEASUREMENT
/begin MEASUREMENT InjectionTime_msec "" FLOAT32_IEEE CompuMethod_2 1 0 -1E+17 1E+17 ECU_ADDRESS 0x4000034F MATRIX_DIM 8 1 1 /end MEASUREMENT
/begin MEASUREMENT InjectionTimeColIdx "Duration of injection signal without time delay to reach the desired injected fuel " UWORD CompuMethod_16 1 0 0 127.998 ECU_ADDRESS 0x4000036F /end MEASUREMENT
/begin MEASUREMENT InjectionTimeColIn "Duration of injection signal without time delay to reach the desired injected fuel " FLOAT32_IEEE CompuMethod_166 1 0 -1E+17 1E+17 ECU_ADDRESS 0x40000371 /end MEASUREMENT
/begin MEASUREMENT InjectionTimeRowIdx "Duration of injection signal without time delay to reach the desired injected fuel " UWORD CompuMethod_16 1 0 0 127.998 ECU_ADDRESS 0x40000375 /end MEASUREMENT
/begin MEASUREMENT InjectionTimeRowIn "Duration of injection signal without time delay to reach the desired injected fuel " FLOAT32_IEEE CompuMethod_168 1 0 -1E+17 1E+17 ECU_ADDRESS 0x40000377 /end MEASUREMENT
/begin MEASUREMENT IntakeDensity_kgperm3 "" FLOAT32_IEEE CompuMethod_2 1 0 -1E+17 1E+17 ECU_ADDRESS 0x4000037B /end MEASUREMENT
/begin MEASUREMENT ISR_ADCCPU "Percentage of CPU spent in eSCI interrupt servicing" UWORD CompuMethod_171 1 0 0 100 ECU_ADDRESS 0x40000381 /end MEASUREMENT
/begin MEASUREMENT ISR_CANCPU "Percentage of CPU spent in CAN interrupt servicing" UWORD CompuMethod_171 1 0 0 100 ECU_ADDRESS 0x40000383 /end MEASUREMENT
/begin MEASUREMENT ISR_DecrementorCPU "Percentage of CPU spent in the Decrementor interrupt" UWORD CompuMethod_171 1 0 0 100 ECU_ADDRESS 0x40000385 /end MEASUREMENT
/begin MEASUREMENT ISR_DMACPU "Percentage of CPU spent in DMA interrupt servicing" UWORD CompuMethod_171 1 0 0 100 ECU_ADDRESS 0x40000387 /end MEASUREMENT
/begin MEASUREMENT ISR_EMIOSCPU "Percentage of CPU spent in eMIOS interrupt servicing" UWORD CompuMethod_171 1 0 0 100 ECU_ADDRESS 0x40000389 /end MEASUREMENT
/begin MEASUREMENT ISR_SCICPU "Percentage of CPU spent in eSCI interrupt servicing" UWORD CompuMethod_171 1 0 0 100 ECU_ADDRESS 0x4000038B /end MEASUREMENT
/begin MEASUREMENT ISR_TPUCPU "Percentage of CPU spent in eTPU interrupts" UWORD CompuMethod_171 1 0 0 100 ECU_ADDRESS 0x4000038D /end MEASUREMENT
/begin MEASUREMENT Knock_Energy "" ULONG CompuMethod_41 1 0 0 4294970000 ECU_ADDRESS 0x40000391 MATRIX_DIM 12 1 1 /end MEASUREMENT
/begin MEASUREMENT Knock_LastCyl "" UBYTE CompuMethod_1 1 0 0 255 ECU_ADDRESS 0x400003C1 /end MEASUREMENT
/begin MEASUREMENT Knock_Ratio "" UWORD CompuMethod_5 1 0 0 65535 ECU_ADDRESS 0x400003C2 MATRIX_DIM 12 1 1 /end MEASUREMENT
/begin MEASUREMENT Knock_Ref "" ULONG CompuMethod_41 1 0 0 4294970000 ECU_ADDRESS 0x400003DA MATRIX_DIM 12 1 1 /end MEASUREMENT
/begin MEASUREMENT KnockRetard "" FLOAT32_IEEE CompuMethod_153 1 0 -1E+17 1E+17 ECU_ADDRESS 0x4000040A /end MEASUREMENT
/begin MEASUREMENT KnockRetardIdx "" UWORD CompuMethod_16 1 0 0 127.998 ECU_ADDRESS 0x4000040E /end MEASUREMENT
/begin MEASUREMENT KnockRetardIn "" FLOAT32_IEEE CompuMethod_2 1 0 -1E+17 1E+17 ECU_ADDRESS 0x40000410 /end MEASUREMENT
/begin MEASUREMENT LIG_effort "" FLOAT32_IEEE CompuMethod_2 1 0 -1E+17 1E+17 ECU_ADDRESS 0x40000414 /end MEASUREMENT
/begin MEASUREMENT LIG_Error_rpm "" FLOAT32_IEEE CompuMethod_172 1 0 -9.5493E+17 9.5493E+17 ECU_ADDRESS 0x40000418 /end MEASUREMENT
/begin MEASUREMENT LIG_FF "" FLOAT32_IEEE CompuMethod_163 1 0 -1E+17 1E+17 ECU_ADDRESS 0x4000041C /end MEASUREMENT
/begin MEASUREMENT LIG_FFeffort "" FLOAT32_IEEE CompuMethod_2 1 0 -1E+17 1E+17 ECU_ADDRESS 0x40000420 /end MEASUREMENT
/begin MEASUREMENT LIG_FFIdx "" UWORD CompuMethod_16 1 0 0 127.998 ECU_ADDRESS 0x40000424 /end MEASUREMENT
/begin MEASUREMENT LIG_FFIn "" FLOAT32_IEEE CompuMethod_173 1 0 -9.5493E+17 9.5493E+17 ECU_ADDRESS 0x40000426 /end MEASUREMENT
/begin MEASUREMENT LIG_Ieffort "" FLOAT32_IEEE CompuMethod_2 1 0 -1E+17 1E+17 ECU_ADDRESS 0x4000042A /end MEASUREMENT
/begin MEASUREMENT LIG_Peffort "" FLOAT32_IEEE CompuMethod_2 1 0 -1E+17 1E+17 ECU_ADDRESS 0x4000042E /end MEASUREMENT
/begin MEASUREMENT MAF_SpeedDensity_kgpersec "" FLOAT32_IEEE CompuMethod_2 1 0 -1E+17 1E+17 ECU_ADDRESS 0x40000432 /end MEASUREMENT
/begin MEASUREMENT MaxKnock "" UWORD CompuMethod_5 1 0 0 65535 ECU_ADDRESS 0x400004BA /end MEASUREMENT
/begin MEASUREMENT MIL "" UBYTE CompuMethod_13 1 0 0 1 ECU_ADDRESS 0x400004BC /end MEASUREMENT
/begin MEASUREMENT NonVolatileCRC "Calculated NonVolatile CRC" ULONG CompuMethod_13 1 0 0 65535 ECU_ADDRESS 0x4000063A /end MEASUREMENT
/begin MEASUREMENT NonVolatileFormatID "Unique identifier of the NonVolatile memory format.  Used to validate whether stored variables are in the correct form for the program" ULONG CompuMethod_41 1 0 0 4294970000 ECU_ADDRESS 0x4000063E /end MEASUREMENT
/begin MEASUREMENT NonVolatileStatus "Indicates how NonVolatile memory was loaded" UBYTE CompuMethod_181 1 0 0 6 ECU_ADDRESS 0x40000642 /end MEASUREMENT
/begin MEASUREMENT O2A "Final value after Linear Sensor Characterization" FLOAT32_IEEE CompuMethod_163 1 0 -1E+17 1E+17 ECU_ADDRESS 0x40000643 /end MEASUREMENT
/begin MEASUREMENT O2A_ADC "Signal measured directly from sensor" UWORD CompuMethod_15 1 0 0 65535 ECU_ADDRESS 0x40000647 /end MEASUREMENT
/begin MEASUREMENT O2A_Raw "After conversion to engineering units, before range checking" FLOAT32_IEEE CompuMethod_163 1 0 -1E+17 1E+17 ECU_ADDRESS 0x40000649 /end MEASUREMENT
/begin MEASUREMENT O2AIdx "" UWORD CompuMethod_16 1 0 0 127.998 ECU_ADDRESS 0x4000064D /end MEASUREMENT
/begin MEASUREMENT O2B "Final value after Linear Sensor Characterization" FLOAT32_IEEE CompuMethod_163 1 0 -1E+17 1E+17 ECU_ADDRESS 0x4000064F /end MEASUREMENT
/begin MEASUREMENT O2B_ADC "Signal measured directly from sensor" UWORD CompuMethod_15 1 0 0 65535 ECU_ADDRESS 0x40000653 /end MEASUREMENT
/begin MEASUREMENT O2B_Raw "After conversion to engineering units, before range checking" FLOAT32_IEEE CompuMethod_163 1 0 -1E+17 1E+17 ECU_ADDRESS 0x40000655 /end MEASUREMENT
/begin MEASUREMENT O2BIdx "" UWORD CompuMethod_16 1 0 0 127.998 ECU_ADDRESS 0x40000659 /end MEASUREMENT
/begin MEASUREMENT O2C "Final value after Linear Sensor Characterization" FLOAT32_IEEE CompuMethod_163 1 0 -1E+17 1E+17 ECU_ADDRESS 0x4000065B /end MEASUREMENT
/begin MEASUREMENT O2C_ADC "Signal measured directly from sensor" UWORD CompuMethod_15 1 0 0 65535 ECU_ADDRESS 0x4000065F /end MEASUREMENT
/begin MEASUREMENT O2C_Raw "After conversion to engineering units, before range checking" FLOAT32_IEEE CompuMethod_163 1 0 -1E+17 1E+17 ECU_ADDRESS 0x40000661 /end MEASUREMENT
/begin MEASUREMENT O2CIdx "" UWORD CompuMethod_16 1 0 0 127.998 ECU_ADDRESS 0x40000665 /end MEASUREMENT
/begin MEASUREMENT O2D "Final value after Linear Sensor Characterization" FLOAT32_IEEE CompuMethod_163 1 0 -1E+17 1E+17 ECU_ADDRESS 0x40000667 /end MEASUREMENT
/begin MEASUREMENT O2D_ADC "Signal measured directly from sensor" UWORD CompuMethod_15 1 0 0 65535 ECU_ADDRESS 0x4000066B /end MEASUREMENT
/begin MEASUREMENT O2D_Raw "After conversion to engineering units, before range checking" FLOAT32_IEEE CompuMethod_163 1 0 -1E+17 1E+17 ECU_ADDRESS 0x4000066D /end MEASUREMENT
/begin MEASUREMENT O2DIdx "" UWORD CompuMethod_16 1 0 0 127.998 ECU_ADDRESS 0x40000671 /end MEASUREMENT
/begin MEASUREMENT OilP "Final value after Linear Sensor Characterization" FLOAT32_IEEE CompuMethod_143 1 0 -1E+17 1E+17 ECU_ADDRESS 0x40000673 /end MEASUREMENT
/begin MEASUREMENT OilP_ADC "Signal measured directly from sensor" UWORD CompuMethod_15 1 0 0 65535 ECU_ADDRESS 0x40000677 /end MEASUREMENT
/begin MEASUREMENT OilP_Raw "After conversion to engineering units, before range checking" FLOAT32_IEEE CompuMethod_143 1 0 -1E+17 1E+17 ECU_ADDRESS 0x40000679 /end MEASUREMENT
/begin MEASUREMENT OilPIdx "" UWORD CompuMethod_16 1 0 0 127.998 ECU_ADDRESS 0x4000067D /end MEASUREMENT
/begin MEASUREMENT Pcyl1 "Final value after Linear Sensor Characterization" FLOAT32_IEEE CompuMethod_143 1 0 -1E+17 1E+17 ECU_ADDRESS 0x400006A7 /end MEASUREMENT
/begin MEASUREMENT Pcyl1_ADC "Signal measured directly from sensor" UWORD CompuMethod_15 1 0 0 65535 ECU_ADDRESS 0x400006AB /end MEASUREMENT
/begin MEASUREMENT Pcyl1_Raw "After conversion to engineering units, before range checking" FLOAT32_IEEE CompuMethod_143 1 0 -1E+17 1E+17 ECU_ADDRESS 0x400006AD /end MEASUREMENT
/begin MEASUREMENT Pcyl1Idx "" UWORD CompuMethod_16 1 0 0 127.998 ECU_ADDRESS 0x400006B1 /end MEASUREMENT
/begin MEASUREMENT Pcyl2 "Final value after Linear Sensor Characterization" FLOAT32_IEEE CompuMethod_143 1 0 -1E+17 1E+17 ECU_ADDRESS 0x400006B3 /end MEASUREMENT
/begin MEASUREMENT Pcyl2_ADC "Signal measured directly from sensor" UWORD CompuMethod_15 1 0 0 65535 ECU_ADDRESS 0x400006B7 /end MEASUREMENT
/begin MEASUREMENT Pcyl2_Raw "After conversion to engineering units, before range checking" FLOAT32_IEEE CompuMethod_143 1 0 -1E+17 1E+17 ECU_ADDRESS 0x400006B9 /end MEASUREMENT
/begin MEASUREMENT Pcyl2Idx "" UWORD CompuMethod_16 1 0 0 127.998 ECU_ADDRESS 0x400006BD /end MEASUREMENT
/begin MEASUREMENT Pcyl3 "Final value after Linear Sensor Characterization" FLOAT32_IEEE CompuMethod_143 1 0 -1E+17 1E+17 ECU_ADDRESS 0x400006BF /end MEASUREMENT
/begin MEASUREMENT Pcyl3_ADC "Signal measured directly from sensor" UWORD CompuMethod_15 1 0 0 65535 ECU_ADDRESS 0x400006C3 /end MEASUREMENT
/begin MEASUREMENT Pcyl3_Raw "After conversion to engineering units, before range checking" FLOAT32_IEEE CompuMethod_143 1 0 -1E+17 1E+17 ECU_ADDRESS 0x400006C5 /end MEASUREMENT
/begin MEASUREMENT Pcyl3Idx "" UWORD CompuMethod_16 1 0 0 127.998 ECU_ADDRESS 0x400006C9 /end MEASUREMENT
/begin MEASUREMENT Pcyl4 "Final value after Linear Sensor Characterization" FLOAT32_IEEE CompuMethod_143 1 0 -1E+17 1E+17 ECU_ADDRESS 0x400006CB /end MEASUREMENT
/begin MEASUREMENT Pcyl4_ADC "Signal measured directly from sensor" UWORD CompuMethod_15 1 0 0 65535 ECU_ADDRESS 0x400006CF /end MEASUREMENT
/begin MEASUREMENT Pcyl4_Raw "After conversion to engineering units, before range checking" FLOAT32_IEEE CompuMethod_143 1 0 -1E+17 1E+17 ECU_ADDRESS 0x400006D1 /end MEASUREMENT
/begin MEASUREMENT Pcyl4Idx "" UWORD CompuMethod_16 1 0 0 127.998 ECU_ADDRESS 0x400006D5 /end MEASUREMENT
/begin MEASUREMENT Pcyl5 "Final value after Linear Sensor Characterization" FLOAT32_IEEE CompuMethod_143 1 0 -1E+17 1E+17 ECU_ADDRESS 0x400006D7 /end MEASUREMENT
/begin MEASUREMENT Pcyl5_ADC "Signal measured directly from sensor" UWORD CompuMethod_15 1 0 0 65535 ECU_ADDRESS 0x400006DB /end MEASUREMENT
/begin MEASUREMENT Pcyl5_Raw "After conversion to engineering units, before range checking" FLOAT32_IEEE CompuMethod_143 1 0 -1E+17 1E+17 ECU_ADDRESS 0x400006DD /end MEASUREMENT
/begin MEASUREMENT Pcyl5Idx "" UWORD CompuMethod_16 1 0 0 127.998 ECU_ADDRESS 0x400006E1 /end MEASUREMENT
/begin MEASUREMENT Pcyl6 "Final value after Linear Sensor Characterization" FLOAT32_IEEE CompuMethod_143 1 0 -1E+17 1E+17 ECU_ADDRESS 0x400006E3 /end MEASUREMENT
/begin MEASUREMENT Pcyl6_ADC "Signal measured directly from sensor" UWORD CompuMethod_15 1 0 0 65535 ECU_ADDRESS 0x400006E7 /end MEASUREMENT
/begin MEASUREMENT Pcyl6_Raw "After conversion to engineering units, before range checking" FLOAT32_IEEE CompuMethod_143 1 0 -1E+17 1E+17 ECU_ADDRESS 0x400006E9 /end MEASUREMENT
/begin MEASUREMENT Pcyl6Idx "" UWORD CompuMethod_16 1 0 0 127.998 ECU_ADDRESS 0x400006ED /end MEASUREMENT
/begin MEASUREMENT Pcyl7 "Final value after Linear Sensor Characterization" FLOAT32_IEEE CompuMethod_143 1 0 -1E+17 1E+17 ECU_ADDRESS 0x400006EF /end MEASUREMENT
/begin MEASUREMENT Pcyl7_ADC "Signal measured directly from sensor" UWORD CompuMethod_15 1 0 0 65535 ECU_ADDRESS 0x400006F3 /end MEASUREMENT
/begin MEASUREMENT Pcyl7_Raw "After conversion to engineering units, before range checking" FLOAT32_IEEE CompuMethod_143 1 0 -1E+17 1E+17 ECU_ADDRESS 0x400006F5 /end MEASUREMENT
/begin MEASUREMENT Pcyl7Idx "" UWORD CompuMethod_16 1 0 0 127.998 ECU_ADDRESS 0x400006F9 /end MEASUREMENT
/begin MEASUREMENT Pcyl8 "Final value after Linear Sensor Characterization" FLOAT32_IEEE CompuMethod_143 1 0 -1E+17 1E+17 ECU_ADDRESS 0x400006FB /end MEASUREMENT
/begin MEASUREMENT Pcyl8_ADC "Signal measured directly from sensor" UWORD CompuMethod_15 1 0 0 65535 ECU_ADDRESS 0x400006FF /end MEASUREMENT
/begin MEASUREMENT Pcyl8_Raw "After conversion to engineering units, before range checking" FLOAT32_IEEE CompuMethod_143 1 0 -1E+17 1E+17 ECU_ADDRESS 0x40000701 /end MEASUREMENT
/begin MEASUREMENT Pcyl8Idx "" UWORD CompuMethod_16 1 0 0 127.998 ECU_ADDRESS 0x40000705 /end MEASUREMENT
/begin MEASUREMENT PowerUpStatus "This indicates the power-up state of the system." UBYTE CompuMethod_183 1 0 0 1 ECU_ADDRESS 0x4000070B /end MEASUREMENT
/begin MEASUREMENT ThrottleAngleConversion "" FLOAT32_IEEE CompuMethod_2 1 0 -1E+17 1E+17 ECU_ADDRESS 0x40000718 /end MEASUREMENT
/begin MEASUREMENT ThrottleAngleConversionIdx "" UWORD CompuMethod_16 1 0 0 127.998 ECU_ADDRESS 0x4000071C /end MEASUREMENT
/begin MEASUREMENT ThrottleAngleConversionIn "" FLOAT32_IEEE CompuMethod_2 1 0 -1E+17 1E+17 ECU_ADDRESS 0x4000071E /end MEASUREMENT
/begin MEASUREMENT ThrottleCommand_deg "" FLOAT32_IEEE CompuMethod_2 1 0 -1E+17 1E+17 ECU_ADDRESS 0x40000722 /end MEASUREMENT
/begin MEASUREMENT VolumetricEff "The volumetric efficiency describes the ratio of the fresh air mass in the cylinder" FLOAT32_IEEE CompuMethod_163 1 0 -1E+17 1E+17 ECU_ADDRESS 0x4000072A /end MEASUREMENT
/begin MEASUREMENT VolumetricEffColIdx "The volumetric efficiency describes the ratio of the fresh air mass in the cylinder" UWORD CompuMethod_16 1 0 0 127.998 ECU_ADDRESS 0x4000072E /end MEASUREMENT
/begin MEASUREMENT VolumetricEffColIn "The volumetric efficiency describes the ratio of the fresh air mass in the cylinder" FLOAT32_IEEE CompuMethod_188 1 0 -1E+17 1E+17 ECU_ADDRESS 0x40000730 /end MEASUREMENT
/begin MEASUREMENT VolumetricEffRowIdx "The volumetric efficiency describes the ratio of the fresh air mass in the cylinder" UWORD CompuMethod_16 1 0 0 127.998 ECU_ADDRESS 0x40000734 /end MEASUREMENT
/begin MEASUREMENT VolumetricEffRowIn "The volumetric efficiency describes the ratio of the fresh air mass in the cylinder" FLOAT32_IEEE CompuMethod_162 1 0 -1E+17 1E+17 ECU_ADDRESS 0x40000736 /end MEASUREMENT
/begin CHARACTERISTIC FuelP_Default "This is the initial default value should the sensor be in fault on key-up.  Otherwise the sensors outputs the last value prior to faulting" VALUE 0x800007B5 RecordLayout_2 0 CompuMethod_143 -1E+17 1E+17 /end CHARACTERISTIC
/begin CHARACTERISTIC FuelP_FiltConst "Filter time constant" VALUE 0x800007B9 RecordLayout_2 0 CompuMethod_8 -1E+17 1E+17 /end CHARACTERISTIC
/begin CHARACTERISTIC FuelP_Max "Maximum allowable input, indicating short or open circuit" VALUE 0x800007BD RecordLayout_4 0 CompuMethod_15 0 65535 /end CHARACTERISTIC
/begin CHARACTERISTIC FuelP_Min "Minimum allowable input, indicating short or open circuit" VALUE 0x800007BF RecordLayout_4 0 CompuMethod_15 0 65535 /end CHARACTERISTIC
/begin CHARACTERISTIC FuelP_new "Override result of linear sensor characterization, in engineering units" VALUE 0x800007C1 RecordLayout_2 0 CompuMethod_143 -1E+17 1E+17 /end CHARACTERISTIC
/begin CHARACTERISTIC FuelP_ovr "" VALUE 0x800007C5 RecordLayout_3 0 CompuMethod_12 0 1 /end CHARACTERISTIC
/begin CHARACTERISTIC FuelPTbl "" CURVE 0x800007CE RecordLayout_2 0 CompuMethod_2 -1E+17 1E+17
 /begin AXIS_DESCR COM_AXIS FuelP_ADC CompuMethod_5 4 0 65535 AXIS_PTS_REF FuelPIdxArr /end AXIS_DESCR
/end CHARACTERISTIC
/begin CHARACTERISTIC FuelPump_new "" VALUE 0x800007DE RecordLayout_3 0 CompuMethod_13 0 1 /end CHARACTERISTIC
/begin CHARACTERISTIC FuelPump_ovr "" VALUE 0x800007DF RecordLayout_3 0 CompuMethod_12 0 1 /end CHARACTERISTIC
/begin CHARACTERISTIC FUELT_Default "This is the initial default value should the sensor be in fault on key-up.  Otherwise the sensors outputs the last value prior to faulting" VALUE 0x800007E0 RecordLayout_2 0 CompuMethod_144 -1E+17 1E+17 /end CHARACTERISTIC
/begin CHARACTERISTIC FUELT_FiltConst "Filter time constant" VALUE 0x800007E4 RecordLayout_2 0 CompuMethod_8 -1E+17 1E+17 /end CHARACTERISTIC
/begin CHARACTERISTIC FUELT_Max "Maximum allowable input, indicating short or open circuit" VALUE 0x800007E8 RecordLayout_4 0 CompuMethod_15 0 65535 /end CHARACTERISTIC
/begin CHARACTERISTIC FUELT_Min "Minimum allowable input, indicating short or open circuit" VALUE 0x800007EA RecordLayout_4 0 CompuMethod_15 0 65535 /end CHARACTERISTIC
/begin CHARACTERISTIC FUELT_new "Override result of linear sensor characterization, in engineering units" VALUE 0x800007EC RecordLayout_2 0 CompuMethod_144 -1E+17 1E+17 /end CHARACTERISTIC
/begin CHARACTERISTIC FUELT_ovr "" VALUE 0x800007F0 RecordLayout_3 0 CompuMethod_12 0 1 /end CHARACTERISTIC
/begin CHARACTERISTIC FUELTTbl "" CURVE 0x80000815 RecordLayout_2 0 CompuMethod_2 -1E+17 1E+17
 /begin AXIS_DESCR COM_AXIS FUELT_ADC CompuMethod_5 18 0 65535 AXIS_PTS_REF FUELTIdxArr /end AXIS_DESCR
/end CHARACTERISTIC
/begin CHARACTERISTIC H1DC_new "" VALUE 0x8000085D RecordLayout_2 0 CompuMethod_2 -1E+17 1E+17 /end CHARACTERISTIC
/begin CHARACTERISTIC H1DC_ovr "" VALUE 0x80000861 RecordLayout_3 0 CompuMethod_12 0 1 /end CHARACTERISTIC
/begin CHARACTERISTIC IAC_new "" VALUE 0x80000864 RecordLayout_2 0 CompuMethod_2 -1E+17 1E+17 /end CHARACTERISTIC
/begin CHARACTERISTIC IAC_ovr "" VALUE 0x80000868 RecordLayout_3 0 CompuMethod_12 0 1 /end CHARACTERISTIC
/begin CHARACTERISTIC IACFreq "" VALUE 0x80000869 RecordLayout_2 0 CompuMethod_2 -1E+17 1E+17 /end CHARACTERISTIC
/begin CHARACTERISTIC IgnitionAngleSign "" VALUE 0x800008B7 RecordLayout_2 0 CompuMethod_2 -1E+17 1E+17 /end CHARACTERISTIC
/begin CHARACTERISTIC IgnitionAngMap "ECU ignition angle described as angle before top dead centre based" MAP 0x800008BB RecordLayout_2 0 CompuMethod_161 -5.72958E+18 5.72958E+18
 /begin AXIS_DESCR COM_AXIS IgnitionAngColIn CompuMethod_162 18 -1E+17 1E+17 AXIS_PTS_REF IgnitionAngColIdxArr /end AXIS_DESCR
 /begin AXIS_DESCR COM_AXIS IgnitionAngRowIn CompuMethod_163 14 -1E+17 1E+17 AXIS_PTS_REF IgnitionAngRowIdxArr /end AXIS_DESCR
/end CHARACTERISTIC
/begin CHARACTERISTIC IgnitionEndAngle_new "" VAL_BLK 0x80000CE7 RecordLayout_2 0 CompuMethod_2 -1E+17 1E+17 MATRIX_DIM 8 1 1 /end CHARACTERISTIC
/begin CHARACTERISTIC IgnitionEndAngle_ovr "" VALUE 0x80000D07 RecordLayout_3 0 CompuMethod_12 0 1 /end CHARACTERISTIC
/begin CHARACTERISTIC IgnitionStartAngle_new "" VAL_BLK 0x80000D08 RecordLayout_2 0 CompuMethod_2 -1E+17 1E+17 MATRIX_DIM 8 1 1 /end CHARACTERISTIC
/begin CHARACTERISTIC IgnitionStartAngle_ovr "" VALUE 0x80000D28 RecordLayout_3 0 CompuMethod_12 0 1 /end CHARACTERISTIC
/begin CHARACTERISTIC IMP_Default "This is the initial default value should the sensor be in fault on key-up.  Otherwise the sensors outputs the last value prior to faulting" VALUE 0x80000D29 RecordLayout_2 0 CompuMethod_143 -1E+17 1E+17 /end CHARACTERISTIC
/begin CHARACTERISTIC IMP_FiltConst "Filter time constant" VALUE 0x80000D2D RecordLayout_2 0 CompuMethod_8 -1E+17 1E+17 /end CHARACTERISTIC
/begin CHARACTERISTIC IMP_Max "Maximum allowable input, indicating short or open circuit" VALUE 0x80000D31 RecordLayout_4 0 CompuMethod_15 0 65535 /end CHARACTERISTIC
/begin CHARACTERISTIC IMP_Min "Minimum allowable input, indicating short or open circuit" VALUE 0x80000D33 RecordLayout_4 0 CompuMethod_15 0 65535 /end CHARACTERISTIC
/begin CHARACTERISTIC IMP_new "Override result of linear sensor characterization, in engineering units" VALUE 0x80000D35 RecordLayout_2 0 CompuMethod_143 -1E+17 1E+17 /end CHARACTERISTIC
/begin CHARACTERISTIC IMP_ovr "" VALUE 0x80000D39 RecordLayout_3 0 CompuMethod_12 0 1 /end CHARACTERISTIC
/begin CHARACTERISTIC IMPTbl "" CURVE 0x80000D42 RecordLayout_2 0 CompuMethod_2 -1E+17 1E+17
 /begin AXIS_DESCR COM_AXIS IMP_ADC CompuMethod_5 4 0 65535 AXIS_PTS_REF IMPIdxArr /end AXIS_DESCR
/end CHARACTERISTIC
/begin CHARACTERISTIC IMT_Default "This is the initial default value should the sensor be in fault on key-up.  Otherwise the sensors outputs the last value prior to faulting" VALUE 0x80000D52 RecordLayout_2 0 CompuMethod_144 -1E+17 1E+17 /end CHARACTERISTIC
/begin CHARACTERISTIC IMT_FiltConst "Filter time constant" VALUE 0x80000D56 RecordLayout_2 0 CompuMethod_8 -1E+17 1E+17 /end CHARACTERISTIC
/begin CHARACTERISTIC IMT_Max "Maximum allowable input, indicating short or open circuit" VALUE 0x80000D5A RecordLayout_4 0 CompuMethod_15 0 65535 /end CHARACTERISTIC
/begin CHARACTERISTIC IMT_Min "Minimum allowable input, indicating short or open circuit" VALUE 0x80000D5C RecordLayout_4 0 CompuMethod_15 0 65535 /end CHARACTERISTIC
/begin CHARACTERISTIC IMT_new "Override result of linear sensor characterization, in engineering units" VALUE 0x80000D5E RecordLayout_2 0 CompuMethod_144 -1E+17 1E+17 /end CHARACTERISTIC
/begin CHARACTERISTIC IMT_ovr "" VALUE 0x80000D62 RecordLayout_3 0 CompuMethod_12 0 1 /end CHARACTERISTIC
/begin CHARACTERISTIC IMTTbl "" CURVE 0x80000D89 RecordLayout_2 0 CompuMethod_2 -1E+17 1E+17
 /begin AXIS_DESCR COM_AXIS IMT_ADC CompuMethod_5 19 0 65535 AXIS_PTS_REF IMTIdxArr /end AXIS_DESCR
/end CHARACTERISTIC
/begin CHARACTERISTIC Injection._._0 "" VALUE 0x80000DD5 RecordLayout_3 0 CompuMethod_21 0 1 /end CHARACTERISTIC
/begin CHARACTERISTIC Injection._._1 "" VALUE 0x80000DD6 RecordLayout_3 0 CompuMethod_21 0 1 /end CHARACTERISTIC
/begin CHARACTERISTIC Injection._._2 "" VALUE 0x80000DD7 RecordLayout_3 0 CompuMethod_21 0 1 /end CHARACTERISTIC
/begin CHARACTERISTIC Injection._._3 "" VALUE 0x80000DD8 RecordLayout_3 0 CompuMethod_21 0 1 /end CHARACTERISTIC
/begin CHARACTERISTIC Injection._._4 "" VALUE 0x80000DD9 RecordLayout_3 0 CompuMethod_21 0 1 /end CHARACTERISTIC
/begin CHARACTERISTIC Injection._._5 "" VALUE 0x80000DDA RecordLayout_3 0 CompuMethod_21 0 1 /end CHARACTERISTIC
/begin CHARACTERISTIC Injection._._6 "" VALUE 0x80000DDB RecordLayout_3 0 CompuMethod_21 0 1 /end CHARACTERISTIC
/begin CHARACTERISTIC Injection._._7 "" VALUE 0x80000DDC RecordLayout_3 0 CompuMethod_21 0 1 /end CHARACTERISTIC
/begin CHARACTERISTIC InjectionTime_new "" VAL_BLK 0x80000DDD RecordLayout_2 0 CompuMethod_2 -1E+17 1E+17 MATRIX_DIM 8 1 1 /end CHARACTERISTIC
/begin CHARACTERISTIC InjectionTime_ovr "" VALUE 0x80000DFD RecordLayout_3 0 CompuMethod_12 0 1 /end CHARACTERISTIC
/begin CHARACTERISTIC InjectionTimeMap "Duration of injection signal without time delay to reach the desired injected fuel " MAP 0x80000E6A RecordLayout_2 0 CompuMethod_165 -1E+17 1E+17
 /begin AXIS_DESCR COM_AXIS InjectionTimeColIn CompuMethod_166 27 -1E+17 1E+17 AXIS_PTS_REF InjectionTimeColIdxArr /end AXIS_DESCR
 /begin AXIS_DESCR COM_AXIS InjectionTimeRowIn CompuMethod_167 27 -1E+17 1E+17 AXIS_PTS_REF InjectionTimeRowIdxArr /end AXIS_DESCR
/end CHARACTERISTIC
/begin CHARACTERISTIC InjectorElectricalOffset "Extra duration added to each generated pulse to account for the injector turn on and turn off time" VALUE 0x80001A3A RecordLayout_7 0 CompuMethod_169 0 4294970000 /end CHARACTERISTIC
/begin CHARACTERISTIC InjectorMaxDuration "Maximum duration for an injector pulse.  Must be a multiple of 5ms" VALUE 0x80001A3E RecordLayout_7 0 CompuMethod_169 0 4294970000 /end CHARACTERISTIC
/begin CHARACTERISTIC InjectorPeakDuration "For a low-impedance injector using the peak-and-hold driver, the duration of the peak portion of the total injector pulse" VALUE 0x80001A42 RecordLayout_7 0 CompuMethod_169 0 4294970000 /end CHARACTERISTIC
/begin CHARACTERISTIC INJStartAngle "" VAL_BLK 0x80001A46 RecordLayout_2 0 CompuMethod_2 -1E+17 1E+17 MATRIX_DIM 8 1 1 /end CHARACTERISTIC
/begin CHARACTERISTIC Knock_SensorSelect "Vista Knock Sensor Select for Knock" VAL_BLK 0x80001A6C RecordLayout_3 0 CompuMethod_1 0 1 MATRIX_DIM 6 1 1 /end CHARACTERISTIC
/begin CHARACTERISTIC KnockRetardTbl "" CURVE 0x80001A8E RecordLayout_2 0 CompuMethod_153 -1E+17 1E+17
 /begin AXIS_DESCR COM_AXIS KnockRetardIn CompuMethod_2 7 -1E+17 1E+17 AXIS_PTS_REF KnockRetardIdxArr /end AXIS_DESCR
/end CHARACTERISTIC
/begin CHARACTERISTIC LIG_AdaptK "" VALUE 0x80001AAA RecordLayout_2 0 CompuMethod_2 -1E+17 1E+17 /end CHARACTERISTIC
/begin CHARACTERISTIC LIG_FFTbl "" CURVE 0x80001ACA RecordLayout_2 0 CompuMethod_163 0 1
 /begin AXIS_DESCR COM_AXIS LIG_FFIn CompuMethod_173 7 0 9.5493E+17 AXIS_PTS_REF LIG_FFIdxArr /end AXIS_DESCR
/end CHARACTERISTIC
/begin CHARACTERISTIC LIG_Imax "" VALUE 0x80001AE6 RecordLayout_2 0 CompuMethod_2 -1E+17 1E+17 /end CHARACTERISTIC
/begin CHARACTERISTIC LIG_Imin "" VALUE 0x80001AEA RecordLayout_2 0 CompuMethod_2 -1E+17 1E+17 /end CHARACTERISTIC
/begin CHARACTERISTIC LIG_Ki "" VALUE 0x80001AEE RecordLayout_2 0 CompuMethod_174 -1E+17 1E+17 /end CHARACTERISTIC
/begin CHARACTERISTIC LIG_Kp "" VALUE 0x80001AF2 RecordLayout_2 0 CompuMethod_174 -1E+17 1E+17 /end CHARACTERISTIC
/begin CHARACTERISTIC LIG_max "" VALUE 0x80001AF6 RecordLayout_2 0 CompuMethod_2 -1E+17 1E+17 /end CHARACTERISTIC
/begin CHARACTERISTIC LIG_min "" VALUE 0x80001AFA RecordLayout_2 0 CompuMethod_2 -1E+17 1E+17 /end CHARACTERISTIC
/begin CHARACTERISTIC LoadCalibrationError "Debug value for LoadCalibrationError" VALUE 0x80001AFE RecordLayout_4 0 CompuMethod_26 0 65535 /end CHARACTERISTIC
/begin CHARACTERISTIC MAFSource "" VALUE 0x80001B00 RecordLayout_3 0 CompuMethod_175 0 255 /end CHARACTERISTIC
/begin CHARACTERISTIC MIL_new "" VALUE 0x80001B03 RecordLayout_3 0 CompuMethod_13 0 1 /end CHARACTERISTIC
/begin CHARACTERISTIC MIL_ovr "" VALUE 0x80001B04 RecordLayout_3 0 CompuMethod_12 0 1 /end CHARACTERISTIC
/begin CHARACTERISTIC MinThrottleAng_deg "" VALUE 0x80001B05 RecordLayout_2 0 CompuMethod_2 -1E+17 1E+17 /end CHARACTERISTIC
/begin CHARACTERISTIC MPRD_new "Directly Override Main Power Relay" VALUE 0x80001B0A RecordLayout_3 0 CompuMethod_179 0 1 /end CHARACTERISTIC
/begin CHARACTERISTIC MPRD_ovr "" VALUE 0x80001B0B RecordLayout_3 0 CompuMethod_12 0 1 /end CHARACTERISTIC
/begin CHARACTERISTIC NonVolatileRestoreOnFirstStartup "Selects whether to restore from factory defaults the first time an application boots" VALUE 0x80001B0C RecordLayout_3 0 CompuMethod_180 0 1 /end CHARACTERISTIC
/begin CHARACTERISTIC NonVolatileRestoreOnStartup "Selects whether to restore from factory defaults on next startup" VALUE 0x80001B0D RecordLayout_3 0 CompuMethod_180 0 1 /end CHARACTERISTIC
/begin CHARACTERISTIC O2A_Default "This is the initial default value should the sensor be in fault on key-up.  Otherwise the sensors outputs the last value prior to faulting" VALUE 0x80001B0E RecordLayout_2 0 CompuMethod_163 -1E+17 1E+17 /end CHARACTERISTIC
/begin CHARACTERISTIC O2A_FiltConst "Filter time constant" VALUE 0x80001B12 RecordLayout_2 0 CompuMethod_8 -1E+17 1E+17 /end CHARACTERISTIC
/begin CHARACTERISTIC O2A_Max "Maximum allowable input, indicating short or open circuit" VALUE 0x80001B16 RecordLayout_4 0 CompuMethod_15 0 65535 /end CHARACTERISTIC
/begin CHARACTERISTIC O2A_Min "Minimum allowable input, indicating short or open circuit" VALUE 0x80001B18 RecordLayout_4 0 CompuMethod_15 0 65535 /end CHARACTERISTIC
/begin CHARACTERISTIC O2A_new "Override result of linear sensor characterization, in engineering units" VALUE 0x80001B1A RecordLayout_2 0 CompuMethod_163 -1E+17 1E+17 /end CHARACTERISTIC
/begin CHARACTERISTIC O2A_ovr "" VALUE 0x80001B1E RecordLayout_3 0 CompuMethod_12 0 1 /end CHARACTERISTIC
/begin CHARACTERISTIC O2ATbl "" CURVE 0x80001B37 RecordLayout_2 0 CompuMethod_2 -1E+17 1E+17
 /begin AXIS_DESCR COM_AXIS O2A_ADC CompuMethod_5 12 0 65535 AXIS_PTS_REF O2AIdxArr /end AXIS_DESCR
/end CHARACTERISTIC
/begin CHARACTERISTIC O2B_Default "This is the initial default value should the sensor be in fault on key-up.  Otherwise the sensors outputs the last value prior to faulting" VALUE 0x80001B67 RecordLayout_2 0 CompuMethod_163 -1E+17 1E+17 /end CHARACTERISTIC
/begin CHARACTERISTIC O2B_FiltConst "Filter time constant" VALUE 0x80001B6B RecordLayout_2 0 CompuMethod_8 -1E+17 1E+17 /end CHARACTERISTIC
/begin CHARACTERISTIC O2B_Max "Maximum allowable input, indicating short or open circuit" VALUE 0x80001B6F RecordLayout_4 0 CompuMethod_15 0 65535 /end CHARACTERISTIC
/begin CHARACTERISTIC O2B_Min "Minimum allowable input, indicating short or open circuit" VALUE 0x80001B71 RecordLayout_4 0 CompuMethod_15 0 65535 /end CHARACTERISTIC
/begin CHARACTERISTIC O2B_new "Override result of linear sensor characterization, in engineering units" VALUE 0x80001B73 RecordLayout_2 0 CompuMethod_163 -1E+17 1E+17 /end CHARACTERISTIC
/begin CHARACTERISTIC O2B_ovr "" VALUE 0x80001B77 RecordLayout_3 0 CompuMethod_12 0 1 /end CHARACTERISTIC
/begin CHARACTERISTIC O2BTbl "" CURVE 0x80001B90 RecordLayout_2 0 CompuMethod_2 -1E+17 1E+17
 /begin AXIS_DESCR COM_AXIS O2B_ADC CompuMethod_5 12 0 65535 AXIS_PTS_REF O2BIdxArr /end AXIS_DESCR
/end CHARACTERISTIC
/begin CHARACTERISTIC O2C_Default "This is the initial default value should the sensor be in fault on key-up.  Otherwise the sensors outputs the last value prior to faulting" VALUE 0x80001BC0 RecordLayout_2 0 CompuMethod_163 -1E+17 1E+17 /end CHARACTERISTIC
/begin CHARACTERISTIC O2C_FiltConst "Filter time constant" VALUE 0x80001BC4 RecordLayout_2 0 CompuMethod_8 -1E+17 1E+17 /end CHARACTERISTIC
/begin CHARACTERISTIC O2C_Max "Maximum allowable input, indicating short or open circuit" VALUE 0x80001BC8 RecordLayout_4 0 CompuMethod_15 0 65535 /end CHARACTERISTIC
/begin CHARACTERISTIC O2C_Min "Minimum allowable input, indicating short or open circuit" VALUE 0x80001BCA RecordLayout_4 0 CompuMethod_15 0 65535 /end CHARACTERISTIC
/begin CHARACTERISTIC O2C_new "Override result of linear sensor characterization, in engineering units" VALUE 0x80001BCC RecordLayout_2 0 CompuMethod_163 -1E+17 1E+17 /end CHARACTERISTIC
/begin CHARACTERISTIC O2C_ovr "" VALUE 0x80001BD0 RecordLayout_3 0 CompuMethod_12 0 1 /end CHARACTERISTIC
/begin CHARACTERISTIC O2CTbl "" CURVE 0x80001BE9 RecordLayout_2 0 CompuMethod_2 -1E+17 1E+17
 /begin AXIS_DESCR COM_AXIS O2C_ADC CompuMethod_5 12 0 65535 AXIS_PTS_REF O2CIdxArr /end AXIS_DESCR
/end CHARACTERISTIC
/begin CHARACTERISTIC O2D_Default "This is the initial default value should the sensor be in fault on key-up.  Otherwise the sensors outputs the last value prior to faulting" VALUE 0x80001C19 RecordLayout_2 0 CompuMethod_163 -1E+17 1E+17 /end CHARACTERISTIC
/begin CHARACTERISTIC O2D_FiltConst "Filter time constant" VALUE 0x80001C1D RecordLayout_2 0 CompuMethod_8 -1E+17 1E+17 /end CHARACTERISTIC
/begin CHARACTERISTIC O2D_Max "Maximum allowable input, indicating short or open circuit" VALUE 0x80001C21 RecordLayout_4 0 CompuMethod_15 0 65535 /end CHARACTERISTIC
/begin CHARACTERISTIC O2D_Min "Minimum allowable input, indicating short or open circuit" VALUE 0x80001C23 RecordLayout_4 0 CompuMethod_15 0 65535 /end CHARACTERISTIC
/begin CHARACTERISTIC O2D_new "Override result of linear sensor characterization, in engineering units" VALUE 0x80001C25 RecordLayout_2 0 CompuMethod_163 -1E+17 1E+17 /end CHARACTERISTIC
/begin CHARACTERISTIC O2D_ovr "" VALUE 0x80001C29 RecordLayout_3 0 CompuMethod_12 0 1 /end CHARACTERISTIC
/begin CHARACTERISTIC O2DTbl "" CURVE 0x80001C42 RecordLayout_2 0 CompuMethod_2 -1E+17 1E+17
 /begin AXIS_DESCR COM_AXIS O2D_ADC CompuMethod_5 12 0 65535 AXIS_PTS_REF O2DIdxArr /end AXIS_DESCR
/end CHARACTERISTIC
/begin CHARACTERISTIC OilP_Default "This is the initial default value should the sensor be in fault on key-up.  Otherwise the sensors outputs the last value prior to faulting" VALUE 0x80001C72 RecordLayout_2 0 CompuMethod_143 -1E+17 1E+17 /end CHARACTERISTIC
/begin CHARACTERISTIC OilP_FiltConst "Filter time constant" VALUE 0x80001C76 RecordLayout_2 0 CompuMethod_8 -1E+17 1E+17 /end CHARACTERISTIC
/begin CHARACTERISTIC OilP_Max "Maximum allowable input, indicating short or open circuit" VALUE 0x80001C7A RecordLayout_4 0 CompuMethod_15 0 65535 /end CHARACTERISTIC
/begin CHARACTERISTIC OilP_Min "Minimum allowable input, indicating short or open circuit" VALUE 0x80001C7C RecordLayout_4 0 CompuMethod_15 0 65535 /end CHARACTERISTIC
/begin CHARACTERISTIC OilP_new "Override result of linear sensor characterization, in engineering units" VALUE 0x80001C7E RecordLayout_2 0 CompuMethod_143 -1E+17 1E+17 /end CHARACTERISTIC
/begin CHARACTERISTIC OilP_ovr "" VALUE 0x80001C82 RecordLayout_3 0 CompuMethod_12 0 1 /end CHARACTERISTIC
/begin CHARACTERISTIC OilPTbl "" CURVE 0x80001C9B RecordLayout_2 0 CompuMethod_2 -1E+17 1E+17
 /begin AXIS_DESCR COM_AXIS OilP_ADC CompuMethod_5 12 0 65535 AXIS_PTS_REF OilPIdxArr /end AXIS_DESCR
/end CHARACTERISTIC
/begin CHARACTERISTIC Pcyl1_Default "This is the initial default value should the sensor be in fault on key-up.  Otherwise the sensors outputs the last value prior to faulting" VALUE 0x80001CCB RecordLayout_2 0 CompuMethod_143 -1E+17 1E+17 /end CHARACTERISTIC
/begin CHARACTERISTIC Pcyl1_FiltConst "Filter time constant" VALUE 0x80001CCF RecordLayout_2 0 CompuMethod_8 -1E+17 1E+17 /end CHARACTERISTIC
/begin CHARACTERISTIC Pcyl1_Max "Maximum allowable input, indicating short or open circuit" VALUE 0x80001CD3 RecordLayout_4 0 CompuMethod_15 0 65535 /end CHARACTERISTIC
/begin CHARACTERISTIC Pcyl1_Min "Minimum allowable input, indicating short or open circuit" VALUE 0x80001CD5 RecordLayout_4 0 CompuMethod_15 0 65535 /end CHARACTERISTIC
/begin CHARACTERISTIC Pcyl1_new "Override result of linear sensor characterization, in engineering units" VALUE 0x80001CD7 RecordLayout_2 0 CompuMethod_143 -1E+17 1E+17 /end CHARACTERISTIC
/begin CHARACTERISTIC Pcyl1_ovr "" VALUE 0x80001CDB RecordLayout_3 0 CompuMethod_12 0 1 /end CHARACTERISTIC
/begin CHARACTERISTIC Pcyl1Tbl "" CURVE 0x80001CF4 RecordLayout_2 0 CompuMethod_2 -1E+17 1E+17
 /begin AXIS_DESCR COM_AXIS Pcyl1_ADC CompuMethod_5 12 0 65535 AXIS_PTS_REF Pcyl1IdxArr /end AXIS_DESCR
/end CHARACTERISTIC
/begin CHARACTERISTIC Pcyl2_Default "This is the initial default value should the sensor be in fault on key-up.  Otherwise the sensors outputs the last value prior to faulting" VALUE 0x80001D24 RecordLayout_2 0 CompuMethod_143 -1E+17 1E+17 /end CHARACTERISTIC
/begin CHARACTERISTIC Pcyl2_FiltConst "Filter time constant" VALUE 0x80001D28 RecordLayout_2 0 CompuMethod_8 -1E+17 1E+17 /end CHARACTERISTIC
/begin CHARACTERISTIC Pcyl2_Max "Maximum allowable input, indicating short or open circuit" VALUE 0x80001D2C RecordLayout_4 0 CompuMethod_15 0 65535 /end CHARACTERISTIC
/begin CHARACTERISTIC Pcyl2_Min "Minimum allowable input, indicating short or open circuit" VALUE 0x80001D2E RecordLayout_4 0 CompuMethod_15 0 65535 /end CHARACTERISTIC
/begin CHARACTERISTIC Pcyl2_new "Override result of linear sensor characterization, in engineering units" VALUE 0x80001D30 RecordLayout_2 0 CompuMethod_143 -1E+17 1E+17 /end CHARACTERISTIC
/begin CHARACTERISTIC Pcyl2_ovr "" VALUE 0x80001D34 RecordLayout_3 0 CompuMethod_12 0 1 /end CHARACTERISTIC
/begin CHARACTERISTIC Pcyl2Tbl "" CURVE 0x80001D4D RecordLayout_2 0 CompuMethod_2 -1E+17 1E+17
 /begin AXIS_DESCR COM_AXIS Pcyl2_ADC CompuMethod_5 12 0 65535 AXIS_PTS_REF Pcyl2IdxArr /end AXIS_DESCR
/end CHARACTERISTIC
/begin CHARACTERISTIC Pcyl3_Default "This is the initial default value should the sensor be in fault on key-up.  Otherwise the sensors outputs the last value prior to faulting" VALUE 0x80001D7D RecordLayout_2 0 CompuMethod_143 -1E+17 1E+17 /end CHARACTERISTIC
/begin CHARACTERISTIC Pcyl3_FiltConst "Filter time constant" VALUE 0x80001D81 RecordLayout_2 0 CompuMethod_8 -1E+17 1E+17 /end CHARACTERISTIC
/begin CHARACTERISTIC Pcyl3_Max "Maximum allowable input, indicating short or open circuit" VALUE 0x80001D85 RecordLayout_4 0 CompuMethod_15 0 65535 /end CHARACTERISTIC
/begin CHARACTERISTIC Pcyl3_Min "Minimum allowable input, indicating short or open circuit" VALUE 0x80001D87 RecordLayout_4 0 CompuMethod_15 0 65535 /end CHARACTERISTIC
/begin CHARACTERISTIC Pcyl3_new "Override result of linear sensor characterization, in engineering units" VALUE 0x80001D89 RecordLayout_2 0 CompuMethod_143 -1E+17 1E+17 /end CHARACTERISTIC
/begin CHARACTERISTIC Pcyl3_ovr "" VALUE 0x80001D8D RecordLayout_3 0 CompuMethod_12 0 1 /end CHARACTERISTIC
/begin CHARACTERISTIC Pcyl3Tbl "" CURVE 0x80001DA6 RecordLayout_2 0 CompuMethod_2 -1E+17 1E+17
 /begin AXIS_DESCR COM_AXIS Pcyl3_ADC CompuMethod_5 12 0 65535 AXIS_PTS_REF Pcyl3IdxArr /end AXIS_DESCR
/end CHARACTERISTIC
/begin CHARACTERISTIC Pcyl4_Default "This is the initial default value should the sensor be in fault on key-up.  Otherwise the sensors outputs the last value prior to faulting" VALUE 0x80001DD6 RecordLayout_2 0 CompuMethod_143 -1E+17 1E+17 /end CHARACTERISTIC
/begin CHARACTERISTIC Pcyl4_FiltConst "Filter time constant" VALUE 0x80001DDA RecordLayout_2 0 CompuMethod_8 -1E+17 1E+17 /end CHARACTERISTIC
/begin CHARACTERISTIC Pcyl4_Max "Maximum allowable input, indicating short or open circuit" VALUE 0x80001DDE RecordLayout_4 0 CompuMethod_15 0 65535 /end CHARACTERISTIC
/begin CHARACTERISTIC Pcyl4_Min "Minimum allowable input, indicating short or open circuit" VALUE 0x80001DE0 RecordLayout_4 0 CompuMethod_15 0 65535 /end CHARACTERISTIC
/begin CHARACTERISTIC Pcyl4_new "Override result of linear sensor characterization, in engineering units" VALUE 0x80001DE2 RecordLayout_2 0 CompuMethod_143 -1E+17 1E+17 /end CHARACTERISTIC
/begin CHARACTERISTIC Pcyl4_ovr "" VALUE 0x80001DE6 RecordLayout_3 0 CompuMethod_12 0 1 /end CHARACTERISTIC
/begin CHARACTERISTIC Pcyl4Tbl "" CURVE 0x80001DFF RecordLayout_2 0 CompuMethod_2 -1E+17 1E+17
 /begin AXIS_DESCR COM_AXIS Pcyl4_ADC CompuMethod_5 12 0 65535 AXIS_PTS_REF Pcyl4IdxArr /end AXIS_DESCR
/end CHARACTERISTIC
/begin CHARACTERISTIC Pcyl5_Default "This is the initial default value should the sensor be in fault on key-up.  Otherwise the sensors outputs the last value prior to faulting" VALUE 0x80001E2F RecordLayout_2 0 CompuMethod_143 -1E+17 1E+17 /end CHARACTERISTIC
/begin CHARACTERISTIC Pcyl5_FiltConst "Filter time constant" VALUE 0x80001E33 RecordLayout_2 0 CompuMethod_8 -1E+17 1E+17 /end CHARACTERISTIC
/begin CHARACTERISTIC Pcyl5_Max "Maximum allowable input, indicating short or open circuit" VALUE 0x80001E37 RecordLayout_4 0 CompuMethod_15 0 65535 /end CHARACTERISTIC
/begin CHARACTERISTIC Pcyl5_Min "Minimum allowable input, indicating short or open circuit" VALUE 0x80001E39 RecordLayout_4 0 CompuMethod_15 0 65535 /end CHARACTERISTIC
/begin CHARACTERISTIC Pcyl5_new "Override result of linear sensor characterization, in engineering units" VALUE 0x80001E3B RecordLayout_2 0 CompuMethod_143 -1E+17 1E+17 /end CHARACTERISTIC
/begin CHARACTERISTIC Pcyl5_ovr "" VALUE 0x80001E3F RecordLayout_3 0 CompuMethod_12 0 1 /end CHARACTERISTIC
/begin CHARACTERISTIC Pcyl5Tbl "" CURVE 0x80001E58 RecordLayout_2 0 CompuMethod_2 -1E+17 1E+17
 /begin AXIS_DESCR COM_AXIS Pcyl5_ADC CompuMethod_5 12 0 65535 AXIS_PTS_REF Pcyl5IdxArr /end AXIS_DESCR
/end CHARACTERISTIC
/begin CHARACTERISTIC Pcyl6_Default "This is the initial default value should the sensor be in fault on key-up.  Otherwise the sensors outputs the last value prior to faulting" VALUE 0x80001E88 RecordLayout_2 0 CompuMethod_143 -1E+17 1E+17 /end CHARACTERISTIC
/begin CHARACTERISTIC Pcyl6_FiltConst "Filter time constant" VALUE 0x80001E8C RecordLayout_2 0 CompuMethod_8 -1E+17 1E+17 /end CHARACTERISTIC
/begin CHARACTERISTIC Pcyl6_Max "Maximum allowable input, indicating short or open circuit" VALUE 0x80001E90 RecordLayout_4 0 CompuMethod_15 0 65535 /end CHARACTERISTIC
/begin CHARACTERISTIC Pcyl6_Min "Minimum allowable input, indicating short or open circuit" VALUE 0x80001E92 RecordLayout_4 0 CompuMethod_15 0 65535 /end CHARACTERISTIC
/begin CHARACTERISTIC Pcyl6_new "Override result of linear sensor characterization, in engineering units" VALUE 0x80001E94 RecordLayout_2 0 CompuMethod_143 -1E+17 1E+17 /end CHARACTERISTIC
/begin CHARACTERISTIC Pcyl6_ovr "" VALUE 0x80001E98 RecordLayout_3 0 CompuMethod_12 0 1 /end CHARACTERISTIC
/begin CHARACTERISTIC Pcyl6Tbl "" CURVE 0x80001EB1 RecordLayout_2 0 CompuMethod_2 -1E+17 1E+17
 /begin AXIS_DESCR COM_AXIS Pcyl6_ADC CompuMethod_5 12 0 65535 AXIS_PTS_REF Pcyl6IdxArr /end AXIS_DESCR
/end CHARACTERISTIC
/begin CHARACTERISTIC Pcyl7_Default "This is the initial default value should the sensor be in fault on key-up.  Otherwise the sensors outputs the last value prior to faulting" VALUE 0x80001EE1 RecordLayout_2 0 CompuMethod_143 -1E+17 1E+17 /end CHARACTERISTIC
/begin CHARACTERISTIC Pcyl7_FiltConst "Filter time constant" VALUE 0x80001EE5 RecordLayout_2 0 CompuMethod_8 -1E+17 1E+17 /end CHARACTERISTIC
/begin CHARACTERISTIC Pcyl7_Max "Maximum allowable input, indicating short or open circuit" VALUE 0x80001EE9 RecordLayout_4 0 CompuMethod_15 0 65535 /end CHARACTERISTIC
/begin CHARACTERISTIC Pcyl7_Min "Minimum allowable input, indicating short or open circuit" VALUE 0x80001EEB RecordLayout_4 0 CompuMethod_15 0 65535 /end CHARACTERISTIC
/begin CHARACTERISTIC Pcyl7_new "Override result of linear sensor characterization, in engineering units" VALUE 0x80001EED RecordLayout_2 0 CompuMethod_143 -1E+17 1E+17 /end CHARACTERISTIC
/begin CHARACTERISTIC Pcyl7_ovr "" VALUE 0x80001EF1 RecordLayout_3 0 CompuMethod_12 0 1 /end CHARACTERISTIC
/begin CHARACTERISTIC Pcyl7Tbl "" CURVE 0x80001F0A RecordLayout_2 0 CompuMethod_2 -1E+17 1E+17
 /begin AXIS_DESCR COM_AXIS Pcyl7_ADC CompuMethod_5 12 0 65535 AXIS_PTS_REF Pcyl7IdxArr /end AXIS_DESCR
/end CHARACTERISTIC
/begin CHARACTERISTIC Pcyl8_Default "This is the initial default value should the sensor be in fault on key-up.  Otherwise the sensors outputs the last value prior to faulting" VALUE 0x80001F3A RecordLayout_2 0 CompuMethod_143 -1E+17 1E+17 /end CHARACTERISTIC
/begin CHARACTERISTIC Pcyl8_FiltConst "Filter time constant" VALUE 0x80001F3E RecordLayout_2 0 CompuMethod_8 -1E+17 1E+17 /end CHARACTERISTIC
/begin CHARACTERISTIC Pcyl8_Max "Maximum allowable input, indicating short or open circuit" VALUE 0x80001F42 RecordLayout_4 0 CompuMethod_15 0 65535 /end CHARACTERISTIC
/begin CHARACTERISTIC Pcyl8_Min "Minimum allowable input, indicating short or open circuit" VALUE 0x80001F44 RecordLayout_4 0 CompuMethod_15 0 65535 /end CHARACTERISTIC
/begin CHARACTERISTIC Pcyl8_new "Override result of linear sensor characterization, in engineering units" VALUE 0x80001F46 RecordLayout_2 0 CompuMethod_143 -1E+17 1E+17 /end CHARACTERISTIC
/begin CHARACTERISTIC Pcyl8_ovr "" VALUE 0x80001F4A RecordLayout_3 0 CompuMethod_12 0 1 /end CHARACTERISTIC
/begin CHARACTERISTIC Pcyl8Tbl "" CURVE 0x80001F63 RecordLayout_2 0 CompuMethod_2 -1E+17 1E+17
 /begin AXIS_DESCR COM_AXIS Pcyl8_ADC CompuMethod_5 12 0 65535 AXIS_PTS_REF Pcyl8IdxArr /end AXIS_DESCR
/end CHARACTERISTIC
/begin CHARACTERISTIC RestoreNVFactoryDefaults "Restores NonVolatile Memory to Factory Defaults" VALUE 0x80001F96 RecordLayout_3 0 CompuMethod_185 0 1 /end CHARACTERISTIC
/begin CHARACTERISTIC SaveCalibrationError "Debug value for SaveCalibrationError" VALUE 0x80001F97 RecordLayout_4 0 CompuMethod_26 0 65535 /end CHARACTERISTIC
/begin CHARACTERISTIC Spark._._0 "" VALUE 0x80001F9B RecordLayout_3 0 CompuMethod_21 0 1 /end CHARACTERISTIC
/begin CHARACTERISTIC Spark._._1 "" VALUE 0x80001F9C RecordLayout_3 0 CompuMethod_21 0 1 /end CHARACTERISTIC
/begin CHARACTERISTIC Spark._._2 "" VALUE 0x80001F9D RecordLayout_3 0 CompuMethod_21 0 1 /end CHARACTERISTIC
/begin CHARACTERISTIC Spark._._3 "" VALUE 0x80001F9E RecordLayout_3 0 CompuMethod_21 0 1 /end CHARACTERISTIC
/begin CHARACTERISTIC Spark._._4 "" VALUE 0x80001F9F RecordLayout_3 0 CompuMethod_21 0 1 /end CHARACTERISTIC
/begin CHARACTERISTIC Spark._._5 "" VALUE 0x80001FA0 RecordLayout_3 0 CompuMethod_21 0 1 /end CHARACTERISTIC
/begin CHARACTERISTIC Spark._._6 "" VALUE 0x80001FA1 RecordLayout_3 0 CompuMethod_21 0 1 /end CHARACTERISTIC
/begin CHARACTERISTIC Spark._._7 "" VALUE 0x80001FA2 RecordLayout_3 0 CompuMethod_21 0 1 /end CHARACTERISTIC
/begin CHARACTERISTIC SparkDuration_msec "" VALUE 0x80001FA3 RecordLayout_2 0 CompuMethod_2 -1E+17 1E+17 /end CHARACTERISTIC
/begin CHARACTERISTIC SparkMaxDuration "Maximum duration for a spark pulse.  Must be a multiple of 5ms" VALUE 0x80001FA7 RecordLayout_7 0 CompuMethod_169 0 4294970000 /end CHARACTERISTIC
/begin CHARACTERISTIC StoechAirFuelRatio "Ratio of theoretically required air mass to fuel mass" VALUE 0x80001FAF RecordLayout_2 0 CompuMethod_2 -1E+17 1E+17 /end CHARACTERISTIC
/begin CHARACTERISTIC StoreNV "Stores RAM-Shadowed memory to serial EEPROM" VALUE 0x80001FB3 RecordLayout_3 0 CompuMethod_187 0 1 /end CHARACTERISTIC
/begin CHARACTERISTIC TachStartAngle "" VALUE 0x80001FB4 RecordLayout_2 0 CompuMethod_2 -1E+17 1E+17 /end CHARACTERISTIC
/begin CHARACTERISTIC Throttle_per_APP "" VALUE 0x80001FB8 RecordLayout_2 0 CompuMethod_2 -1E+17 1E+17 /end CHARACTERISTIC
/begin CHARACTERISTIC ThrottleAngleConversionTbl "" CURVE 0x80001FCC RecordLayout_2 0 CompuMethod_2 -1E+17 1E+17
 /begin AXIS_DESCR COM_AXIS ThrottleAngleConversionIn CompuMethod_2 4 -1E+17 1E+17 AXIS_PTS_REF ThrottleAngleConversionIdxArr /end AXIS_DESCR
/end CHARACTERISTIC
/begin CHARACTERISTIC VolumetricEffMap "The volumetric efficiency describes the ratio of the fresh air mass in the cylinder" MAP 0x8000204C RecordLayout_2 0 CompuMethod_163 -1E+17 1E+17
 /begin AXIS_DESCR COM_AXIS VolumetricEffColIn CompuMethod_188 28 -1E+17 1E+17 AXIS_PTS_REF VolumetricEffColIdxArr /end AXIS_DESCR
 /begin AXIS_DESCR COM_AXIS VolumetricEffRowIn CompuMethod_162 27 -1E+17 1E+17 AXIS_PTS_REF VolumetricEffRowIdxArr /end AXIS_DESCR
/end CHARACTERISTIC
/begin AXIS_PTS FuelPIdxArr "" 0x800007C6 FuelP_ADC RecordLayout_5 0 CompuMethod_5 4 0 65535 DEPOSIT ABSOLUTE /end AXIS_PTS
/begin AXIS_PTS FUELTIdxArr "" 0x800007F1 FUELT_ADC RecordLayout_5 0 CompuMethod_5 18 0 65535 DEPOSIT ABSOLUTE /end AXIS_PTS
/begin AXIS_PTS IgnitionAngColIdxArr "ECU ignition angle described as angle before top dead centre based" 0x8000086F IgnitionAngColIn RecordLayout_6 0 CompuMethod_162 18 -1E+17 1E+17 DEPOSIT ABSOLUTE /end AXIS_PTS
/begin AXIS_PTS IgnitionAngRowIdxArr "ECU ignition angle described as angle before top dead centre based" 0x80000CAB IgnitionAngRowIn RecordLayout_6 0 CompuMethod_163 14 -1E+17 1E+17 DEPOSIT ABSOLUTE /end AXIS_PTS
/begin AXIS_PTS IMPIdxArr "" 0x80000D3A IMP_ADC RecordLayout_5 0 CompuMethod_5 4 0 65535 DEPOSIT ABSOLUTE /end AXIS_PTS
/begin AXIS_PTS IMTIdxArr "" 0x80000D63 IMT_ADC RecordLayout_5 0 CompuMethod_5 19 0 65535 DEPOSIT ABSOLUTE /end AXIS_PTS
/begin AXIS_PTS InjectionTimeColIdxArr "Duration of injection signal without time delay to reach the desired injected fuel " 0x80000DFE InjectionTimeColIn RecordLayout_6 0 CompuMethod_166 27 -1E+17 1E+17 DEPOSIT ABSOLUTE /end AXIS_PTS
/begin AXIS_PTS InjectionTimeRowIdxArr "Duration of injection signal without time delay to reach the desired injected fuel " 0x800019CE InjectionTimeRowIn RecordLayout_6 0 CompuMethod_167 27 -1E+17 1E+17 DEPOSIT ABSOLUTE /end AXIS_PTS
/begin AXIS_PTS KnockRetardIdxArr "" 0x80001A72 KnockRetardIn RecordLayout_6 0 CompuMethod_2 7 -1E+17 1E+17 DEPOSIT ABSOLUTE /end AXIS_PTS
/begin AXIS_PTS LIG_FFIdxArr "" 0x80001AAE LIG_FFIn RecordLayout_6 0 CompuMethod_173 7 0 9.5493E+17 DEPOSIT ABSOLUTE /end AXIS_PTS
/begin AXIS_PTS O2AIdxArr "" 0x80001B1F O2A_ADC RecordLayout_5 0 CompuMethod_5 12 0 65535 DEPOSIT ABSOLUTE /end AXIS_PTS
/begin AXIS_PTS O2BIdxArr "" 0x80001B78 O2B_ADC RecordLayout_5 0 CompuMethod_5 12 0 65535 DEPOSIT ABSOLUTE /end AXIS_PTS
/begin AXIS_PTS O2CIdxArr "" 0x80001BD1 O2C_ADC RecordLayout_5 0 CompuMethod_5 12 0 65535 DEPOSIT ABSOLUTE /end AXIS_PTS
/begin AXIS_PTS O2DIdxArr "" 0x80001C2A O2D_ADC RecordLayout_5 0 CompuMethod_5 12 0 65535 DEPOSIT ABSOLUTE /end AXIS_PTS
/begin AXIS_PTS OilPIdxArr "" 0x80001C83 OilP_ADC RecordLayout_5 0 CompuMethod_5 12 0 65535 DEPOSIT ABSOLUTE /end AXIS_PTS
/begin AXIS_PTS Pcyl1IdxArr "" 0x80001CDC Pcyl1_ADC RecordLayout_5 0 CompuMethod_5 12 0 65535 DEPOSIT ABSOLUTE /end AXIS_PTS
/begin AXIS_PTS Pcyl2IdxArr "" 0x80001D35 Pcyl2_ADC RecordLayout_5 0 CompuMethod_5 12 0 65535 DEPOSIT ABSOLUTE /end AXIS_PTS
/begin AXIS_PTS Pcyl3IdxArr "" 0x80001D8E Pcyl3_ADC RecordLayout_5 0 CompuMethod_5 12 0 65535 DEPOSIT ABSOLUTE /end AXIS_PTS
/begin AXIS_PTS Pcyl4IdxArr "" 0x80001DE7 Pcyl4_ADC RecordLayout_5 0 CompuMethod_5 12 0 65535 DEPOSIT ABSOLUTE /end AXIS_PTS
/begin AXIS_PTS Pcyl5IdxArr "" 0x80001E40 Pcyl5_ADC RecordLayout_5 0 CompuMethod_5 12 0 65535 DEPOSIT ABSOLUTE /end AXIS_PTS
/begin AXIS_PTS Pcyl6IdxArr "" 0x80001E99 Pcyl6_ADC RecordLayout_5 0 CompuMethod_5 12 0 65535 DEPOSIT ABSOLUTE /end AXIS_PTS
/begin AXIS_PTS Pcyl7IdxArr "" 0x80001EF2 Pcyl7_ADC RecordLayout_5 0 CompuMethod_5 12 0 65535 DEPOSIT ABSOLUTE /end AXIS_PTS
/begin AXIS_PTS Pcyl8IdxArr "" 0x80001F4B Pcyl8_ADC RecordLayout_5 0 CompuMethod_5 12 0 65535 DEPOSIT ABSOLUTE /end AXIS_PTS
/begin AXIS_PTS ThrottleAngleConversionIdxArr "" 0x80001FBC ThrottleAngleConversionIn RecordLayout_6 0 CompuMethod_2 4 -1E+17 1E+17 DEPOSIT ABSOLUTE /end AXIS_PTS
/begin AXIS_PTS VolumetricEffColIdxArr "The volumetric efficiency describes the ratio of the fresh air mass in the cylinder" 0x80001FDC VolumetricEffColIn RecordLayout_6 0 CompuMethod_188 28 -1E+17 1E+17 DEPOSIT ABSOLUTE /end AXIS_PTS
/begin AXIS_PTS VolumetricEffRowIdxArr "The volumetric efficiency describes the ratio of the fresh air mass in the cylinder" 0x80002C1C VolumetricEffRowIn RecordLayout_6 0 CompuMethod_162 27 -1E+17 1E+17 DEPOSIT ABSOLUTE /end AXIS_PTS
/begin RECORD_LAYOUT RecordLayout_2 FNC_VALUES 1 FLOAT32_IEEE ROW_DIR DIRECT /end RECORD_LAYOUT
/begin RECORD_LAYOUT RecordLayout_3 FNC_VALUES 1 UBYTE ROW_DIR DIRECT /end RECORD_LAYOUT
/begin RECORD_LAYOUT RecordLayout_4 FNC_VALUES 1 UWORD ROW_DIR DIRECT /end RECORD_LAYOUT
/begin RECORD_LAYOUT RecordLayout_5 AXIS_PTS_X 1 UWORD /* IndexIncr */ INDEX_INCR /* Addressing */ DIRECT /end RECORD_LAYOUT
/begin RECORD_LAYOUT RecordLayout_6 AXIS_PTS_X 1 FLOAT32_IEEE /* IndexIncr */ INDEX_INCR /* Addressing */ DIRECT /end RECORD_LAYOUT
/begin RECORD_LAYOUT RecordLayout_7 FNC_VALUES 1 ULONG ROW_DIR DIRECT /end RECORD_LAYOUT
/*~~~~~~~~~ 6.3.31 COMPU_METHODs ~~~~~~~~~*/
/begin COMPU_METHOD CompuMethod_1 "" RAT_FUNC "%3.0" "" COEFFS 0 1 0 0 0 1 /end COMPU_METHOD
/begin COMPU_METHOD CompuMethod_2 "" RAT_FUNC "%6.2" "" COEFFS 0 1 0 0 0 1 /end COMPU_METHOD
/begin COMPU_METHOD CompuMethod_5 "" RAT_FUNC "%5.0" "" COEFFS 0 1 0 0 0 1 /end COMPU_METHOD
/begin COMPU_METHOD CompuMethod_8 "" RAT_FUNC "%6.2" "sec" COEFFS 0 1 0 0 0 1 /end COMPU_METHOD
/begin COMPU_METHOD CompuMethod_12 "" TAB_VERB "%1.0" "" COMPU_TAB_REF CompuVtab_2 /end COMPU_METHOD
/begin COMPU_METHOD CompuMethod_13 "" RAT_FUNC "%1.0" "" COEFFS 0 1 0 0 0 1 /end COMPU_METHOD
/begin COMPU_METHOD CompuMethod_15 "" RAT_FUNC "%5.0" "ADC" COEFFS 0 1 0 0 0 1 /end COMPU_METHOD
/begin COMPU_METHOD CompuMethod_16 "" RAT_FUNC "%6.2" "idx.frac" COEFFS 0 1 0 0 0 0.00195313 /end COMPU_METHOD
/begin COMPU_METHOD CompuMethod_21 "" TAB_VERB "%1.0" "" COMPU_TAB_REF CompuVtab_4 /end COMPU_METHOD
/begin COMPU_METHOD CompuMethod_26 "" TAB_VERB "%5.0" "" COMPU_TAB_REF CompuVtab_9 /end COMPU_METHOD
/begin COMPU_METHOD CompuMethod_41 "" RAT_FUNC "%8.0" "" COEFFS 0 1 0 0 0 1 /end COMPU_METHOD
/begin COMPU_METHOD CompuMethod_143 "" RAT_FUNC "%6.2" "psia" COEFFS 0 1 0 0 0 1 /end COMPU_METHOD
/begin COMPU_METHOD CompuMethod_144 "" RAT_FUNC "%6.2" "C" COEFFS 0 1 0 0 0 1 /end COMPU_METHOD
/begin COMPU_METHOD CompuMethod_153 "" RAT_FUNC "%6.2" "deg" COEFFS 0 1 0 0 0 1 /end COMPU_METHOD
/begin COMPU_METHOD CompuMethod_161 "" RAT_FUNC "%6.2" "rad" COEFFS 0 1 0 0 0 57.2958 /end COMPU_METHOD
/begin COMPU_METHOD CompuMethod_162 "" RAT_FUNC "%6.2" "rad/s" COEFFS 0 1 0 0 0 1 /end COMPU_METHOD
/begin COMPU_METHOD CompuMethod_163 "" RAT_FUNC "%6.2" "-" COEFFS 0 1 0 0 0 1 /end COMPU_METHOD
/begin COMPU_METHOD CompuMethod_165 "" RAT_FUNC "%18.9" "s" COEFFS 0 1 0 0 0 1 /end COMPU_METHOD
/begin COMPU_METHOD CompuMethod_166 "" RAT_FUNC "%6.2" "Pa" COEFFS 0 1 0 0 0 1 /end COMPU_METHOD
/begin COMPU_METHOD CompuMethod_167 "" RAT_FUNC "%18.9" "kg" COEFFS 0 1 0 0 0 1 /end COMPU_METHOD
/begin COMPU_METHOD CompuMethod_168 "" RAT_FUNC "%6.2" "kg" COEFFS 0 1 0 0 0 1 /end COMPU_METHOD
/begin COMPU_METHOD CompuMethod_169 "" RAT_FUNC "%8.0" "us" COEFFS 0 1 0 0 0 1 /end COMPU_METHOD
/begin COMPU_METHOD CompuMethod_171 "" RAT_FUNC "%7.2" "%" COEFFS 0 1 0 0 0 0.0015259 /end COMPU_METHOD
/begin COMPU_METHOD CompuMethod_172 "" RAT_FUNC "%6.2" "" COEFFS 0 1 0 0 0 9.5493 /end COMPU_METHOD
/begin COMPU_METHOD CompuMethod_173 "" RAT_FUNC "%6.2" "RPM" COEFFS 0 1 0 0 0 9.5493 /end COMPU_METHOD
/begin COMPU_METHOD CompuMethod_174 "" RAT_FUNC "%21.9" "" COEFFS 0 1 0 0 0 1 /end COMPU_METHOD
/begin COMPU_METHOD CompuMethod_175 "" TAB_VERB "%3.0" "" COMPU_TAB_REF CompuVtab_126 /end COMPU_METHOD
/begin COMPU_METHOD CompuMethod_179 "" TAB_VERB "%1.0" "boolean" COMPU_TAB_REF CompuVtab_128 /end COMPU_METHOD
/begin COMPU_METHOD CompuMethod_180 "" TAB_VERB "%1.0" "" COMPU_TAB_REF CompuVtab_129 /end COMPU_METHOD
/begin COMPU_METHOD CompuMethod_181 "" TAB_VERB "%1.0" "" COMPU_TAB_REF CompuVtab_130 /end COMPU_METHOD
/begin COMPU_METHOD CompuMethod_183 "" TAB_VERB "%1.0" "" COMPU_TAB_REF CompuVtab_131 /end COMPU_METHOD
/begin COMPU_METHOD CompuMethod_185 "" TAB_VERB "%1.0" "" COMPU_TAB_REF CompuVtab_133 /end COMPU_METHOD
/begin COMPU_METHOD CompuMethod_187 "" TAB_VERB "%1.0" "" COMPU_TAB_REF CompuVtab_134 /end COMPU_METHOD
/begin COMPU_METHOD CompuMethod_188 "" RAT_FUNC "%6.2" "kg/m**3" COEFFS 0 1 0 0 0 1 /end COMPU_METHOD
/begin COMPU_VTAB CompuVtab_2 "" TAB_VERB 2 0 "Pass-Through" 1 "Override" /end COMPU_VTAB
/begin COMPU_VTAB CompuVtab_4 "" TAB_VERB 2 0 "Disabled" 1 "Enabled" /end COMPU_VTAB
/begin COMPU_VTAB CompuVtab_9 "" TAB_VERB 38 0 "Normal Operation" 1 "Task Kernel API Usage" 2 "Bad Attribute Data" 3 "Operation timed out" 4 "Operation aborted" 5 "Access from an ISR" 6 "Illegal Handle" 7 "Out of free store memory" 8 "The supplied task information is not valid." 9 "Missing Attribute" 10 "Insufficient FW resource" 11 "TPU Mask incompatible with the eTPU" 12 "Resource Busy" 13 "Data Unavailable" 14 "Function Not Supported" 15 "Flash is not blank" 16 "Flash Prog Voltage Unavailable" 17 "Memory verify" 18 "Uncreated Resource access" 19 "Illegal address" 20 "Hardware overrun" 21 "Alignment" 22 "Hardware timeout" 23 "TPU Function not in mask" 24 "TPU coprocessor not succesfully opened" 25 "Required dependants were not located" 26 "SPI Bus Integrity check failed." 27 "Insufficient param ram for TPU primitive" 28 "Dependent ASIC not created" 29 "Resource Not Capable." 30 "Software overrun" 31 "A Write attempted failed but OK to continue" 32 "Heap free-list distroyed; found while allocating" 33 "Heap freeing already freed or distroyed block" 34 "Heap freeing block outside of pool" 35 "Heap free list crashed; found while reallocating" 36 "An operation to the host operating system failed" 37 "Data Alignment" /end COMPU_VTAB
/begin COMPU_VTAB CompuVtab_126 "" TAB_VERB 3 0 "SpeedDensity" 1 "Spd1" 2 "Spd2" /end COMPU_VTAB
/begin COMPU_VTAB CompuVtab_128 "" TAB_VERB 2 0 "Off" 1 "On" /end COMPU_VTAB
/begin COMPU_VTAB CompuVtab_129 "" TAB_VERB 2 0 "Load saved application values on next startup" 1 "Load factory defaults on next startup" /end COMPU_VTAB
/begin COMPU_VTAB CompuVtab_130 "" TAB_VERB 7 0 "Currently loading NV from Factory FLASH to RAM" 1 "Currently loading NV from EEPROM to RAM" 2 "Currently storing NV from RAM to EEPROM" 3 "Detected new program.  Loaded Factory Defaults from FLASH" 4 "CRC failure.  Loaded Factory Defaults from FLASH" 5 "User requested refresh from Factory Defaults in FLASH." 6 "Successful refresh of EEPROM values from last shutdown" /end COMPU_VTAB
/begin COMPU_VTAB CompuVtab_131 "" TAB_VERB 2 0 "Cold Powerup" 1 "Warm Powerup" /end COMPU_VTAB
/begin COMPU_VTAB CompuVtab_133 "" TAB_VERB 2 0 "Run" 1 "Restore To Defaults" /end COMPU_VTAB
/begin COMPU_VTAB CompuVtab_134 "" TAB_VERB 2 0 "Run" 1 "Store To EEPROM" /end COMPU_VTAB
/begin FUNCTION Injection "" /begin DEF_CHARACTERISTIC InjectionTimeMap /end DEF_CHARACTERISTIC
 /begin OUT_MEASUREMENT FuelFlow_kgpercyl FuelFlow_kgpersec InjectionTime InjectionTimeColIdx InjectionTimeColIn InjectionTimeRowIdx InjectionTimeRowIn /end OUT_MEASUREMENT
/end FUNCTION
/begin FUNCTION FuelP "" /begin DEF_CHARACTERISTIC FuelPTbl /end DEF_CHARACTERISTIC /begin OUT_MEASUREMENT FuelP FuelP_ADC FuelP_Raw FuelPIdx /end OUT_MEASUREMENT /begin SUB_FUNCTION FuelP_Config FuelP_Override /end SUB_FUNCTION /end FUNCTION
/begin FUNCTION FuelP_Config "" /begin DEF_CHARACTERISTIC FuelP_Default FuelP_FiltConst FuelP_Max FuelP_Min /end DEF_CHARACTERISTIC /end FUNCTION
/begin FUNCTION FuelP_Override "" /begin DEF_CHARACTERISTIC FuelP_new FuelP_ovr /end DEF_CHARACTERISTIC /end FUNCTION
/begin FUNCTION Fuel_Pump "" /begin OUT_MEASUREMENT FuelPump /end OUT_MEASUREMENT /begin SUB_FUNCTION FuelPump_Override /end SUB_FUNCTION /end FUNCTION
/begin FUNCTION FuelPump_Override "" /begin DEF_CHARACTERISTIC FuelPump_new FuelPump_ovr /end DEF_CHARACTERISTIC /end FUNCTION
/begin FUNCTION FUELT "" /begin DEF_CHARACTERISTIC FUELTTbl /end DEF_CHARACTERISTIC /begin OUT_MEASUREMENT FUELT FUELT_ADC FUELT_Raw FUELTIdx /end OUT_MEASUREMENT /begin SUB_FUNCTION FUELT_Config FUELT_Override /end SUB_FUNCTION /end FUNCTION
/begin FUNCTION FUELT_Config "" /begin DEF_CHARACTERISTIC FUELT_Default FUELT_FiltConst FUELT_Max FUELT_Min /end DEF_CHARACTERISTIC /end FUNCTION
/begin FUNCTION FUELT_Override "" /begin DEF_CHARACTERISTIC FUELT_new FUELT_ovr /end DEF_CHARACTERISTIC /end FUNCTION
/begin FUNCTION H1DC_Override "" /begin DEF_CHARACTERISTIC H1DC_new H1DC_ovr /end DEF_CHARACTERISTIC /end FUNCTION
/begin FUNCTION IAC "" /begin DEF_CHARACTERISTIC IACFreq /end DEF_CHARACTERISTIC /begin OUT_MEASUREMENT IAC /end OUT_MEASUREMENT /begin SUB_FUNCTION IAC_Override /end SUB_FUNCTION /end FUNCTION
/begin FUNCTION IAC_Override "" /begin DEF_CHARACTERISTIC IAC_new IAC_ovr /end DEF_CHARACTERISTIC /end FUNCTION
/begin FUNCTION Ignition "" /begin DEF_CHARACTERISTIC IgnitionAngMap KnockRetardTbl /end DEF_CHARACTERISTIC
 /begin OUT_MEASUREMENT IgnitionAng IgnitionAngColIdx IgnitionAngColIn IgnitionAngRowIdx IgnitionAngRowIn KnockRetard KnockRetardIdx KnockRetardIn /end OUT_MEASUREMENT
/end FUNCTION
/begin FUNCTION Ignition_Angle "" /begin DEF_CHARACTERISTIC IgnitionAngleSign SparkDuration_msec /end DEF_CHARACTERISTIC
 /begin OUT_MEASUREMENT IgnitionAngles_dbtdc.Start_Angle._ IgnitionAngles_dbtdc.End_Angle._ /end OUT_MEASUREMENT
/end FUNCTION
/begin FUNCTION IgnitionEndAngle_Override "" /begin DEF_CHARACTERISTIC IgnitionEndAngle_new IgnitionEndAngle_ovr /end DEF_CHARACTERISTIC /end FUNCTION
/begin FUNCTION Ignition_1 ""
 /begin DEF_CHARACTERISTIC Spark._._0 Spark._._1 Spark._._2 Spark._._3 Spark._._4 Spark._._5 Spark._._6 Spark._._7 SparkMaxDuration /end DEF_CHARACTERISTIC
 /begin SUB_FUNCTION IgnitionEndAngle_Override IgnitionStartAngle_Override /end SUB_FUNCTION
/end FUNCTION
/begin FUNCTION IgnitionStartAngle_Override "" /begin DEF_CHARACTERISTIC IgnitionStartAngle_new IgnitionStartAngle_ovr /end DEF_CHARACTERISTIC /end FUNCTION
/begin FUNCTION IMP "" /begin DEF_CHARACTERISTIC IMPTbl /end DEF_CHARACTERISTIC /begin OUT_MEASUREMENT IMP IMP_ADC IMP_Raw IMPIdx /end OUT_MEASUREMENT /begin SUB_FUNCTION IMP_Config IMP_Override /end SUB_FUNCTION /end FUNCTION
/begin FUNCTION IMP_Config "" /begin DEF_CHARACTERISTIC IMP_Default IMP_FiltConst IMP_Max IMP_Min /end DEF_CHARACTERISTIC /end FUNCTION
/begin FUNCTION IMP_Override "" /begin DEF_CHARACTERISTIC IMP_new IMP_ovr /end DEF_CHARACTERISTIC /end FUNCTION
/begin FUNCTION IMT "" /begin DEF_CHARACTERISTIC IMTTbl /end DEF_CHARACTERISTIC /begin OUT_MEASUREMENT IMT IMT_ADC IMT_Raw IMTIdx /end OUT_MEASUREMENT /begin SUB_FUNCTION IMT_Config IMT_Override /end SUB_FUNCTION /end FUNCTION
/begin FUNCTION IMT_Config "" /begin DEF_CHARACTERISTIC IMT_Default IMT_FiltConst IMT_Max IMT_Min /end DEF_CHARACTERISTIC /end FUNCTION
/begin FUNCTION IMT_Override "" /begin DEF_CHARACTERISTIC IMT_new IMT_ovr /end DEF_CHARACTERISTIC /end FUNCTION
/begin FUNCTION Injection_1 ""
 /begin DEF_CHARACTERISTIC Injection._._0 Injection._._1 Injection._._2 Injection._._3 Injection._._4 Injection._._5 Injection._._6 Injection._._7 InjectorElectricalOffset InjectorMaxDuration InjectorPeakDuration INJStartAngle /end DEF_CHARACTERISTIC
 /begin OUT_MEASUREMENT InjectionTime_msec /end OUT_MEASUREMENT
 /begin SUB_FUNCTION InjectionTime_Override /end SUB_FUNCTION
/end FUNCTION
/begin FUNCTION InjectionTime_Override "" /begin DEF_CHARACTERISTIC InjectionTime_new InjectionTime_ovr /end DEF_CHARACTERISTIC /end FUNCTION
/begin FUNCTION Intake_Density "" /begin OUT_MEASUREMENT IntakeDensity_kgperm3 /end OUT_MEASUREMENT /end FUNCTION
/begin FUNCTION Virtual_Sensors "" /begin SUB_FUNCTION Intake_Density IntakeFlow Inverse_Int_Lambda VolEff /end SUB_FUNCTION /end FUNCTION
/begin FUNCTION ISR ""
 /begin OUT_MEASUREMENT ISR_ADCCPU ISR_CANCPU ISR_DecrementorCPU ISR_DMACPU ISR_EMIOSCPU ISR_SCICPU ISR_TPUCPU /end OUT_MEASUREMENT
/end FUNCTION
/begin FUNCTION KnockCalc "" /begin OUT_MEASUREMENT Knock_Energy Knock_LastCyl Knock_Ratio Knock_Ref MaxKnock /end OUT_MEASUREMENT /end FUNCTION
/begin FUNCTION Knock "" /begin DEF_CHARACTERISTIC Knock_SensorSelect /end DEF_CHARACTERISTIC /begin SUB_FUNCTION KnockCalc /end SUB_FUNCTION /end FUNCTION
/begin FUNCTION LIG_FF_Adapt "" /begin DEF_CHARACTERISTIC LIG_AdaptK /end DEF_CHARACTERISTIC /end FUNCTION
/begin FUNCTION LIG_APP_Request "" /begin DEF_CHARACTERISTIC LIG_FFTbl LIG_Imax LIG_Imin LIG_Ki LIG_Kp LIG_max LIG_min /end DEF_CHARACTERISTIC
 /begin OUT_MEASUREMENT LIG_effort LIG_Error_rpm LIG_FF LIG_FFeffort LIG_FFIdx LIG_FFIn LIG_Ieffort LIG_Peffort /end OUT_MEASUREMENT
 /begin SUB_FUNCTION LIG_FF_Adapt /end SUB_FUNCTION
/end FUNCTION
/begin FUNCTION Memory_1 "" /begin DEF_CHARACTERISTIC LoadCalibrationError SaveCalibrationError /end DEF_CHARACTERISTIC /end FUNCTION
/begin FUNCTION IntakeFlow "" /begin OUT_MEASUREMENT MAF_SpeedDensity_kgpersec /end OUT_MEASUREMENT /end FUNCTION
/begin FUNCTION MAF_Source "" /begin DEF_CHARACTERISTIC MAFSource /end DEF_CHARACTERISTIC /end FUNCTION
/begin FUNCTION MIL "" /begin OUT_MEASUREMENT MIL /end OUT_MEASUREMENT /begin SUB_FUNCTION MIL_Override /end SUB_FUNCTION /end FUNCTION
/begin FUNCTION MIL_Override "" /begin DEF_CHARACTERISTIC MIL_new MIL_ovr /end DEF_CHARACTERISTIC /end FUNCTION
/begin FUNCTION ThrottleControl "" /begin DEF_CHARACTERISTIC MinThrottleAng_deg Throttle_per_APP /end DEF_CHARACTERISTIC /begin OUT_MEASUREMENT ThrottleCommand_deg /end OUT_MEASUREMENT /end FUNCTION
/begin FUNCTION MPRD_Override "" /begin DEF_CHARACTERISTIC MPRD_new MPRD_ovr /end DEF_CHARACTERISTIC /end FUNCTION
/begin FUNCTION NonVolatile_Storage "" /begin DEF_CHARACTERISTIC RestoreNVFactoryDefaults StoreNV /end DEF_CHARACTERISTIC /begin OUT_MEASUREMENT NonVolatileCRC NonVolatileFormatID NonVolatileStatus /end OUT_MEASUREMENT /begin SUB_FUNCTION NonVolatile_Storage_Config /end SUB_FUNCTION /end FUNCTION
/begin FUNCTION NonVolatile_Storage_Config ""
 /begin DEF_CHARACTERISTIC NonVolatileRestoreOnFirstStartup NonVolatileRestoreOnStartup /end DEF_CHARACTERISTIC
/end FUNCTION
/begin FUNCTION O2A "" /begin DEF_CHARACTERISTIC O2ATbl /end DEF_CHARACTERISTIC /begin OUT_MEASUREMENT O2A O2A_ADC O2A_Raw O2AIdx /end OUT_MEASUREMENT /begin SUB_FUNCTION O2A_Config O2A_Override /end SUB_FUNCTION /end FUNCTION
/begin FUNCTION O2A_Config "" /begin DEF_CHARACTERISTIC O2A_Default O2A_FiltConst O2A_Max O2A_Min /end DEF_CHARACTERISTIC /end FUNCTION
/begin FUNCTION O2A_Override "" /begin DEF_CHARACTERISTIC O2A_new O2A_ovr /end DEF_CHARACTERISTIC /end FUNCTION
/begin FUNCTION O2B "" /begin DEF_CHARACTERISTIC O2BTbl /end DEF_CHARACTERISTIC /begin OUT_MEASUREMENT O2B O2B_ADC O2B_Raw O2BIdx /end OUT_MEASUREMENT /begin SUB_FUNCTION O2B_Config O2B_Override /end SUB_FUNCTION /end FUNCTION
/begin FUNCTION O2B_Config "" /begin DEF_CHARACTERISTIC O2B_Default O2B_FiltConst O2B_Max O2B_Min /end DEF_CHARACTERISTIC /end FUNCTION
/begin FUNCTION O2B_Override "" /begin DEF_CHARACTERISTIC O2B_new O2B_ovr /end DEF_CHARACTERISTIC /end FUNCTION
/begin FUNCTION O2C "" /begin DEF_CHARACTERISTIC O2CTbl /end DEF_CHARACTERISTIC /begin OUT_MEASUREMENT O2C O2C_ADC O2C_Raw O2CIdx /end OUT_MEASUREMENT /begin SUB_FUNCTION O2C_Config O2C_Override /end SUB_FUNCTION /end FUNCTION
/begin FUNCTION O2C_Config "" /begin DEF_CHARACTERISTIC O2C_Default O2C_FiltConst O2C_Max O2C_Min /end DEF_CHARACTERISTIC /end FUNCTION
/begin FUNCTION O2C_Override "" /begin DEF_CHARACTERISTIC O2C_new O2C_ovr /end DEF_CHARACTERISTIC /end FUNCTION
/begin FUNCTION O2D "" /begin DEF_CHARACTERISTIC O2DTbl /end DEF_CHARACTERISTIC /begin OUT_MEASUREMENT O2D O2D_ADC O2D_Raw O2DIdx /end OUT_MEASUREMENT /begin SUB_FUNCTION O2D_Config O2D_Override /end SUB_FUNCTION /end FUNCTION
/begin FUNCTION O2D_Config "" /begin DEF_CHARACTERISTIC O2D_Default O2D_FiltConst O2D_Max O2D_Min /end DEF_CHARACTERISTIC /end FUNCTION
/begin FUNCTION O2D_Override "" /begin DEF_CHARACTERISTIC O2D_new O2D_ovr /end DEF_CHARACTERISTIC /end FUNCTION
/begin FUNCTION OilP "" /begin DEF_CHARACTERISTIC OilPTbl /end DEF_CHARACTERISTIC /begin OUT_MEASUREMENT OilP OilP_ADC OilP_Raw OilPIdx /end OUT_MEASUREMENT /begin SUB_FUNCTION OilP_Config OilP_Override /end SUB_FUNCTION /end FUNCTION
/begin FUNCTION OilP_Config "" /begin DEF_CHARACTERISTIC OilP_Default OilP_FiltConst OilP_Max OilP_Min /end DEF_CHARACTERISTIC /end FUNCTION
/begin FUNCTION OilP_Override "" /begin DEF_CHARACTERISTIC OilP_new OilP_ovr /end DEF_CHARACTERISTIC /end FUNCTION
/begin FUNCTION Pcyl1 "" /begin DEF_CHARACTERISTIC Pcyl1Tbl /end DEF_CHARACTERISTIC /begin OUT_MEASUREMENT Pcyl1 Pcyl1_ADC Pcyl1_Raw Pcyl1Idx /end OUT_MEASUREMENT /begin SUB_FUNCTION Pcyl1_Config Pcyl1_Override /end SUB_FUNCTION /end FUNCTION
/begin FUNCTION Pcyl1_Config "" /begin DEF_CHARACTERISTIC Pcyl1_Default Pcyl1_FiltConst Pcyl1_Max Pcyl1_Min /end DEF_CHARACTERISTIC /end FUNCTION
/begin FUNCTION Pcyl1_Override "" /begin DEF_CHARACTERISTIC Pcyl1_new Pcyl1_ovr /end DEF_CHARACTERISTIC /end FUNCTION
/begin FUNCTION Pcyl2 "" /begin DEF_CHARACTERISTIC Pcyl2Tbl /end DEF_CHARACTERISTIC /begin OUT_MEASUREMENT Pcyl2 Pcyl2_ADC Pcyl2_Raw Pcyl2Idx /end OUT_MEASUREMENT /begin SUB_FUNCTION Pcyl2_Config Pcyl2_Override /end SUB_FUNCTION /end FUNCTION
/begin FUNCTION Pcyl2_Config "" /begin DEF_CHARACTERISTIC Pcyl2_Default Pcyl2_FiltConst Pcyl2_Max Pcyl2_Min /end DEF_CHARACTERISTIC /end FUNCTION
/begin FUNCTION Pcyl2_Override "" /begin DEF_CHARACTERISTIC Pcyl2_new Pcyl2_ovr /end DEF_CHARACTERISTIC /end FUNCTION
/begin FUNCTION Pcyl3 "" /begin DEF_CHARACTERISTIC Pcyl3Tbl /end DEF_CHARACTERISTIC /begin OUT_MEASUREMENT Pcyl3 Pcyl3_ADC Pcyl3_Raw Pcyl3Idx /end OUT_MEASUREMENT /begin SUB_FUNCTION Pcyl3_Config Pcyl3_Override /end SUB_FUNCTION /end FUNCTION
/begin FUNCTION Pcyl3_Config "" /begin DEF_CHARACTERISTIC Pcyl3_Default Pcyl3_FiltConst Pcyl3_Max Pcyl3_Min /end DEF_CHARACTERISTIC /end FUNCTION
/begin FUNCTION Pcyl3_Override "" /begin DEF_CHARACTERISTIC Pcyl3_new Pcyl3_ovr /end DEF_CHARACTERISTIC /end FUNCTION
/begin FUNCTION Pcyl4 "" /begin DEF_CHARACTERISTIC Pcyl4Tbl /end DEF_CHARACTERISTIC /begin OUT_MEASUREMENT Pcyl4 Pcyl4_ADC Pcyl4_Raw Pcyl4Idx /end OUT_MEASUREMENT /begin SUB_FUNCTION Pcyl4_Config Pcyl4_Override /end SUB_FUNCTION /end FUNCTION
/begin FUNCTION Pcyl4_Config "" /begin DEF_CHARACTERISTIC Pcyl4_Default Pcyl4_FiltConst Pcyl4_Max Pcyl4_Min /end DEF_CHARACTERISTIC /end FUNCTION
/begin FUNCTION Pcyl4_Override "" /begin DEF_CHARACTERISTIC Pcyl4_new Pcyl4_ovr /end DEF_CHARACTERISTIC /end FUNCTION
/begin FUNCTION Pcyl5 "" /begin DEF_CHARACTERISTIC Pcyl5Tbl /end DEF_CHARACTERISTIC /begin OUT_MEASUREMENT Pcyl5 Pcyl5_ADC Pcyl5_Raw Pcyl5Idx /end OUT_MEASUREMENT /begin SUB_FUNCTION Pcyl5_Config Pcyl5_Override /end SUB_FUNCTION /end FUNCTION
/begin FUNCTION Pcyl5_Config "" /begin DEF_CHARACTERISTIC Pcyl5_Default Pcyl5_FiltConst Pcyl5_Max Pcyl5_Min /end DEF_CHARACTERISTIC /end FUNCTION
/begin FUNCTION Pcyl5_Override "" /begin DEF_CHARACTERISTIC Pcyl5_new Pcyl5_ovr /end DEF_CHARACTERISTIC /end FUNCTION
/begin FUNCTION Pcyl6 "" /begin DEF_CHARACTERISTIC Pcyl6Tbl /end DEF_CHARACTERISTIC /begin OUT_MEASUREMENT Pcyl6 Pcyl6_ADC Pcyl6_Raw Pcyl6Idx /end OUT_MEASUREMENT /begin SUB_FUNCTION Pcyl6_Config Pcyl6_Override /end SUB_FUNCTION /end FUNCTION
/begin FUNCTION Pcyl6_Config "" /begin DEF_CHARACTERISTIC Pcyl6_Default Pcyl6_FiltConst Pcyl6_Max Pcyl6_Min /end DEF_CHARACTERISTIC /end FUNCTION
/begin FUNCTION Pcyl6_Override "" /begin DEF_CHARACTERISTIC Pcyl6_new Pcyl6_ovr /end DEF_CHARACTERISTIC /end FUNCTION
/begin FUNCTION Pcyl7 "" /begin DEF_CHARACTERISTIC Pcyl7Tbl /end DEF_CHARACTERISTIC /begin OUT_MEASUREMENT Pcyl7 Pcyl7_ADC Pcyl7_Raw Pcyl7Idx /end OUT_MEASUREMENT /begin SUB_FUNCTION Pcyl7_Config Pcyl7_Override /end SUB_FUNCTION /end FUNCTION
/begin FUNCTION Pcyl7_Config "" /begin DEF_CHARACTERISTIC Pcyl7_Default Pcyl7_FiltConst Pcyl7_Max Pcyl7_Min /end DEF_CHARACTERISTIC /end FUNCTION
/begin FUNCTION Pcyl7_Override "" /begin DEF_CHARACTERISTIC Pcyl7_new Pcyl7_ovr /end DEF_CHARACTERISTIC /end FUNCTION
/begin FUNCTION Pcyl8 "" /begin DEF_CHARACTERISTIC Pcyl8Tbl /end DEF_CHARACTERISTIC /begin OUT_MEASUREMENT Pcyl8 Pcyl8_ADC Pcyl8_Raw Pcyl8Idx /end OUT_MEASUREMENT /begin SUB_FUNCTION Pcyl8_Config Pcyl8_Override /end SUB_FUNCTION /end FUNCTION
/begin FUNCTION Pcyl8_Config "" /begin DEF_CHARACTERISTIC Pcyl8_Default Pcyl8_FiltConst Pcyl8_Max Pcyl8_Min /end DEF_CHARACTERISTIC /end FUNCTION
/begin FUNCTION Pcyl8_Override "" /begin DEF_CHARACTERISTIC Pcyl8_new Pcyl8_ovr /end DEF_CHARACTERISTIC /end FUNCTION
/begin FUNCTION Status "" /begin OUT_MEASUREMENT PowerUpStatus /end OUT_MEASUREMENT /end FUNCTION
/begin FUNCTION Inverse_Int_Lambda "" /begin DEF_CHARACTERISTIC StoechAirFuelRatio /end DEF_CHARACTERISTIC /end FUNCTION
/begin FUNCTION Tach "" /begin DEF_CHARACTERISTIC TachStartAngle ThrottleAngleConversionTbl /end DEF_CHARACTERISTIC
 /begin OUT_MEASUREMENT ThrottleAngleConversion ThrottleAngleConversionIdx ThrottleAngleConversionIn /end OUT_MEASUREMENT
/end FUNCTION
/begin FUNCTION VolEff "" /begin DEF_CHARACTERISTIC VolumetricEffMap /end DEF_CHARACTERISTIC
 /begin OUT_MEASUREMENT VolumetricEff VolumetricEffColIdx VolumetricEffColIn VolumetricEffRowIdx VolumetricEffRowIn /end OUT_MEASUREMENT
/end FUNCTION
/end MODULE
/end PROJECT

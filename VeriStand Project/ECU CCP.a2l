/******************************************************************************
* ASAP2 descrition file /
* Generated by Woodward ASAP2 Generator /
* This file was auto-generated on: Monday, September 29, 2014 3:09 PM /
******************************************************************************/
ASAP2_VERSION 1 51
/begin PROJECT Project ""
/begin MODULE niihil14_037 ""
/begin IF_DATA VISION DEVICE_SETTING "CCP=2.1_ASAP1b" DEVICE_SETTING "DefaultCRCType=5" /end IF_DATA
/begin IF_DATA ASAP1B_CCP
 /begin SOURCE "List 1" 0 0 DISPLAY_IDENTIFIER "DAQ1"
  /begin QP_BLOB 0 LENGTH 8 CAN_ID_FIXED 0x701 RASTER 0 REDUCTION_ALLOWED FIRST_PID 0 /end QP_BLOB
 /end SOURCE
 /begin SOURCE "List 2" 0 0 DISPLAY_IDENTIFIER "DAQ2"
  /begin QP_BLOB 1 LENGTH 8 CAN_ID_FIXED 0x701 RASTER 1 REDUCTION_ALLOWED FIRST_PID 8 /end QP_BLOB
 /end SOURCE
 /begin SOURCE "List 3" 0 0 DISPLAY_IDENTIFIER "DAQ3"
  /begin QP_BLOB 2 LENGTH 8 CAN_ID_FIXED 0x701 RASTER 2 REDUCTION_ALLOWED FIRST_PID 16 /end QP_BLOB
 /end SOURCE
 /begin SOURCE "List 4" 0 0 DISPLAY_IDENTIFIER "DAQ4"
  /begin QP_BLOB 3 LENGTH 8 CAN_ID_FIXED 0x701 RASTER 3 REDUCTION_ALLOWED FIRST_PID 24 /end QP_BLOB
 /end SOURCE
 /begin RASTER "FGND_RTI_PERIODIC" "FGND_RTI_PERIODIC" 0 3 10 /end RASTER
 /begin RASTER "FGND_2XRTI_PERIODIC" "FGND_2XRTI_PERIODIC" 1 3 20 /end RASTER
 /begin RASTER "FGND_10XRTI_PERIODIC" "FGND_10XRTI_PERIODIC" 2 3 100 /end RASTER
 /begin RASTER "FGND_20XRTI_PERIODIC" "FGND_20XRTI_PERIODIC" 3 3 200 /end RASTER
 /begin RASTER "BGND_BASE_PERIODIC" "BGND_BASE_PERIODIC" 4 3 100 /end RASTER
 /begin RASTER "BGND_BASEx2_PERIODIC" "BGND_BASEx2_PERIODIC" 5 3 200 /end RASTER
 /begin RASTER "BGND_BASEx10_PERIODIC" "BGND_BASEx10_PERIODIC" 6 3 1000 /end RASTER
 /begin RASTER "ONE_SECOND_EVENT" "ONE_SECOND_EVENT" 7 3 1000 /end RASTER
 /* /begin SEED_KEY */ /* DLL for CAL */ /* Uncomment and supply a value "SecurityCAL.dll" */ /* DLL for DAQ */ /* Uncomment and supply a value "SecurityDAQ.dll" */ /* DLL for PGM */ /* Uncomment and supply a value "SecurityPGM.dll" */ /* /end SEED_KEY */
 /begin TP_BLOB /* CCP version */ 0x201 /* Blob version */ 0x204 /* CAN msg ID - send */ 0x700 /* CAN msg ID - recv */ 0x701 /* Station address */ 0x31 /* byte order */ 1 BAUDRATE 250000 SAMPLE_RATE 1 SAMPLE_POINT 70 BTL_CYCLES 10 SJW 2 SYNC_EDGE SINGLE DAQ_MODE BURST CONSISTENCY ODT ADDRESS_EXTENSION DAQ
  /begin CHECKSUM_PARAM /* algorithm */ 0x8009 /* limit */ 0x1000 CHECKSUM_CALCULATION ACTIVE_PAGE /end CHECKSUM_PARAM
  /begin DEFINED_PAGES /* Memory page num */ 1 /* Page Name */ "working page" /* address ext. */ 0x00 /* base address */ 0x80000000 /* page length */ 0x00002C88 RAM /* memory page in RAM */ RAM_INIT_BY_ECU /* memory page is initialised by ECU start-up */ /end DEFINED_PAGES
  OPTIONAL_CMD 0x5 /* TEST */ OPTIONAL_CMD 0x8 /* START_STOP_ALL */ OPTIONAL_CMD 0xC /* SET_S_STATUS */ OPTIONAL_CMD 0xD /* GET_S_STATUS */ OPTIONAL_CMD 0xE /* BUILD_CHECKSUM */ OPTIONAL_CMD 0xF /* SHORT_UP */ OPTIONAL_CMD 0x12 /* GET_SEED */ OPTIONAL_CMD 0x13 /* UNLOCK */ OPTIONAL_CMD 0x23 /* DNLOAD_6 */ /end TP_BLOB
/end IF_DATA
/*~~~~~~~~~ 6.3.91 MOD_PAR ~~~~~~~~~*/
/begin MOD_PAR /* MOD_PAR Comment*/ "" ECU_CALIBRATION_OFFSET 0x00000000
 /begin MEMORY_SEGMENT CAL "" DATA FLASH INTERN 0x80000000 /* Size */ 0x00002C88 /* Offset */ -1 -1 -1 -1 -1 /end MEMORY_SEGMENT
 /begin MEMORY_SEGMENT MeasRAM "" VARIABLES RAM INTERN 0x40000000 /* Size */ 0x00000740 /* Offset */ -1 -1 -1 -1 -1 /end MEMORY_SEGMENT
/end MOD_PAR
/begin MOD_COMMON /* MOD_COMMON Comment */ "" BYTE_ORDER MSB_FIRST ALIGNMENT_BYTE 1 ALIGNMENT_FLOAT32_IEEE 1 ALIGNMENT_FLOAT64_IEEE 1 ALIGNMENT_LONG 1 ALIGNMENT_WORD 1 /end MOD_COMMON
/*~~~~~~~~~ 6.3.86 MEASUREMENTs ~~~~~~~~~*/
/begin MEASUREMENT project_id "This is the Platform ID used by the tools." UBYTE CompuMethod_1 1 0 0 255 ECU_ADDRESS 0x4000073F /end MEASUREMENT
/begin MEASUREMENT table_0_rev "This is Table0 Revision Number" UBYTE CompuMethod_1 1 0 0 255 ECU_ADDRESS 0x40000001 /end MEASUREMENT
/begin MEASUREMENT table_1_rev "This is Table1 Revision Number" UBYTE CompuMethod_1 1 0 0 255 ECU_ADDRESS 0x40000002 /end MEASUREMENT
/begin MEASUREMENT table_2_rev "This is Table2 Revision Number" UBYTE CompuMethod_1 1 0 0 255 ECU_ADDRESS 0x40000003 /end MEASUREMENT
/begin MEASUREMENT Protocol_KeySuite_Rev "MotoTron KeySuite Protocol Version (Key/ERI)" UBYTE CompuMethod_1 1 0 0 255 ECU_ADDRESS 0x40000005 /end MEASUREMENT
/begin MEASUREMENT EriRev "This is the revision for the ERI protocol." UBYTE CompuMethod_1 1 0 0 255 ECU_ADDRESS 0x40000006 /end MEASUREMENT
/begin MEASUREMENT table_3_rev "This is Table3 Revision Number" UBYTE CompuMethod_1 1 0 0 255 ECU_ADDRESS 0x40000007 /end MEASUREMENT
/begin MEASUREMENT table_4_rev "This is Table4 Revision Number" UBYTE CompuMethod_1 1 0 0 255 ECU_ADDRESS 0x40000008 /end MEASUREMENT
/begin MEASUREMENT table_5_rev "This is Table5 Revision Number" UBYTE CompuMethod_1 1 0 0 255 ECU_ADDRESS 0x40000009 /end MEASUREMENT
/begin MEASUREMENT table_6_rev "This is Table6 Revision Number" UBYTE CompuMethod_1 1 0 0 255 ECU_ADDRESS 0x4000000A /end MEASUREMENT
/begin MEASUREMENT table_7_rev "This is Table7 Revision Number" UBYTE CompuMethod_1 1 0 0 255 ECU_ADDRESS 0x4000000B /end MEASUREMENT
/begin MEASUREMENT ProductID "Customer's ID used by the tools." ULONG CompuMethod_3 1 0 0 4294970000 ECU_ADDRESS 0x40000075 /end MEASUREMENT
/begin MEASUREMENT MotProgRev "MotoTron Programming Interface Version" UBYTE CompuMethod_1 1 0 0 255 ECU_ADDRESS 0x40000079 /end MEASUREMENT
/begin MEASUREMENT BootVerMaj "" UBYTE CompuMethod_1 1 0 0 255 ECU_ADDRESS 0x4000007A /end MEASUREMENT
/begin MEASUREMENT BootVerMin "" UBYTE CompuMethod_1 1 0 0 255 ECU_ADDRESS 0x4000007B /end MEASUREMENT
/begin MEASUREMENT EcuHwMaj "" UBYTE CompuMethod_4 1 0 0 255 ECU_ADDRESS 0x4000007C /end MEASUREMENT
/begin MEASUREMENT EcuHwMin "" UBYTE CompuMethod_1 1 0 0 255 ECU_ADDRESS 0x4000007D /end MEASUREMENT
/begin MEASUREMENT ApplicationCompatibilityArr "Software Format ID" UWORD CompuMethod_5 1 0 0 65535 ECU_ADDRESS 0x4000007E MATRIX_DIM 1 50 1 /end MEASUREMENT
/begin MEASUREMENT Airflow "Final value after Linear Sensor Characterization" FLOAT32_IEEE CompuMethod_6 1 0 -1E+17 1E+17 ECU_ADDRESS 0x40000144 /end MEASUREMENT
/begin MEASUREMENT Airflow_ADC "Singal measured directly from sensor" ULONG CompuMethod_7 1 0 0 4294970000 ECU_ADDRESS 0x40000148 /end MEASUREMENT
/begin MEASUREMENT Airflow_Raw "After conversion to engineering units, before range checking" FLOAT32_IEEE CompuMethod_6 1 0 -1E+17 1E+17 ECU_ADDRESS 0x4000014C /end MEASUREMENT
/begin MEASUREMENT Airflow2 "Final value after Linear Sensor Characterization" FLOAT32_IEEE CompuMethod_6 1 0 -1E+17 1E+17 ECU_ADDRESS 0x40000150 /end MEASUREMENT
/begin MEASUREMENT Airflow2_ADC "Singal measured directly from sensor" ULONG CompuMethod_7 1 0 0 4294970000 ECU_ADDRESS 0x40000154 /end MEASUREMENT
/begin MEASUREMENT Airflow2_Raw "After conversion to engineering units, before range checking" FLOAT32_IEEE CompuMethod_6 1 0 -1E+17 1E+17 ECU_ADDRESS 0x40000158 /end MEASUREMENT
/begin MEASUREMENT Airflow3 "Final value after Linear Sensor Characterization" FLOAT32_IEEE CompuMethod_6 1 0 -1E+17 1E+17 ECU_ADDRESS 0x4000015C /end MEASUREMENT
/begin MEASUREMENT Airflow3_ADC "Singal measured directly from sensor" ULONG CompuMethod_7 1 0 0 4294970000 ECU_ADDRESS 0x40000160 /end MEASUREMENT
/begin MEASUREMENT Airflow3_Raw "After conversion to engineering units, before range checking" FLOAT32_IEEE CompuMethod_6 1 0 -1E+17 1E+17 ECU_ADDRESS 0x40000164 /end MEASUREMENT
/begin MEASUREMENT AllFaults.APP_RangeHigh._ "" UBYTE CompuMethod_13 1 0 0 1 ECU_ADDRESS 0x40000168 /end MEASUREMENT
/begin MEASUREMENT AllFaults.APP_RangeLow._ "" UBYTE CompuMethod_13 1 0 0 1 ECU_ADDRESS 0x40000169 /end MEASUREMENT
/begin MEASUREMENT AllFaults.Airflow2_RangeHigh._ "" UBYTE CompuMethod_13 1 0 0 1 ECU_ADDRESS 0x4000016A /end MEASUREMENT
/begin MEASUREMENT AllFaults.Airflow2_RangeLow._ "" UBYTE CompuMethod_13 1 0 0 1 ECU_ADDRESS 0x4000016B /end MEASUREMENT
/begin MEASUREMENT AllFaults.Airflow3_RangeHigh._ "" UBYTE CompuMethod_13 1 0 0 1 ECU_ADDRESS 0x4000016C /end MEASUREMENT
/begin MEASUREMENT AllFaults.Airflow3_RangeLow._ "" UBYTE CompuMethod_13 1 0 0 1 ECU_ADDRESS 0x4000016D /end MEASUREMENT
/begin MEASUREMENT AllFaults.Airflow_RangeHigh._ "" UBYTE CompuMethod_13 1 0 0 1 ECU_ADDRESS 0x4000016E /end MEASUREMENT
/begin MEASUREMENT AllFaults.Airflow_RangeLow._ "" UBYTE CompuMethod_13 1 0 0 1 ECU_ADDRESS 0x4000016F /end MEASUREMENT
/begin MEASUREMENT AllFaults.CCVS_Stale._ "" UBYTE CompuMethod_13 1 0 0 1 ECU_ADDRESS 0x40000170 /end MEASUREMENT
/begin MEASUREMENT AllFaults.COOLT_RangeHigh._ "" UBYTE CompuMethod_13 1 0 0 1 ECU_ADDRESS 0x40000171 /end MEASUREMENT
/begin MEASUREMENT AllFaults.COOLT_RangeLow._ "" UBYTE CompuMethod_13 1 0 0 1 ECU_ADDRESS 0x40000172 /end MEASUREMENT
/begin MEASUREMENT AllFaults.CoolP_RangeHigh._ "" UBYTE CompuMethod_13 1 0 0 1 ECU_ADDRESS 0x40000173 /end MEASUREMENT
/begin MEASUREMENT AllFaults.CoolP_RangeLow._ "" UBYTE CompuMethod_13 1 0 0 1 ECU_ADDRESS 0x40000174 /end MEASUREMENT
/begin MEASUREMENT AllFaults.DRVP_RangeHigh._ "" UBYTE CompuMethod_13 1 0 0 1 ECU_ADDRESS 0x40000175 /end MEASUREMENT
/begin MEASUREMENT AllFaults.DRVP_RangeLow._ "" UBYTE CompuMethod_13 1 0 0 1 ECU_ADDRESS 0x40000176 /end MEASUREMENT
/begin MEASUREMENT AllFaults.ECUP_RangeHigh._ "" UBYTE CompuMethod_13 1 0 0 1 ECU_ADDRESS 0x40000177 /end MEASUREMENT
/begin MEASUREMENT AllFaults.ECUP_RangeLow._ "" UBYTE CompuMethod_13 1 0 0 1 ECU_ADDRESS 0x40000178 /end MEASUREMENT
/begin MEASUREMENT AllFaults.ETCPosA_RangeHigh._ "" UBYTE CompuMethod_13 1 0 0 1 ECU_ADDRESS 0x40000179 /end MEASUREMENT
/begin MEASUREMENT AllFaults.ETCPosA_RangeLow._ "" UBYTE CompuMethod_13 1 0 0 1 ECU_ADDRESS 0x4000017A /end MEASUREMENT
/begin MEASUREMENT AllFaults.ETCPosB_RangeHigh._ "" UBYTE CompuMethod_13 1 0 0 1 ECU_ADDRESS 0x4000017B /end MEASUREMENT
/begin MEASUREMENT AllFaults.ETCPosB_RangeLow._ "" UBYTE CompuMethod_13 1 0 0 1 ECU_ADDRESS 0x4000017C /end MEASUREMENT
/begin MEASUREMENT AllFaults.ExT1_RangeHigh._ "" UBYTE CompuMethod_13 1 0 0 1 ECU_ADDRESS 0x4000017D /end MEASUREMENT
/begin MEASUREMENT AllFaults.ExT1_RangeLow._ "" UBYTE CompuMethod_13 1 0 0 1 ECU_ADDRESS 0x4000017E /end MEASUREMENT
/begin MEASUREMENT AllFaults.ExT2_RangeHigh._ "" UBYTE CompuMethod_13 1 0 0 1 ECU_ADDRESS 0x4000017F /end MEASUREMENT
/begin MEASUREMENT AllFaults.ExT2_RangeLow._ "" UBYTE CompuMethod_13 1 0 0 1 ECU_ADDRESS 0x40000180 /end MEASUREMENT
/begin MEASUREMENT AllFaults.FUELT_RangeHigh._ "" UBYTE CompuMethod_13 1 0 0 1 ECU_ADDRESS 0x40000181 /end MEASUREMENT
/begin MEASUREMENT AllFaults.FUELT_RangeLow._ "" UBYTE CompuMethod_13 1 0 0 1 ECU_ADDRESS 0x40000182 /end MEASUREMENT
/begin MEASUREMENT AllFaults.FuelP_RangeHigh._ "" UBYTE CompuMethod_13 1 0 0 1 ECU_ADDRESS 0x40000183 /end MEASUREMENT
/begin MEASUREMENT AllFaults.FuelP_RangeLow._ "" UBYTE CompuMethod_13 1 0 0 1 ECU_ADDRESS 0x40000184 /end MEASUREMENT
/begin MEASUREMENT AllFaults.IMP_RangeHigh._ "" UBYTE CompuMethod_13 1 0 0 1 ECU_ADDRESS 0x40000185 /end MEASUREMENT
/begin MEASUREMENT AllFaults.IMP_RangeLow._ "" UBYTE CompuMethod_13 1 0 0 1 ECU_ADDRESS 0x40000186 /end MEASUREMENT
/begin MEASUREMENT AllFaults.IMT_RangeHigh._ "" UBYTE CompuMethod_13 1 0 0 1 ECU_ADDRESS 0x40000187 /end MEASUREMENT
/begin MEASUREMENT AllFaults.IMT_RangeLow._ "" UBYTE CompuMethod_13 1 0 0 1 ECU_ADDRESS 0x40000188 /end MEASUREMENT
/begin MEASUREMENT AllFaults.Idle_CPU._ "" UBYTE CompuMethod_13 1 0 0 1 ECU_ADDRESS 0x40000189 /end MEASUREMENT
/begin MEASUREMENT AllFaults.O2A_RangeHigh._ "" UBYTE CompuMethod_13 1 0 0 1 ECU_ADDRESS 0x4000018A /end MEASUREMENT
/begin MEASUREMENT AllFaults.O2A_RangeLow._ "" UBYTE CompuMethod_13 1 0 0 1 ECU_ADDRESS 0x4000018B /end MEASUREMENT
/begin MEASUREMENT AllFaults.O2B_RangeHigh._ "" UBYTE CompuMethod_13 1 0 0 1 ECU_ADDRESS 0x4000018C /end MEASUREMENT
/begin MEASUREMENT AllFaults.O2B_RangeLow._ "" UBYTE CompuMethod_13 1 0 0 1 ECU_ADDRESS 0x4000018D /end MEASUREMENT
/begin MEASUREMENT AllFaults.O2C_RangeHigh._ "" UBYTE CompuMethod_13 1 0 0 1 ECU_ADDRESS 0x4000018E /end MEASUREMENT
/begin MEASUREMENT AllFaults.O2C_RangeLow._ "" UBYTE CompuMethod_13 1 0 0 1 ECU_ADDRESS 0x4000018F /end MEASUREMENT
/begin MEASUREMENT AllFaults.O2D_RangeHigh._ "" UBYTE CompuMethod_13 1 0 0 1 ECU_ADDRESS 0x40000190 /end MEASUREMENT
/begin MEASUREMENT AllFaults.O2D_RangeLow._ "" UBYTE CompuMethod_13 1 0 0 1 ECU_ADDRESS 0x40000191 /end MEASUREMENT
/begin MEASUREMENT AllFaults.OilP_RangeHigh._ "" UBYTE CompuMethod_13 1 0 0 1 ECU_ADDRESS 0x40000192 /end MEASUREMENT
/begin MEASUREMENT AllFaults.OilP_RangeLow._ "" UBYTE CompuMethod_13 1 0 0 1 ECU_ADDRESS 0x40000193 /end MEASUREMENT
/begin MEASUREMENT AllFaults.Pcyl1_RangeHigh._ "" UBYTE CompuMethod_13 1 0 0 1 ECU_ADDRESS 0x40000194 /end MEASUREMENT
/begin MEASUREMENT AllFaults.Pcyl1_RangeLow._ "" UBYTE CompuMethod_13 1 0 0 1 ECU_ADDRESS 0x40000195 /end MEASUREMENT
/begin MEASUREMENT AllFaults.Pcyl2_RangeHigh._ "" UBYTE CompuMethod_13 1 0 0 1 ECU_ADDRESS 0x40000196 /end MEASUREMENT
/begin MEASUREMENT AllFaults.Pcyl2_RangeLow._ "" UBYTE CompuMethod_13 1 0 0 1 ECU_ADDRESS 0x40000197 /end MEASUREMENT
/begin MEASUREMENT AllFaults.Pcyl3_RangeHigh._ "" UBYTE CompuMethod_13 1 0 0 1 ECU_ADDRESS 0x40000198 /end MEASUREMENT
/begin MEASUREMENT AllFaults.Pcyl3_RangeLow._ "" UBYTE CompuMethod_13 1 0 0 1 ECU_ADDRESS 0x40000199 /end MEASUREMENT
/begin MEASUREMENT AllFaults.Pcyl4_RangeHigh._ "" UBYTE CompuMethod_13 1 0 0 1 ECU_ADDRESS 0x4000019A /end MEASUREMENT
/begin MEASUREMENT AllFaults.Pcyl4_RangeLow._ "" UBYTE CompuMethod_13 1 0 0 1 ECU_ADDRESS 0x4000019B /end MEASUREMENT
/begin MEASUREMENT AllFaults.Pcyl5_RangeHigh._ "" UBYTE CompuMethod_13 1 0 0 1 ECU_ADDRESS 0x4000019C /end MEASUREMENT
/begin MEASUREMENT AllFaults.Pcyl5_RangeLow._ "" UBYTE CompuMethod_13 1 0 0 1 ECU_ADDRESS 0x4000019D /end MEASUREMENT
/begin MEASUREMENT AllFaults.Pcyl6_RangeHigh._ "" UBYTE CompuMethod_13 1 0 0 1 ECU_ADDRESS 0x4000019E /end MEASUREMENT
/begin MEASUREMENT AllFaults.Pcyl6_RangeLow._ "" UBYTE CompuMethod_13 1 0 0 1 ECU_ADDRESS 0x4000019F /end MEASUREMENT
/begin MEASUREMENT AllFaults.Pcyl7_RangeHigh._ "" UBYTE CompuMethod_13 1 0 0 1 ECU_ADDRESS 0x400001A0 /end MEASUREMENT
/begin MEASUREMENT AllFaults.Pcyl7_RangeLow._ "" UBYTE CompuMethod_13 1 0 0 1 ECU_ADDRESS 0x400001A1 /end MEASUREMENT
/begin MEASUREMENT AllFaults.Pcyl8_RangeHigh._ "" UBYTE CompuMethod_13 1 0 0 1 ECU_ADDRESS 0x400001A2 /end MEASUREMENT
/begin MEASUREMENT AllFaults.Pcyl8_RangeLow._ "" UBYTE CompuMethod_13 1 0 0 1 ECU_ADDRESS 0x400001A3 /end MEASUREMENT
/begin MEASUREMENT APP "Final value after Linear Sensor Characterization" FLOAT32_IEEE CompuMethod_14 1 0 -1E+17 1E+17 ECU_ADDRESS 0x400001A4 /end MEASUREMENT
/begin MEASUREMENT APP_ADC "Signal measured directly from sensor" UWORD CompuMethod_15 1 0 0 65535 ECU_ADDRESS 0x400001A8 /end MEASUREMENT
/begin MEASUREMENT APP_Raw "After conversion to engineering units, before range checking" FLOAT32_IEEE CompuMethod_14 1 0 -1E+17 1E+17 ECU_ADDRESS 0x400001AA /end MEASUREMENT
/begin MEASUREMENT APPIdx "" UWORD CompuMethod_16 1 0 0 127.998 ECU_ADDRESS 0x400001AE /end MEASUREMENT
/begin MEASUREMENT ApplicationInitStatus "Shows how far the module initialization has progressed" UBYTE CompuMethod_17 1 0 3 5 ECU_ADDRESS 0x400001B0 /end MEASUREMENT
/begin MEASUREMENT ApplicationInterruptTaskCPU "Percentage of CPU spent on ApplicationInterruptTask task" UWORD CompuMethod_18 1 0 0 100 ECU_ADDRESS 0x400001B1 /end MEASUREMENT
/begin MEASUREMENT ApplicationInterruptTaskStackMinBytesFree "Remaining bytes available on the ApplicationInterruptTask stack" UWORD CompuMethod_20 1 0 0 65535 ECU_ADDRESS 0x400001B3 /end MEASUREMENT
/begin MEASUREMENT ApplicationStopReason "Indicates the reason for an application stop" UWORD CompuMethod_24 1 0 0 5 ECU_ADDRESS 0x400001B5 /end MEASUREMENT
/begin MEASUREMENT ApplicationStopReasonAppLink "Indicates the reason for a notification-driven application stop" UWORD CompuMethod_25 1 0 0 65535 ECU_ADDRESS 0x400001B7 /end MEASUREMENT
/begin MEASUREMENT BGNDTaskCPU "Percentage of CPU spent on BGNDTask task" UWORD CompuMethod_18 1 0 0 100 ECU_ADDRESS 0x400001B9 /end MEASUREMENT
/begin MEASUREMENT BGNDTaskStackMinBytesFree "Remaining bytes available on the BGNDTask stack" UWORD CompuMethod_20 1 0 0 65535 ECU_ADDRESS 0x400001BB /end MEASUREMENT
/begin MEASUREMENT Capability "" UBYTE CompuMethod_27 1 0 0 255 ECU_ADDRESS 0x400001BD /end MEASUREMENT
/begin MEASUREMENT CC_effort "" FLOAT32_IEEE CompuMethod_2 1 0 -1E+17 1E+17 ECU_ADDRESS 0x400001BE /end MEASUREMENT
/begin MEASUREMENT CC_Error_kph "" FLOAT32_IEEE CompuMethod_2 1 0 -1E+17 1E+17 ECU_ADDRESS 0x400001C2 /end MEASUREMENT
/begin MEASUREMENT CC_FF "" FLOAT32_IEEE CompuMethod_28 1 0 -1E+17 1E+17 ECU_ADDRESS 0x400001C6 /end MEASUREMENT
/begin MEASUREMENT CC_FFeffort "" FLOAT32_IEEE CompuMethod_2 1 0 -1E+17 1E+17 ECU_ADDRESS 0x400001CA /end MEASUREMENT
/begin MEASUREMENT CC_FFIdx "" UWORD CompuMethod_16 1 0 0 127.998 ECU_ADDRESS 0x400001CE /end MEASUREMENT
/begin MEASUREMENT CC_FFIn "" FLOAT32_IEEE CompuMethod_29 1 0 -1E+17 1E+17 ECU_ADDRESS 0x400001D0 /end MEASUREMENT
/begin MEASUREMENT CC_Ieffort "" FLOAT32_IEEE CompuMethod_2 1 0 -1E+17 1E+17 ECU_ADDRESS 0x400001D4 /end MEASUREMENT
/begin MEASUREMENT CC_Ki "" FLOAT32_IEEE CompuMethod_30 1 0 -1E+17 1E+17 ECU_ADDRESS 0x400001D8 /end MEASUREMENT
/begin MEASUREMENT CC_KiIdx "" UWORD CompuMethod_16 1 0 0 127.998 ECU_ADDRESS 0x400001DC /end MEASUREMENT
/begin MEASUREMENT CC_KiIn "" FLOAT32_IEEE CompuMethod_31 1 0 -1E+17 1E+17 ECU_ADDRESS 0x400001DE /end MEASUREMENT
/begin MEASUREMENT CC_Kp "" FLOAT32_IEEE CompuMethod_32 1 0 -1E+17 1E+17 ECU_ADDRESS 0x400001E2 /end MEASUREMENT
/begin MEASUREMENT CC_KpIdx "" UWORD CompuMethod_16 1 0 0 127.998 ECU_ADDRESS 0x400001E6 /end MEASUREMENT
/begin MEASUREMENT CC_KpIn "" FLOAT32_IEEE CompuMethod_31 1 0 -1E+17 1E+17 ECU_ADDRESS 0x400001E8 /end MEASUREMENT
/begin MEASUREMENT CC_Mode "" SBYTE CompuMethod_34 1 0 -128 127 ECU_ADDRESS 0x400001EC /end MEASUREMENT
/begin MEASUREMENT CC_Peffort "" FLOAT32_IEEE CompuMethod_2 1 0 -1E+17 1E+17 ECU_ADDRESS 0x400001ED /end MEASUREMENT
/begin MEASUREMENT CC_PublishedMode "" UBYTE CompuMethod_35 1 0 0 255 ECU_ADDRESS 0x400001F1 /end MEASUREMENT
/begin MEASUREMENT CC_TargetSpeed "" FLOAT32_IEEE CompuMethod_2 1 0 -1E+17 1E+17 ECU_ADDRESS 0x400001F2 /end MEASUREMENT
/begin MEASUREMENT CCP_CCP1_Access.CCP_CCP1_CAL "Calibration Authentication Status for CCP Handler CCP1" UBYTE CompuMethod_37 1 0 0 1 ECU_ADDRESS 0x400001F6 BIT_MASK 0x00000001 /end MEASUREMENT
/begin MEASUREMENT CCP_CCP1_Access.CCP_CCP1_DAQ "Data Acquisition Authentication Status for CCP Handler CCP1" UBYTE CompuMethod_38 1 0 0 1 ECU_ADDRESS 0x400001F6 BIT_MASK 0x00000002 /end MEASUREMENT
/begin MEASUREMENT CCP_CCP1_Access.CCP_CCP1_PGM "Programming Authentication Status for CCP Handler CCP1" UBYTE CompuMethod_39 1 0 0 1 ECU_ADDRESS 0x400001F6 BIT_MASK 0x00000040 /end MEASUREMENT
/begin MEASUREMENT CCP_CCP1_Access "Current Access Code for CCP Handler CCP1" UBYTE CompuMethod_2 1 0 0 255 ECU_ADDRESS 0x400001F6 /end MEASUREMENT
/begin MEASUREMENT CCP_CCP1_ConnectionStatus "CCP Handler CCP1 connection status" UBYTE CompuMethod_40 1 0 0 255 ECU_ADDRESS 0x400001F7 /end MEASUREMENT
/begin MEASUREMENT CCP_CCP2_Access.CCP_CCP2_CAL "Calibration Authentication Status for CCP Handler CCP2" UBYTE CompuMethod_37 1 0 0 1 ECU_ADDRESS 0x400001F8 BIT_MASK 0x00000001 /end MEASUREMENT
/begin MEASUREMENT CCP_CCP2_Access.CCP_CCP2_DAQ "Data Acquisition Authentication Status for CCP Handler CCP2" UBYTE CompuMethod_38 1 0 0 1 ECU_ADDRESS 0x400001F8 BIT_MASK 0x00000002 /end MEASUREMENT
/begin MEASUREMENT CCP_CCP2_Access.CCP_CCP2_PGM "Programming Authentication Status for CCP Handler CCP2" UBYTE CompuMethod_39 1 0 0 1 ECU_ADDRESS 0x400001F8 BIT_MASK 0x00000040 /end MEASUREMENT
/begin MEASUREMENT CCP_CCP2_Access "Current Access Code for CCP Handler CCP2" UBYTE CompuMethod_2 1 0 0 255 ECU_ADDRESS 0x400001F8 /end MEASUREMENT
/begin MEASUREMENT CCP_CCP2_ConnectionStatus "CCP Handler CCP2 connection status" UBYTE CompuMethod_40 1 0 0 255 ECU_ADDRESS 0x400001F9 /end MEASUREMENT
/begin MEASUREMENT CCP_CCP3_Access.CCP_CCP3_CAL "Calibration Authentication Status for CCP Handler CCP3" UBYTE CompuMethod_37 1 0 0 1 ECU_ADDRESS 0x400001FA BIT_MASK 0x00000001 /end MEASUREMENT
/begin MEASUREMENT CCP_CCP3_Access.CCP_CCP3_DAQ "Data Acquisition Authentication Status for CCP Handler CCP3" UBYTE CompuMethod_38 1 0 0 1 ECU_ADDRESS 0x400001FA BIT_MASK 0x00000002 /end MEASUREMENT
/begin MEASUREMENT CCP_CCP3_Access.CCP_CCP3_PGM "Programming Authentication Status for CCP Handler CCP3" UBYTE CompuMethod_39 1 0 0 1 ECU_ADDRESS 0x400001FA BIT_MASK 0x00000040 /end MEASUREMENT
/begin MEASUREMENT CCP_CCP3_Access "Current Access Code for CCP Handler CCP3" UBYTE CompuMethod_2 1 0 0 255 ECU_ADDRESS 0x400001FA /end MEASUREMENT
/begin MEASUREMENT CCP_CCP3_ConnectionStatus "CCP Handler CCP3 connection status" UBYTE CompuMethod_40 1 0 0 255 ECU_ADDRESS 0x400001FB /end MEASUREMENT
/begin MEASUREMENT CCVS_Age "" ULONG CompuMethod_41 1 0 0 4294970000 ECU_ADDRESS 0x400001FC /end MEASUREMENT
/begin MEASUREMENT CCVS_CC_Brake "" UBYTE CompuMethod_13 1 0 0 1 ECU_ADDRESS 0x40000200 /end MEASUREMENT
/begin MEASUREMENT CCVS_CC_Clutch "" UBYTE CompuMethod_13 1 0 0 1 ECU_ADDRESS 0x40000201 /end MEASUREMENT
/begin MEASUREMENT CCVS_CC_Dec "" UBYTE CompuMethod_13 1 0 0 1 ECU_ADDRESS 0x40000202 /end MEASUREMENT
/begin MEASUREMENT CCVS_CC_Inc "" UBYTE CompuMethod_13 1 0 0 1 ECU_ADDRESS 0x40000203 /end MEASUREMENT
/begin MEASUREMENT CCVS_CC_Off "" UBYTE CompuMethod_13 1 0 0 1 ECU_ADDRESS 0x40000204 /end MEASUREMENT
/begin MEASUREMENT CCVS_CC_On "" UBYTE CompuMethod_13 1 0 0 1 ECU_ADDRESS 0x40000205 /end MEASUREMENT
/begin MEASUREMENT CCVS_CC_Resume "" UBYTE CompuMethod_13 1 0 0 1 ECU_ADDRESS 0x40000206 /end MEASUREMENT
/begin MEASUREMENT CCVS_CC_Set "" UBYTE CompuMethod_13 1 0 0 1 ECU_ADDRESS 0x40000207 /end MEASUREMENT
/begin MEASUREMENT CCVS_roadspeed "" FLOAT32_IEEE CompuMethod_2 1 0 -1E+17 1E+17 ECU_ADDRESS 0x40000208 /end MEASUREMENT
/begin MEASUREMENT CodeCoverParent000.CodeCover000029 "Determines if this subsystem has run" ULONG CompuMethod_42 1 0 0 1 ECU_ADDRESS 0x4000020C BIT_MASK 0x20000000 /end MEASUREMENT
/begin MEASUREMENT CodeCoverParent000.CodeCover000018 "Determines if this subsystem has run" ULONG CompuMethod_43 1 0 0 1 ECU_ADDRESS 0x4000020C BIT_MASK 0x00040000 /end MEASUREMENT
/begin MEASUREMENT CodeCoverParent000.CodeCover000007 "Determines if this subsystem has run" ULONG CompuMethod_44 1 0 0 1 ECU_ADDRESS 0x4000020C BIT_MASK 0x00000080 /end MEASUREMENT
/begin MEASUREMENT CodeCoverParent000.CodeCover000019 "Determines if this subsystem has run" ULONG CompuMethod_45 1 0 0 1 ECU_ADDRESS 0x4000020C BIT_MASK 0x00080000 /end MEASUREMENT
/begin MEASUREMENT CodeCoverParent000.CodeCover000008 "Determines if this subsystem has run" ULONG CompuMethod_46 1 0 0 1 ECU_ADDRESS 0x4000020C BIT_MASK 0x00000100 /end MEASUREMENT
/begin MEASUREMENT CodeCoverParent000.CodeCover000009 "Determines if this subsystem has run" ULONG CompuMethod_47 1 0 0 1 ECU_ADDRESS 0x4000020C BIT_MASK 0x00000200 /end MEASUREMENT
/begin MEASUREMENT CodeCoverParent000.CodeCover000030 "Determines if this subsystem has run" ULONG CompuMethod_48 1 0 0 1 ECU_ADDRESS 0x4000020C BIT_MASK 0x40000000 /end MEASUREMENT
/begin MEASUREMENT CodeCoverParent000.CodeCover000031 "Determines if this subsystem has run" ULONG CompuMethod_49 1 0 0 1 ECU_ADDRESS 0x4000020C BIT_MASK 0x80000000 /end MEASUREMENT
/begin MEASUREMENT CodeCoverParent000.CodeCover000020 "Determines if this subsystem has run" ULONG CompuMethod_50 1 0 0 1 ECU_ADDRESS 0x4000020C BIT_MASK 0x00100000 /end MEASUREMENT
/begin MEASUREMENT CodeCoverParent000.CodeCover000021 "Determines if this subsystem has run" ULONG CompuMethod_51 1 0 0 1 ECU_ADDRESS 0x4000020C BIT_MASK 0x00200000 /end MEASUREMENT
/begin MEASUREMENT CodeCoverParent000.CodeCover000010 "Determines if this subsystem has run" ULONG CompuMethod_52 1 0 0 1 ECU_ADDRESS 0x4000020C BIT_MASK 0x00000400 /end MEASUREMENT
/begin MEASUREMENT CodeCoverParent000.CodeCover000022 "Determines if this subsystem has run" ULONG CompuMethod_53 1 0 0 1 ECU_ADDRESS 0x4000020C BIT_MASK 0x00400000 /end MEASUREMENT
/begin MEASUREMENT CodeCoverParent000.CodeCover000011 "Determines if this subsystem has run" ULONG CompuMethod_54 1 0 0 1 ECU_ADDRESS 0x4000020C BIT_MASK 0x00000800 /end MEASUREMENT
/begin MEASUREMENT CodeCoverParent000.CodeCover000000 "Determines if this subsystem has run" ULONG CompuMethod_55 1 0 0 1 ECU_ADDRESS 0x4000020C BIT_MASK 0x00000001 /end MEASUREMENT
/begin MEASUREMENT CodeCoverParent000.CodeCover000023 "Determines if this subsystem has run" ULONG CompuMethod_56 1 0 0 1 ECU_ADDRESS 0x4000020C BIT_MASK 0x00800000 /end MEASUREMENT
/begin MEASUREMENT CodeCoverParent000.CodeCover000012 "Determines if this subsystem has run" ULONG CompuMethod_57 1 0 0 1 ECU_ADDRESS 0x4000020C BIT_MASK 0x00001000 /end MEASUREMENT
/begin MEASUREMENT CodeCoverParent000.CodeCover000001 "Determines if this subsystem has run" ULONG CompuMethod_58 1 0 0 1 ECU_ADDRESS 0x4000020C BIT_MASK 0x00000002 /end MEASUREMENT
/begin MEASUREMENT CodeCoverParent000.CodeCover000024 "Determines if this subsystem has run" ULONG CompuMethod_59 1 0 0 1 ECU_ADDRESS 0x4000020C BIT_MASK 0x01000000 /end MEASUREMENT
/begin MEASUREMENT CodeCoverParent000.CodeCover000013 "Determines if this subsystem has run" ULONG CompuMethod_60 1 0 0 1 ECU_ADDRESS 0x4000020C BIT_MASK 0x00002000 /end MEASUREMENT
/begin MEASUREMENT CodeCoverParent000.CodeCover000002 "Determines if this subsystem has run" ULONG CompuMethod_61 1 0 0 1 ECU_ADDRESS 0x4000020C BIT_MASK 0x00000004 /end MEASUREMENT
/begin MEASUREMENT CodeCoverParent000.CodeCover000025 "Determines if this subsystem has run" ULONG CompuMethod_62 1 0 0 1 ECU_ADDRESS 0x4000020C BIT_MASK 0x02000000 /end MEASUREMENT
/begin MEASUREMENT CodeCoverParent000.CodeCover000014 "Determines if this subsystem has run" ULONG CompuMethod_63 1 0 0 1 ECU_ADDRESS 0x4000020C BIT_MASK 0x00004000 /end MEASUREMENT
/begin MEASUREMENT CodeCoverParent000.CodeCover000003 "Determines if this subsystem has run" ULONG CompuMethod_64 1 0 0 1 ECU_ADDRESS 0x4000020C BIT_MASK 0x00000008 /end MEASUREMENT
/begin MEASUREMENT CodeCoverParent000.CodeCover000026 "Determines if this subsystem has run" ULONG CompuMethod_65 1 0 0 1 ECU_ADDRESS 0x4000020C BIT_MASK 0x04000000 /end MEASUREMENT
/begin MEASUREMENT CodeCoverParent000.CodeCover000015 "Determines if this subsystem has run" ULONG CompuMethod_66 1 0 0 1 ECU_ADDRESS 0x4000020C BIT_MASK 0x00008000 /end MEASUREMENT
/begin MEASUREMENT CodeCoverParent000.CodeCover000004 "Determines if this subsystem has run" ULONG CompuMethod_67 1 0 0 1 ECU_ADDRESS 0x4000020C BIT_MASK 0x00000010 /end MEASUREMENT
/begin MEASUREMENT CodeCoverParent000.CodeCover000027 "Determines if this subsystem has run" ULONG CompuMethod_68 1 0 0 1 ECU_ADDRESS 0x4000020C BIT_MASK 0x08000000 /end MEASUREMENT
/begin MEASUREMENT CodeCoverParent000.CodeCover000016 "Determines if this subsystem has run" ULONG CompuMethod_69 1 0 0 1 ECU_ADDRESS 0x4000020C BIT_MASK 0x00010000 /end MEASUREMENT
/begin MEASUREMENT CodeCoverParent000.CodeCover000005 "Determines if this subsystem has run" ULONG CompuMethod_70 1 0 0 1 ECU_ADDRESS 0x4000020C BIT_MASK 0x00000020 /end MEASUREMENT
/begin MEASUREMENT CodeCoverParent000.CodeCover000028 "Determines if this subsystem has run" ULONG CompuMethod_71 1 0 0 1 ECU_ADDRESS 0x4000020C BIT_MASK 0x10000000 /end MEASUREMENT
/begin MEASUREMENT CodeCoverParent000.CodeCover000017 "Determines if this subsystem has run" ULONG CompuMethod_72 1 0 0 1 ECU_ADDRESS 0x4000020C BIT_MASK 0x00020000 /end MEASUREMENT
/begin MEASUREMENT CodeCoverParent000.CodeCover000006 "Determines if this subsystem has run" ULONG CompuMethod_73 1 0 0 1 ECU_ADDRESS 0x4000020C BIT_MASK 0x00000040 /end MEASUREMENT
/begin MEASUREMENT CodeCoverParent000 "Run Status of Subsystems" ULONG CompuMethod_2 1 0 0 4294967295 ECU_ADDRESS 0x4000020C /end MEASUREMENT
/begin MEASUREMENT CodeCoverParent001.CodeCover000060 "Determines if this subsystem has run" ULONG CompuMethod_74 1 0 0 1 ECU_ADDRESS 0x40000210 BIT_MASK 0x10000000 /end MEASUREMENT
/begin MEASUREMENT CodeCoverParent001.CodeCover000061 "Determines if this subsystem has run" ULONG CompuMethod_75 1 0 0 1 ECU_ADDRESS 0x40000210 BIT_MASK 0x20000000 /end MEASUREMENT
/begin MEASUREMENT CodeCoverParent001.CodeCover000050 "Determines if this subsystem has run" ULONG CompuMethod_76 1 0 0 1 ECU_ADDRESS 0x40000210 BIT_MASK 0x00040000 /end MEASUREMENT
/begin MEASUREMENT CodeCoverParent001.CodeCover000062 "Determines if this subsystem has run" ULONG CompuMethod_77 1 0 0 1 ECU_ADDRESS 0x40000210 BIT_MASK 0x40000000 /end MEASUREMENT
/begin MEASUREMENT CodeCoverParent001.CodeCover000051 "Determines if this subsystem has run" ULONG CompuMethod_78 1 0 0 1 ECU_ADDRESS 0x40000210 BIT_MASK 0x00080000 /end MEASUREMENT
/begin MEASUREMENT CodeCoverParent001.CodeCover000040 "Determines if this subsystem has run" ULONG CompuMethod_79 1 0 0 1 ECU_ADDRESS 0x40000210 BIT_MASK 0x00000100 /end MEASUREMENT
/begin MEASUREMENT CodeCoverParent001.CodeCover000063 "Determines if this subsystem has run" ULONG CompuMethod_80 1 0 0 1 ECU_ADDRESS 0x40000210 BIT_MASK 0x80000000 /end MEASUREMENT
/begin MEASUREMENT CodeCoverParent001.CodeCover000052 "Determines if this subsystem has run" ULONG CompuMethod_81 1 0 0 1 ECU_ADDRESS 0x40000210 BIT_MASK 0x00100000 /end MEASUREMENT
/begin MEASUREMENT CodeCoverParent001.CodeCover000041 "Determines if this subsystem has run" ULONG CompuMethod_82 1 0 0 1 ECU_ADDRESS 0x40000210 BIT_MASK 0x00000200 /end MEASUREMENT
/begin MEASUREMENT CodeCoverParent001.CodeCover000053 "Determines if this subsystem has run" ULONG CompuMethod_83 1 0 0 1 ECU_ADDRESS 0x40000210 BIT_MASK 0x00200000 /end MEASUREMENT
/begin MEASUREMENT CodeCoverParent001.CodeCover000042 "Determines if this subsystem has run" ULONG CompuMethod_84 1 0 0 1 ECU_ADDRESS 0x40000210 BIT_MASK 0x00000400 /end MEASUREMENT
/begin MEASUREMENT CodeCoverParent001.CodeCover000054 "Determines if this subsystem has run" ULONG CompuMethod_85 1 0 0 1 ECU_ADDRESS 0x40000210 BIT_MASK 0x00400000 /end MEASUREMENT
/begin MEASUREMENT CodeCoverParent001.CodeCover000043 "Determines if this subsystem has run" ULONG CompuMethod_86 1 0 0 1 ECU_ADDRESS 0x40000210 BIT_MASK 0x00000800 /end MEASUREMENT
/begin MEASUREMENT CodeCoverParent001.CodeCover000032 "Determines if this subsystem has run" ULONG CompuMethod_87 1 0 0 1 ECU_ADDRESS 0x40000210 BIT_MASK 0x00000001 /end MEASUREMENT
/begin MEASUREMENT CodeCoverParent001.CodeCover000055 "Determines if this subsystem has run" ULONG CompuMethod_88 1 0 0 1 ECU_ADDRESS 0x40000210 BIT_MASK 0x00800000 /end MEASUREMENT
/begin MEASUREMENT CodeCoverParent001.CodeCover000044 "Determines if this subsystem has run" ULONG CompuMethod_89 1 0 0 1 ECU_ADDRESS 0x40000210 BIT_MASK 0x00001000 /end MEASUREMENT
/begin MEASUREMENT CodeCoverParent001.CodeCover000033 "Determines if this subsystem has run" ULONG CompuMethod_90 1 0 0 1 ECU_ADDRESS 0x40000210 BIT_MASK 0x00000002 /end MEASUREMENT
/begin MEASUREMENT CodeCoverParent001.CodeCover000056 "Determines if this subsystem has run" ULONG CompuMethod_91 1 0 0 1 ECU_ADDRESS 0x40000210 BIT_MASK 0x01000000 /end MEASUREMENT
/begin MEASUREMENT CodeCoverParent001.CodeCover000045 "Determines if this subsystem has run" ULONG CompuMethod_92 1 0 0 1 ECU_ADDRESS 0x40000210 BIT_MASK 0x00002000 /end MEASUREMENT
/begin MEASUREMENT CodeCoverParent001.CodeCover000034 "Determines if this subsystem has run" ULONG CompuMethod_93 1 0 0 1 ECU_ADDRESS 0x40000210 BIT_MASK 0x00000004 /end MEASUREMENT
/begin MEASUREMENT CodeCoverParent001.CodeCover000057 "Determines if this subsystem has run" ULONG CompuMethod_94 1 0 0 1 ECU_ADDRESS 0x40000210 BIT_MASK 0x02000000 /end MEASUREMENT
/begin MEASUREMENT CodeCoverParent001.CodeCover000046 "Determines if this subsystem has run" ULONG CompuMethod_95 1 0 0 1 ECU_ADDRESS 0x40000210 BIT_MASK 0x00004000 /end MEASUREMENT
/begin MEASUREMENT CodeCoverParent001.CodeCover000035 "Determines if this subsystem has run" ULONG CompuMethod_96 1 0 0 1 ECU_ADDRESS 0x40000210 BIT_MASK 0x00000008 /end MEASUREMENT
/begin MEASUREMENT CodeCoverParent001.CodeCover000058 "Determines if this subsystem has run" ULONG CompuMethod_97 1 0 0 1 ECU_ADDRESS 0x40000210 BIT_MASK 0x04000000 /end MEASUREMENT
/begin MEASUREMENT CodeCoverParent001.CodeCover000047 "Determines if this subsystem has run" ULONG CompuMethod_98 1 0 0 1 ECU_ADDRESS 0x40000210 BIT_MASK 0x00008000 /end MEASUREMENT
/begin MEASUREMENT CodeCoverParent001.CodeCover000036 "Determines if this subsystem has run" ULONG CompuMethod_99 1 0 0 1 ECU_ADDRESS 0x40000210 BIT_MASK 0x00000010 /end MEASUREMENT
/begin MEASUREMENT CodeCoverParent001.CodeCover000059 "Determines if this subsystem has run" ULONG CompuMethod_100 1 0 0 1 ECU_ADDRESS 0x40000210 BIT_MASK 0x08000000 /end MEASUREMENT
/begin MEASUREMENT CodeCoverParent001.CodeCover000048 "Determines if this subsystem has run" ULONG CompuMethod_101 1 0 0 1 ECU_ADDRESS 0x40000210 BIT_MASK 0x00010000 /end MEASUREMENT
/begin MEASUREMENT CodeCoverParent001.CodeCover000037 "Determines if this subsystem has run" ULONG CompuMethod_102 1 0 0 1 ECU_ADDRESS 0x40000210 BIT_MASK 0x00000020 /end MEASUREMENT
/begin MEASUREMENT CodeCoverParent001.CodeCover000049 "Determines if this subsystem has run" ULONG CompuMethod_103 1 0 0 1 ECU_ADDRESS 0x40000210 BIT_MASK 0x00020000 /end MEASUREMENT
/begin MEASUREMENT CodeCoverParent001.CodeCover000038 "Determines if this subsystem has run" ULONG CompuMethod_104 1 0 0 1 ECU_ADDRESS 0x40000210 BIT_MASK 0x00000040 /end MEASUREMENT
/begin MEASUREMENT CodeCoverParent001.CodeCover000039 "Determines if this subsystem has run" ULONG CompuMethod_105 1 0 0 1 ECU_ADDRESS 0x40000210 BIT_MASK 0x00000080 /end MEASUREMENT
/begin MEASUREMENT CodeCoverParent001 "Run Status of Subsystems" ULONG CompuMethod_2 1 0 0 4294967295 ECU_ADDRESS 0x40000210 /end MEASUREMENT
/begin MEASUREMENT CodeCoverParent002.CodeCover000090 "Determines if this subsystem has run" ULONG CompuMethod_106 1 0 0 1 ECU_ADDRESS 0x40000214 BIT_MASK 0x04000000 /end MEASUREMENT
/begin MEASUREMENT CodeCoverParent002.CodeCover000091 "Determines if this subsystem has run" ULONG CompuMethod_107 1 0 0 1 ECU_ADDRESS 0x40000214 BIT_MASK 0x08000000 /end MEASUREMENT
/begin MEASUREMENT CodeCoverParent002.CodeCover000080 "Determines if this subsystem has run" ULONG CompuMethod_108 1 0 0 1 ECU_ADDRESS 0x40000214 BIT_MASK 0x00010000 /end MEASUREMENT
/begin MEASUREMENT CodeCoverParent002.CodeCover000092 "Determines if this subsystem has run" ULONG CompuMethod_109 1 0 0 1 ECU_ADDRESS 0x40000214 BIT_MASK 0x10000000 /end MEASUREMENT
/begin MEASUREMENT CodeCoverParent002.CodeCover000081 "Determines if this subsystem has run" ULONG CompuMethod_110 1 0 0 1 ECU_ADDRESS 0x40000214 BIT_MASK 0x00020000 /end MEASUREMENT
/begin MEASUREMENT CodeCoverParent002.CodeCover000070 "Determines if this subsystem has run" ULONG CompuMethod_111 1 0 0 1 ECU_ADDRESS 0x40000214 BIT_MASK 0x00000040 /end MEASUREMENT
/begin MEASUREMENT CodeCoverParent002.CodeCover000093 "Determines if this subsystem has run" ULONG CompuMethod_112 1 0 0 1 ECU_ADDRESS 0x40000214 BIT_MASK 0x20000000 /end MEASUREMENT
/begin MEASUREMENT CodeCoverParent002.CodeCover000082 "Determines if this subsystem has run" ULONG CompuMethod_113 1 0 0 1 ECU_ADDRESS 0x40000214 BIT_MASK 0x00040000 /end MEASUREMENT
/begin MEASUREMENT CodeCoverParent002.CodeCover000071 "Determines if this subsystem has run" ULONG CompuMethod_114 1 0 0 1 ECU_ADDRESS 0x40000214 BIT_MASK 0x00000080 /end MEASUREMENT
/begin MEASUREMENT CodeCoverParent002.CodeCover000094 "Determines if this subsystem has run" ULONG CompuMethod_115 1 0 0 1 ECU_ADDRESS 0x40000214 BIT_MASK 0x40000000 /end MEASUREMENT
/begin MEASUREMENT CodeCoverParent002.CodeCover000083 "Determines if this subsystem has run" ULONG CompuMethod_116 1 0 0 1 ECU_ADDRESS 0x40000214 BIT_MASK 0x00080000 /end MEASUREMENT
/begin MEASUREMENT CodeCoverParent002.CodeCover000072 "Determines if this subsystem has run" ULONG CompuMethod_117 1 0 0 1 ECU_ADDRESS 0x40000214 BIT_MASK 0x00000100 /end MEASUREMENT
/begin MEASUREMENT CodeCoverParent002.CodeCover000095 "Determines if this subsystem has run" ULONG CompuMethod_118 1 0 0 1 ECU_ADDRESS 0x40000214 BIT_MASK 0x80000000 /end MEASUREMENT
/begin MEASUREMENT CodeCoverParent002.CodeCover000084 "Determines if this subsystem has run" ULONG CompuMethod_119 1 0 0 1 ECU_ADDRESS 0x40000214 BIT_MASK 0x00100000 /end MEASUREMENT
/begin MEASUREMENT CodeCoverParent002.CodeCover000073 "Determines if this subsystem has run" ULONG CompuMethod_120 1 0 0 1 ECU_ADDRESS 0x40000214 BIT_MASK 0x00000200 /end MEASUREMENT
/begin MEASUREMENT CodeCoverParent002.CodeCover000085 "Determines if this subsystem has run" ULONG CompuMethod_121 1 0 0 1 ECU_ADDRESS 0x40000214 BIT_MASK 0x00200000 /end MEASUREMENT
/begin MEASUREMENT CodeCoverParent002.CodeCover000074 "Determines if this subsystem has run" ULONG CompuMethod_122 1 0 0 1 ECU_ADDRESS 0x40000214 BIT_MASK 0x00000400 /end MEASUREMENT
/begin MEASUREMENT CodeCoverParent002.CodeCover000086 "Determines if this subsystem has run" ULONG CompuMethod_123 1 0 0 1 ECU_ADDRESS 0x40000214 BIT_MASK 0x00400000 /end MEASUREMENT
/begin MEASUREMENT CodeCoverParent002.CodeCover000075 "Determines if this subsystem has run" ULONG CompuMethod_124 1 0 0 1 ECU_ADDRESS 0x40000214 BIT_MASK 0x00000800 /end MEASUREMENT
/begin MEASUREMENT CodeCoverParent002.CodeCover000064 "Determines if this subsystem has run" ULONG CompuMethod_125 1 0 0 1 ECU_ADDRESS 0x40000214 BIT_MASK 0x00000001 /end MEASUREMENT
/begin MEASUREMENT CodeCoverParent002.CodeCover000087 "Determines if this subsystem has run" ULONG CompuMethod_126 1 0 0 1 ECU_ADDRESS 0x40000214 BIT_MASK 0x00800000 /end MEASUREMENT
/begin MEASUREMENT CodeCoverParent002.CodeCover000076 "Determines if this subsystem has run" ULONG CompuMethod_127 1 0 0 1 ECU_ADDRESS 0x40000214 BIT_MASK 0x00001000 /end MEASUREMENT
/begin MEASUREMENT CodeCoverParent002.CodeCover000065 "Determines if this subsystem has run" ULONG CompuMethod_128 1 0 0 1 ECU_ADDRESS 0x40000214 BIT_MASK 0x00000002 /end MEASUREMENT
/begin MEASUREMENT CodeCoverParent002.CodeCover000088 "Determines if this subsystem has run" ULONG CompuMethod_129 1 0 0 1 ECU_ADDRESS 0x40000214 BIT_MASK 0x01000000 /end MEASUREMENT
/begin MEASUREMENT CodeCoverParent002.CodeCover000077 "Determines if this subsystem has run" ULONG CompuMethod_130 1 0 0 1 ECU_ADDRESS 0x40000214 BIT_MASK 0x00002000 /end MEASUREMENT
/begin MEASUREMENT CodeCoverParent002.CodeCover000066 "Determines if this subsystem has run" ULONG CompuMethod_131 1 0 0 1 ECU_ADDRESS 0x40000214 BIT_MASK 0x00000004 /end MEASUREMENT
/begin MEASUREMENT CodeCoverParent002.CodeCover000089 "Determines if this subsystem has run" ULONG CompuMethod_132 1 0 0 1 ECU_ADDRESS 0x40000214 BIT_MASK 0x02000000 /end MEASUREMENT
/begin MEASUREMENT CodeCoverParent002.CodeCover000078 "Determines if this subsystem has run" ULONG CompuMethod_133 1 0 0 1 ECU_ADDRESS 0x40000214 BIT_MASK 0x00004000 /end MEASUREMENT
/begin MEASUREMENT CodeCoverParent002.CodeCover000067 "Determines if this subsystem has run" ULONG CompuMethod_134 1 0 0 1 ECU_ADDRESS 0x40000214 BIT_MASK 0x00000008 /end MEASUREMENT
/begin MEASUREMENT CodeCoverParent002.CodeCover000079 "Determines if this subsystem has run" ULONG CompuMethod_135 1 0 0 1 ECU_ADDRESS 0x40000214 BIT_MASK 0x00008000 /end MEASUREMENT
/begin MEASUREMENT CodeCoverParent002.CodeCover000068 "Determines if this subsystem has run" ULONG CompuMethod_136 1 0 0 1 ECU_ADDRESS 0x40000214 BIT_MASK 0x00000010 /end MEASUREMENT
/begin MEASUREMENT CodeCoverParent002.CodeCover000069 "Determines if this subsystem has run" ULONG CompuMethod_137 1 0 0 1 ECU_ADDRESS 0x40000214 BIT_MASK 0x00000020 /end MEASUREMENT
/begin MEASUREMENT CodeCoverParent002 "Run Status of Subsystems" ULONG CompuMethod_2 1 0 0 4294967295 ECU_ADDRESS 0x40000214 /end MEASUREMENT
/begin MEASUREMENT CodeCoverParent003.CodeCover000096 "Determines if this subsystem has run" ULONG CompuMethod_138 1 0 0 1 ECU_ADDRESS 0x40000218 BIT_MASK 0x00000001 /end MEASUREMENT
/begin MEASUREMENT CodeCoverParent003.CodeCover000097 "Determines if this subsystem has run" ULONG CompuMethod_139 1 0 0 1 ECU_ADDRESS 0x40000218 BIT_MASK 0x00000002 /end MEASUREMENT
/begin MEASUREMENT CodeCoverParent003.CodeCover000098 "Determines if this subsystem has run" ULONG CompuMethod_140 1 0 0 1 ECU_ADDRESS 0x40000218 BIT_MASK 0x00000004 /end MEASUREMENT
/begin MEASUREMENT CodeCoverParent003.CodeCover000099 "Determines if this subsystem has run" ULONG CompuMethod_141 1 0 0 1 ECU_ADDRESS 0x40000218 BIT_MASK 0x00000008 /end MEASUREMENT
/begin MEASUREMENT CodeCoverParent003.CodeCover000100 "Determines if this subsystem has run" ULONG CompuMethod_142 1 0 0 1 ECU_ADDRESS 0x40000218 BIT_MASK 0x00000010 /end MEASUREMENT
/begin MEASUREMENT CodeCoverParent003 "Run Status of Subsystems" ULONG CompuMethod_2 1 0 0 4294967295 ECU_ADDRESS 0x40000218 /end MEASUREMENT
/begin MEASUREMENT CoolP "Final value after Linear Sensor Characterization" FLOAT32_IEEE CompuMethod_143 1 0 -1E+17 1E+17 ECU_ADDRESS 0x4000026C /end MEASUREMENT
/begin MEASUREMENT CoolP_ADC "Signal measured directly from sensor" UWORD CompuMethod_15 1 0 0 65535 ECU_ADDRESS 0x40000270 /end MEASUREMENT
/begin MEASUREMENT CoolP_Raw "After conversion to engineering units, before range checking" FLOAT32_IEEE CompuMethod_143 1 0 -1E+17 1E+17 ECU_ADDRESS 0x40000272 /end MEASUREMENT
/begin MEASUREMENT CoolPIdx "" UWORD CompuMethod_16 1 0 0 127.998 ECU_ADDRESS 0x40000276 /end MEASUREMENT
/begin MEASUREMENT COOLT "Final value after Linear Sensor Characterization" FLOAT32_IEEE CompuMethod_144 1 0 -1E+17 1E+17 ECU_ADDRESS 0x40000278 /end MEASUREMENT
/begin MEASUREMENT COOLT_ADC "Signal measured directly from sensor" UWORD CompuMethod_15 1 0 0 65535 ECU_ADDRESS 0x4000027C /end MEASUREMENT
/begin MEASUREMENT COOLT_Raw "After conversion to engineering units, before range checking" FLOAT32_IEEE CompuMethod_144 1 0 -1E+17 1E+17 ECU_ADDRESS 0x4000027E /end MEASUREMENT
/begin MEASUREMENT COOLTIdx "" UWORD CompuMethod_16 1 0 0 127.998 ECU_ADDRESS 0x40000282 /end MEASUREMENT
/begin MEASUREMENT CPUIdlePcnt "Percentage of CPU spent executing idle activity" UWORD CompuMethod_18 1 0 0 100 ECU_ADDRESS 0x40000284 /end MEASUREMENT
/begin MEASUREMENT DRVP "Final value after Linear Sensor Characterization" FLOAT32_IEEE CompuMethod_145 1 0 -1E+17 1E+17 ECU_ADDRESS 0x40000286 /end MEASUREMENT
/begin MEASUREMENT DRVP_ADC "Singal measured directly from sensor" UWORD CompuMethod_15 1 0 0 65535 ECU_ADDRESS 0x4000028A /end MEASUREMENT
/begin MEASUREMENT DRVP_Raw "After conversion to engineering units, before range checking" FLOAT32_IEEE CompuMethod_145 1 0 -1E+17 1E+17 ECU_ADDRESS 0x4000028C /end MEASUREMENT
/begin MEASUREMENT ECUP "Final value after Linear Sensor Characterization" FLOAT32_IEEE CompuMethod_145 1 0 -1E+17 1E+17 ECU_ADDRESS 0x40000290 /end MEASUREMENT
/begin MEASUREMENT ECUP_ADC "Singal measured directly from sensor" UWORD CompuMethod_15 1 0 0 65535 ECU_ADDRESS 0x40000294 /end MEASUREMENT
/begin MEASUREMENT ECUP_Raw "After conversion to engineering units, before range checking" FLOAT32_IEEE CompuMethod_145 1 0 -1E+17 1E+17 ECU_ADDRESS 0x40000296 /end MEASUREMENT
/begin MEASUREMENT EncoderFault "Encoder synchronization fault status" UBYTE CompuMethod_148 1 0 0 255 ECU_ADDRESS 0x4000029A /end MEASUREMENT
/begin MEASUREMENT EncoderFaultCount "" ULONG CompuMethod_41 1 0 0 4294970000 ECU_ADDRESS 0x4000029B /end MEASUREMENT
/begin MEASUREMENT EncoderState "Encoder synchronization status" UBYTE CompuMethod_149 1 0 0 255 ECU_ADDRESS 0x4000029F /end MEASUREMENT
/begin MEASUREMENT EncoderTDCOrder "Order of TDC angles (0 means unused)" SBYTE CompuMethod_152 1 0 -1 127 ECU_ADDRESS 0x400002A0 MATRIX_DIM 8 1 1 /end MEASUREMENT
/begin MEASUREMENT ETC_effort "" FLOAT32_IEEE CompuMethod_2 1 0 -1E+17 1E+17 ECU_ADDRESS 0x400002A8 /end MEASUREMENT
/begin MEASUREMENT ETC_Ieffort "" FLOAT32_IEEE CompuMethod_2 1 0 -1E+17 1E+17 ECU_ADDRESS 0x400002AC /end MEASUREMENT
/begin MEASUREMENT ETC_Peffort "" FLOAT32_IEEE CompuMethod_2 1 0 -1E+17 1E+17 ECU_ADDRESS 0x400002B0 /end MEASUREMENT
/begin MEASUREMENT ETCPosA "Final value after Linear Sensor Characterization" FLOAT32_IEEE CompuMethod_153 1 0 -1E+17 1E+17 ECU_ADDRESS 0x400002B4 /end MEASUREMENT
/begin MEASUREMENT ETCPosA_ADC "Signal measured directly from sensor" UWORD CompuMethod_15 1 0 0 65535 ECU_ADDRESS 0x400002B8 /end MEASUREMENT
/begin MEASUREMENT ETCPosA_Raw "After conversion to engineering units, before range checking" FLOAT32_IEEE CompuMethod_153 1 0 -1E+17 1E+17 ECU_ADDRESS 0x400002BA /end MEASUREMENT
/begin MEASUREMENT ETCPosAIdx "" UWORD CompuMethod_16 1 0 0 127.998 ECU_ADDRESS 0x400002BE /end MEASUREMENT
/begin MEASUREMENT ETCPosB "Final value after Linear Sensor Characterization" FLOAT32_IEEE CompuMethod_14 1 0 -1E+17 1E+17 ECU_ADDRESS 0x400002C0 /end MEASUREMENT
/begin MEASUREMENT ETCPosB_ADC "Signal measured directly from sensor" UWORD CompuMethod_15 1 0 0 65535 ECU_ADDRESS 0x400002C4 /end MEASUREMENT
/begin MEASUREMENT ETCPosB_Raw "After conversion to engineering units, before range checking" FLOAT32_IEEE CompuMethod_14 1 0 -1E+17 1E+17 ECU_ADDRESS 0x400002C6 /end MEASUREMENT
/begin MEASUREMENT ETCPosBIdx "" UWORD CompuMethod_16 1 0 0 127.998 ECU_ADDRESS 0x400002CA /end MEASUREMENT
/begin MEASUREMENT ExT1 "Final value after Linear Sensor Characterization" FLOAT32_IEEE CompuMethod_144 1 0 -1E+17 1E+17 ECU_ADDRESS 0x400002CC /end MEASUREMENT
/begin MEASUREMENT ExT1_ADC "Signal measured directly from sensor" UWORD CompuMethod_15 1 0 0 65535 ECU_ADDRESS 0x400002D0 /end MEASUREMENT
/begin MEASUREMENT ExT1_Raw "After conversion to engineering units, before range checking" FLOAT32_IEEE CompuMethod_144 1 0 -1E+17 1E+17 ECU_ADDRESS 0x400002D2 /end MEASUREMENT
/begin MEASUREMENT ExT1Idx "" UWORD CompuMethod_16 1 0 0 127.998 ECU_ADDRESS 0x400002D6 /end MEASUREMENT
/begin MEASUREMENT ExT2 "Final value after Linear Sensor Characterization" FLOAT32_IEEE CompuMethod_144 1 0 -1E+17 1E+17 ECU_ADDRESS 0x400002D8 /end MEASUREMENT
/begin MEASUREMENT ExT2_ADC "Signal measured directly from sensor" UWORD CompuMethod_15 1 0 0 65535 ECU_ADDRESS 0x400002DC /end MEASUREMENT
/begin MEASUREMENT ExT2_Raw "After conversion to engineering units, before range checking" FLOAT32_IEEE CompuMethod_144 1 0 -1E+17 1E+17 ECU_ADDRESS 0x400002DE /end MEASUREMENT
/begin MEASUREMENT ExT2Idx "" UWORD CompuMethod_16 1 0 0 127.998 ECU_ADDRESS 0x400002E2 /end MEASUREMENT
/begin MEASUREMENT FaultActionReason._.DisableFuel "Displays a rolling marquee of the reasons for fault action: FaultActionReason." UBYTE CompuMethod_154 1 0 0 255 ECU_ADDRESS 0x400002E4 /end MEASUREMENT
/begin MEASUREMENT FaultActionReason._.DisableIAC "Displays a rolling marquee of the reasons for fault action: FaultActionReason." UBYTE CompuMethod_154 1 0 0 255 ECU_ADDRESS 0x400002E5 /end MEASUREMENT
/begin MEASUREMENT FaultActionReason._.DisableSpark "Displays a rolling marquee of the reasons for fault action: FaultActionReason." UBYTE CompuMethod_154 1 0 0 255 ECU_ADDRESS 0x400002E6 /end MEASUREMENT
/begin MEASUREMENT FaultActionReason._.DisableThrottle "Displays a rolling marquee of the reasons for fault action: FaultActionReason." UBYTE CompuMethod_154 1 0 0 255 ECU_ADDRESS 0x400002E7 /end MEASUREMENT
/begin MEASUREMENT FaultActionReason._.IlluminateMIL "Displays a rolling marquee of the reasons for fault action: FaultActionReason." UBYTE CompuMethod_154 1 0 0 255 ECU_ADDRESS 0x400002E8 /end MEASUREMENT
/begin MEASUREMENT FGNDTaskCPU "Percentage of CPU spent on FGNDTask task" UWORD CompuMethod_18 1 0 0 100 ECU_ADDRESS 0x400002EC /end MEASUREMENT
/begin MEASUREMENT FGNDTaskStackMinBytesFree "Remaining bytes available on the FGNDTask stack" UWORD CompuMethod_20 1 0 0 65535 ECU_ADDRESS 0x400002EE /end MEASUREMENT
/begin MEASUREMENT H1DC "" FLOAT32_IEEE CompuMethod_2 1 0 -1E+17 1E+17 ECU_ADDRESS 0x40000311 /end MEASUREMENT
/begin MEASUREMENT IdleStackMinBytesFree "Remaining bytes available on the Idle stack" UWORD CompuMethod_19 1 0 0 65535 ECU_ADDRESS 0x40000319 /end MEASUREMENT
/begin MEASUREMENT InterruptStackMinBytesFree "Remaining bytes available on the interrupt stack" UWORD CompuMethod_19 1 0 0 65535 ECU_ADDRESS 0x4000037F /end MEASUREMENT
/begin MEASUREMENT KernelStackMinBytesFree "Remaining bytes available on the Kernel stack" UWORD CompuMethod_19 1 0 0 65535 ECU_ADDRESS 0x4000038F /end MEASUREMENT
/begin MEASUREMENT MainControllerIn.Pedal_[0_1]._ "" FLOAT32_IEEE CompuMethod_176 1 0 -1E+17 1E+17 ECU_ADDRESS 0x40000436 /end MEASUREMENT
/begin MEASUREMENT MainControllerIn.N_[rad_s]._ "" FLOAT32_IEEE CompuMethod_176 1 0 -1E+17 1E+17 ECU_ADDRESS 0x4000043A /end MEASUREMENT
/begin MEASUREMENT MainControllerIn.MAF_[kg_s]._ "" FLOAT32_IEEE CompuMethod_176 1 0 -1E+17 1E+17 ECU_ADDRESS 0x4000043E /end MEASUREMENT
/begin MEASUREMENT MainControllerIn.Nidle_[rad_s]._ "" FLOAT32_IEEE CompuMethod_176 1 0 -1E+17 1E+17 ECU_ADDRESS 0x40000442 /end MEASUREMENT
/begin MEASUREMENT MainControllerIn.IILambda_[_]._ "" FLOAT32_IEEE CompuMethod_176 1 0 -1E+17 1E+17 ECU_ADDRESS 0x40000446 /end MEASUREMENT
/begin MEASUREMENT MainControllerIn.Vbatt_[V]._ "" FLOAT32_IEEE CompuMethod_176 1 0 -1E+17 1E+17 ECU_ADDRESS 0x4000044A /end MEASUREMENT
/begin MEASUREMENT MainControllerIn.Pfuel_[Pa]._ "" FLOAT32_IEEE CompuMethod_176 1 0 -1E+17 1E+17 ECU_ADDRESS 0x4000044E /end MEASUREMENT
/begin MEASUREMENT MainControllerIn.Pman_[Pa]._ "" FLOAT32_IEEE CompuMethod_176 1 0 -1E+17 1E+17 ECU_ADDRESS 0x40000452 /end MEASUREMENT
/begin MEASUREMENT MainControllerIn.MaxKnock[_]._ "" FLOAT32_IEEE CompuMethod_176 1 0 -1E+17 1E+17 ECU_ADDRESS 0x40000456 /end MEASUREMENT
/begin MEASUREMENT MainControllerOut.Ign_ANg_[rad_btdc]._ "" FLOAT32_IEEE CompuMethod_176 1 0 -1E+17 1E+17 ECU_ADDRESS 0x4000045A /end MEASUREMENT
/begin MEASUREMENT MainControllerOut.Inj_Time_[s]._ "" FLOAT32_IEEE CompuMethod_176 1 0 -1E+17 1E+17 ECU_ADDRESS 0x4000045E /end MEASUREMENT
/begin MEASUREMENT MainControllerOut.Ign_Ang_[rad_dbtdc]._ "" FLOAT32_IEEE CompuMethod_176 1 0 -1E+17 1E+17 ECU_ADDRESS 0x40000462 /end MEASUREMENT
/begin MEASUREMENT MainControllerOut.ThrottleAng_[deg]._ "" FLOAT32_IEEE CompuMethod_176 1 0 -1E+17 1E+17 ECU_ADDRESS 0x40000466 /end MEASUREMENT
/begin MEASUREMENT MotoHawkModelSecondsInUse "Total runtime of this MotoHawk software model" ULONG CompuMethod_177 1 0 0 4294970000 ECU_ADDRESS 0x400005B3 /end MEASUREMENT
/begin MEASUREMENT MPRD "Indicates whether the main power relay is active" UBYTE CompuMethod_21 1 0 0 1 ECU_ADDRESS 0x40000639 /end MEASUREMENT
/begin MEASUREMENT PeakHeapBytesUsed "Maximum number of bytes used on the heap since startup" ULONG CompuMethod_182 1 0 0 4294970000 ECU_ADDRESS 0x40000707 /end MEASUREMENT
/begin MEASUREMENT RPM "" UWORD CompuMethod_5 1 0 0 65535 ECU_ADDRESS 0x4000070C /end MEASUREMENT
/begin MEASUREMENT RPMInst "" UWORD CompuMethod_5 1 0 0 65535 ECU_ADDRESS 0x4000070E /end MEASUREMENT
/begin MEASUREMENT SelectedAPP "" FLOAT32_IEEE CompuMethod_2 1 0 -1E+17 1E+17 ECU_ADDRESS 0x40000710 /end MEASUREMENT
/begin MEASUREMENT SHUTDOWNTaskCPU "Percentage of CPU spent on SHUTDOWNTask task" UWORD CompuMethod_18 1 0 0 100 ECU_ADDRESS 0x40000714 /end MEASUREMENT
/begin MEASUREMENT SHUTDOWNTaskStackMinBytesFree "Remaining bytes available on the SHUTDOWNTask stack" UWORD CompuMethod_20 1 0 0 65535 ECU_ADDRESS 0x40000716 /end MEASUREMENT
/begin MEASUREMENT TPS_Error_pcnt "" FLOAT32_IEEE CompuMethod_2 1 0 -1E+17 1E+17 ECU_ADDRESS 0x40000726 /end MEASUREMENT
/*~~~~~~~~~ 6.3.27 CHARACTERISTICs ~~~~~~~~~*/
/begin CHARACTERISTIC SwIdTxt "Software Format ID" ASCII 0x4000000C RecordLayout_1 0 CompuMethod_2 0 255 NUMBER 13 MATRIX_DIM 13 1 1 READ_ONLY /end CHARACTERISTIC
/begin CHARACTERISTIC CalIdTxt "Calibration ID" ASCII 0x80000000 RecordLayout_1 0 CompuMethod_2 0 255 NUMBER 33 MATRIX_DIM 33 1 1 /end CHARACTERISTIC
/begin CHARACTERISTIC SwRevisionTxt "Software Revision ID" ASCII 0x40000019 RecordLayout_1 0 CompuMethod_2 0 255 NUMBER 50 MATRIX_DIM 50 1 1 READ_ONLY /end CHARACTERISTIC
/begin CHARACTERISTIC FriendlyName "The device's friendly name." ASCII 0x40000054 RecordLayout_1 0 CompuMethod_2 0 255 NUMBER 33 MATRIX_DIM 33 1 1 READ_ONLY /end CHARACTERISTIC
/begin CHARACTERISTIC SerialNumber "Module Serial Number" ASCII 0x400000E2 RecordLayout_1 0 CompuMethod_2 0 255 NUMBER 49 MATRIX_DIM 49 1 1 READ_ONLY /end CHARACTERISTIC
/begin CHARACTERISTIC ModelNumber "Module Model Number" ASCII 0x40000113 RecordLayout_1 0 CompuMethod_2 0 255 NUMBER 49 MATRIX_DIM 49 1 1 READ_ONLY /end CHARACTERISTIC
/begin CHARACTERISTIC Airflow_Default "This is the initial default value should the sensor be in fault on key-up.  Otherwise the sensors outputs the last value prior to faulting" VALUE 0x80000021 RecordLayout_2 0 CompuMethod_6 -1E+17 1E+17 /end CHARACTERISTIC
/begin CHARACTERISTIC Airflow_FiltConst "Filter time constant" VALUE 0x80000025 RecordLayout_2 0 CompuMethod_8 -1E+17 1E+17 /end CHARACTERISTIC
/begin CHARACTERISTIC Airflow_InHi "Maximum input value" VALUE 0x80000029 RecordLayout_2 0 CompuMethod_9 -1E+17 1E+17 /end CHARACTERISTIC
/begin CHARACTERISTIC Airflow_InHiFlt "Maximum allowable input, indicating short or open circuit" VALUE 0x8000002D RecordLayout_2 0 CompuMethod_10 -1E+17 1E+17 /end CHARACTERISTIC
/begin CHARACTERISTIC Airflow_InLo "Minimum input value" VALUE 0x80000031 RecordLayout_2 0 CompuMethod_9 -1E+17 1E+17 /end CHARACTERISTIC
/begin CHARACTERISTIC Airflow_InLoFlt "Minimum allowable input, indicating short or open circuit" VALUE 0x80000035 RecordLayout_2 0 CompuMethod_10 -1E+17 1E+17 /end CHARACTERISTIC
/begin CHARACTERISTIC Airflow_new "Override result of linear sensor characterization, in engineering units" VALUE 0x80000039 RecordLayout_2 0 CompuMethod_6 -1E+17 1E+17 /end CHARACTERISTIC
/begin CHARACTERISTIC Airflow_OutHi "Maximum output value" VALUE 0x8000003D RecordLayout_2 0 CompuMethod_11 -1E+17 1E+17 /end CHARACTERISTIC
/begin CHARACTERISTIC Airflow_OutLo "Minimum output value" VALUE 0x80000041 RecordLayout_2 0 CompuMethod_11 -1E+17 1E+17 /end CHARACTERISTIC
/begin CHARACTERISTIC Airflow_ovr "" VALUE 0x80000045 RecordLayout_3 0 CompuMethod_12 0 1 /end CHARACTERISTIC
/begin CHARACTERISTIC Airflow2_Default "This is the initial default value should the sensor be in fault on key-up.  Otherwise the sensors outputs the last value prior to faulting" VALUE 0x80000046 RecordLayout_2 0 CompuMethod_6 -1E+17 1E+17 /end CHARACTERISTIC
/begin CHARACTERISTIC Airflow2_FiltConst "Filter time constant" VALUE 0x8000004A RecordLayout_2 0 CompuMethod_8 -1E+17 1E+17 /end CHARACTERISTIC
/begin CHARACTERISTIC Airflow2_InHi "Maximum input value" VALUE 0x8000004E RecordLayout_2 0 CompuMethod_9 -1E+17 1E+17 /end CHARACTERISTIC
/begin CHARACTERISTIC Airflow2_InHiFlt "Maximum allowable input, indicating short or open circuit" VALUE 0x80000052 RecordLayout_2 0 CompuMethod_10 -1E+17 1E+17 /end CHARACTERISTIC
/begin CHARACTERISTIC Airflow2_InLo "Minimum input value" VALUE 0x80000056 RecordLayout_2 0 CompuMethod_9 -1E+17 1E+17 /end CHARACTERISTIC
/begin CHARACTERISTIC Airflow2_InLoFlt "Minimum allowable input, indicating short or open circuit" VALUE 0x8000005A RecordLayout_2 0 CompuMethod_10 -1E+17 1E+17 /end CHARACTERISTIC
/begin CHARACTERISTIC Airflow2_new "Override result of linear sensor characterization, in engineering units" VALUE 0x8000005E RecordLayout_2 0 CompuMethod_6 -1E+17 1E+17 /end CHARACTERISTIC
/begin CHARACTERISTIC Airflow2_OutHi "Maximum output value" VALUE 0x80000062 RecordLayout_2 0 CompuMethod_11 -1E+17 1E+17 /end CHARACTERISTIC
/begin CHARACTERISTIC Airflow2_OutLo "Minimum output value" VALUE 0x80000066 RecordLayout_2 0 CompuMethod_11 -1E+17 1E+17 /end CHARACTERISTIC
/begin CHARACTERISTIC Airflow2_ovr "" VALUE 0x8000006A RecordLayout_3 0 CompuMethod_12 0 1 /end CHARACTERISTIC
/begin CHARACTERISTIC Airflow3_Default "This is the initial default value should the sensor be in fault on key-up.  Otherwise the sensors outputs the last value prior to faulting" VALUE 0x8000006B RecordLayout_2 0 CompuMethod_6 -1E+17 1E+17 /end CHARACTERISTIC
/begin CHARACTERISTIC Airflow3_FiltConst "Filter time constant" VALUE 0x8000006F RecordLayout_2 0 CompuMethod_8 -1E+17 1E+17 /end CHARACTERISTIC
/begin CHARACTERISTIC Airflow3_InHi "Maximum input value" VALUE 0x80000073 RecordLayout_2 0 CompuMethod_9 -1E+17 1E+17 /end CHARACTERISTIC
/begin CHARACTERISTIC Airflow3_InHiFlt "Maximum allowable input, indicating short or open circuit" VALUE 0x80000077 RecordLayout_2 0 CompuMethod_10 -1E+17 1E+17 /end CHARACTERISTIC
/begin CHARACTERISTIC Airflow3_InLo "Minimum input value" VALUE 0x8000007B RecordLayout_2 0 CompuMethod_9 -1E+17 1E+17 /end CHARACTERISTIC
/begin CHARACTERISTIC Airflow3_InLoFlt "Minimum allowable input, indicating short or open circuit" VALUE 0x8000007F RecordLayout_2 0 CompuMethod_10 -1E+17 1E+17 /end CHARACTERISTIC
/begin CHARACTERISTIC Airflow3_new "Override result of linear sensor characterization, in engineering units" VALUE 0x80000083 RecordLayout_2 0 CompuMethod_6 -1E+17 1E+17 /end CHARACTERISTIC
/begin CHARACTERISTIC Airflow3_OutHi "Maximum output value" VALUE 0x80000087 RecordLayout_2 0 CompuMethod_11 -1E+17 1E+17 /end CHARACTERISTIC
/begin CHARACTERISTIC Airflow3_OutLo "Minimum output value" VALUE 0x8000008B RecordLayout_2 0 CompuMethod_11 -1E+17 1E+17 /end CHARACTERISTIC
/begin CHARACTERISTIC Airflow3_ovr "" VALUE 0x8000008F RecordLayout_3 0 CompuMethod_12 0 1 /end CHARACTERISTIC
/begin CHARACTERISTIC APP_Default "This is the initial default value should the sensor be in fault on key-up.  Otherwise the sensors outputs the last value prior to faulting" VALUE 0x80000090 RecordLayout_2 0 CompuMethod_14 -1E+17 1E+17 /end CHARACTERISTIC
/begin CHARACTERISTIC APP_FiltConst "Filter time constant" VALUE 0x80000094 RecordLayout_2 0 CompuMethod_8 -1E+17 1E+17 /end CHARACTERISTIC
/begin CHARACTERISTIC APP_Max "Maximum allowable input, indicating short or open circuit" VALUE 0x80000098 RecordLayout_4 0 CompuMethod_15 0 65535 /end CHARACTERISTIC
/begin CHARACTERISTIC APP_Min "Minimum allowable input, indicating short or open circuit" VALUE 0x8000009A RecordLayout_4 0 CompuMethod_15 0 65535 /end CHARACTERISTIC
/begin CHARACTERISTIC APP_new "Override result of linear sensor characterization, in engineering units" VALUE 0x8000009C RecordLayout_2 0 CompuMethod_14 -1E+17 1E+17 /end CHARACTERISTIC
/begin CHARACTERISTIC APP_ovr "" VALUE 0x800000A0 RecordLayout_3 0 CompuMethod_12 0 1 /end CHARACTERISTIC
/begin CHARACTERISTIC ApplicationInterruptTaskStackMargin "When the available ApplicationInterruptTask stack space drops below this threshold, the application performs a safety stop" VALUE 0x800000A9 RecordLayout_4 0 CompuMethod_19 0 1024 /end CHARACTERISTIC
/begin CHARACTERISTIC ApplicationMonitorEnable "Enables runtime checking of stack, heap, CPU, and OS errors.  Stops the application on error." VALUE 0x800000AB RecordLayout_3 0 CompuMethod_21 0 1 /end CHARACTERISTIC
/begin CHARACTERISTIC ApplicationPausePoint "Selects the startup pause point, for debugging.  Can be moved forward to step through the initialization" VALUE 0x800000AC RecordLayout_3 0 CompuMethod_22 0 255 /end CHARACTERISTIC
/begin CHARACTERISTIC ApplicationStatus "View and set the application runtime status" VALUE 0x800000AD RecordLayout_3 0 CompuMethod_23 1 4 /end CHARACTERISTIC
/begin CHARACTERISTIC APPTbl "" CURVE 0x800000AE RecordLayout_2 0 CompuMethod_2 -1E+17 1E+17
 /begin AXIS_DESCR COM_AXIS APP_ADC CompuMethod_5 4 0 65535 AXIS_PTS_REF APPIdxArr /end AXIS_DESCR
/end CHARACTERISTIC
/begin CHARACTERISTIC BGNDTaskStackMargin "When the available BGNDTask stack space drops below this threshold, the application performs a safety stop" VALUE 0x800000BE RecordLayout_4 0 CompuMethod_19 0 2048 /end CHARACTERISTIC
/begin CHARACTERISTIC CAN_1_TransmitOverrun "Debug value for CAN_1_TransmitOverrun" VALUE 0x800000C0 RecordLayout_4 0 CompuMethod_26 0 65535 /end CHARACTERISTIC
/begin CHARACTERISTIC CAN_2_TransmitOverrun "Debug value for CAN_2_TransmitOverrun" VALUE 0x800000C2 RecordLayout_4 0 CompuMethod_26 0 65535 /end CHARACTERISTIC
/begin CHARACTERISTIC CAN_3_TransmitOverrun "Debug value for CAN_3_TransmitOverrun" VALUE 0x800000C4 RecordLayout_4 0 CompuMethod_26 0 65535 /end CHARACTERISTIC
/begin CHARACTERISTIC CC_AdaptK "" VALUE 0x800000C6 RecordLayout_2 0 CompuMethod_2 -1E+17 1E+17 /end CHARACTERISTIC
/begin CHARACTERISTIC CC_ButtonHeldTime "Time that the Inc or Dec button is considered held" VALUE 0x800000CA RecordLayout_2 0 CompuMethod_8 -1E+17 1E+17 /end CHARACTERISTIC
/begin CHARACTERISTIC CC_FFTbl "" CURVE 0x800000F2 RecordLayout_2 0 CompuMethod_28 -1E+17 1E+17
 /begin AXIS_DESCR COM_AXIS CC_FFIn CompuMethod_29 9 -1E+17 1E+17 AXIS_PTS_REF CC_FFIdxArr /end AXIS_DESCR
/end CHARACTERISTIC
/begin CHARACTERISTIC CC_Imax "" VALUE 0x80000116 RecordLayout_2 0 CompuMethod_2 -1E+17 1E+17 /end CHARACTERISTIC
/begin CHARACTERISTIC CC_Imin "" VALUE 0x8000011A RecordLayout_2 0 CompuMethod_2 -1E+17 1E+17 /end CHARACTERISTIC
/begin CHARACTERISTIC CC_KiTbl "" CURVE 0x8000013A RecordLayout_2 0 CompuMethod_30 -1E+17 1E+17
 /begin AXIS_DESCR COM_AXIS CC_KiIn CompuMethod_31 7 -1E+17 1E+17 AXIS_PTS_REF CC_KiIdxArr /end AXIS_DESCR
/end CHARACTERISTIC
/begin CHARACTERISTIC CC_KpTbl "" CURVE 0x80000172 RecordLayout_2 0 CompuMethod_32 -1E+17 1E+17
 /begin AXIS_DESCR COM_AXIS CC_KpIn CompuMethod_31 7 -1E+17 1E+17 AXIS_PTS_REF CC_KpIdxArr /end AXIS_DESCR
/end CHARACTERISTIC
/begin CHARACTERISTIC CC_max "" VALUE 0x8000018E RecordLayout_2 0 CompuMethod_2 -1E+17 1E+17 /end CHARACTERISTIC
/begin CHARACTERISTIC CC_MaxSpd "Maximum CC Set Speed" VALUE 0x80000192 RecordLayout_2 0 CompuMethod_33 -1E+17 1E+17 /end CHARACTERISTIC
/begin CHARACTERISTIC CC_min "" VALUE 0x80000196 RecordLayout_2 0 CompuMethod_2 -1E+17 1E+17 /end CHARACTERISTIC
/begin CHARACTERISTIC CC_MinSpd "Minimum CC Set Speed" VALUE 0x8000019A RecordLayout_2 0 CompuMethod_33 -1E+17 1E+17 /end CHARACTERISTIC
/begin CHARACTERISTIC CC_SpeedChange "Speed Change per sec for held Inc or Dec button" VALUE 0x8000019E RecordLayout_2 0 CompuMethod_36 -1E+17 1E+17 /end CHARACTERISTIC
/begin CHARACTERISTIC CCP1_StationAddr "Station ID for CCP handler: CCP1" VALUE 0x800001A2 RecordLayout_4 0 CompuMethod_5 0 65535 /end CHARACTERISTIC
/begin CHARACTERISTIC CCP1RxID "Receive CAN ID for CCP handler: CCP1" VALUE 0x800001A4 RecordLayout_7 0 CompuMethod_41 0 4294970000 /end CHARACTERISTIC
/begin CHARACTERISTIC CCP1RxIDMask "Receive CAN ID Mask for CCP handler: CCP1" VALUE 0x800001A8 RecordLayout_7 0 CompuMethod_41 0 4294970000 /end CHARACTERISTIC
/begin CHARACTERISTIC CCP1TxID "Transmit CAN ID for CCP handler: CCP1" VALUE 0x800001AC RecordLayout_7 0 CompuMethod_41 0 4294970000 /end CHARACTERISTIC
/begin CHARACTERISTIC CCP2_StationAddr "Station ID for CCP handler: CCP2" VALUE 0x800001B0 RecordLayout_4 0 CompuMethod_5 0 65535 /end CHARACTERISTIC
/begin CHARACTERISTIC CCP2RxID "Receive CAN ID for CCP handler: CCP2" VALUE 0x800001B2 RecordLayout_7 0 CompuMethod_41 0 4294970000 /end CHARACTERISTIC
/begin CHARACTERISTIC CCP2RxIDMask "Receive CAN ID Mask for CCP handler: CCP2" VALUE 0x800001B6 RecordLayout_7 0 CompuMethod_41 0 4294970000 /end CHARACTERISTIC
/begin CHARACTERISTIC CCP2TxID "Transmit CAN ID for CCP handler: CCP2" VALUE 0x800001BA RecordLayout_7 0 CompuMethod_41 0 4294970000 /end CHARACTERISTIC
/begin CHARACTERISTIC CCP3_StationAddr "Station ID for CCP handler: CCP3" VALUE 0x800001BE RecordLayout_4 0 CompuMethod_5 0 65535 /end CHARACTERISTIC
/begin CHARACTERISTIC CCP3RxID "Receive CAN ID for CCP handler: CCP3" VALUE 0x800001C0 RecordLayout_7 0 CompuMethod_41 0 4294970000 /end CHARACTERISTIC
/begin CHARACTERISTIC CCP3RxIDMask "Receive CAN ID Mask for CCP handler: CCP3" VALUE 0x800001C4 RecordLayout_7 0 CompuMethod_41 0 4294970000 /end CHARACTERISTIC
/begin CHARACTERISTIC CCP3TxID "Transmit CAN ID for CCP handler: CCP3" VALUE 0x800001C8 RecordLayout_7 0 CompuMethod_41 0 4294970000 /end CHARACTERISTIC
/begin CHARACTERISTIC CCVS_SourceAddress "" VALUE 0x800001CC RecordLayout_2 0 CompuMethod_2 -1E+17 1E+17 /end CHARACTERISTIC
/begin CHARACTERISTIC CCVSTimout "" VALUE 0x800001D0 RecordLayout_2 0 CompuMethod_2 -1E+17 1E+17 /end CHARACTERISTIC
/begin CHARACTERISTIC CityID_CAN_1 "City ID for CAN bus CAN_1" VALUE 0x800001D4 RecordLayout_3 0 CompuMethod_1 0 255 /end CHARACTERISTIC
/begin CHARACTERISTIC CityID_CAN_2 "City ID for CAN bus CAN_2" VALUE 0x800001D5 RecordLayout_3 0 CompuMethod_1 0 255 /end CHARACTERISTIC
/begin CHARACTERISTIC CityID_CAN_3 "City ID for CAN bus CAN_3" VALUE 0x800001D6 RecordLayout_3 0 CompuMethod_1 0 255 /end CHARACTERISTIC
/begin CHARACTERISTIC CompilerVersion "Compiler toolchain version used for the MotoHawk build" ASCII 0x4000021C RecordLayout_1 0 CompuMethod_2 0 255 NUMBER 80 MATRIX_DIM 80 1 1 READ_ONLY /end CHARACTERISTIC
/begin CHARACTERISTIC CoolP_Default "This is the initial default value should the sensor be in fault on key-up.  Otherwise the sensors outputs the last value prior to faulting" VALUE 0x800001D7 RecordLayout_2 0 CompuMethod_143 -1E+17 1E+17 /end CHARACTERISTIC
/begin CHARACTERISTIC CoolP_FiltConst "Filter time constant" VALUE 0x800001DB RecordLayout_2 0 CompuMethod_8 -1E+17 1E+17 /end CHARACTERISTIC
/begin CHARACTERISTIC CoolP_Max "Maximum allowable input, indicating short or open circuit" VALUE 0x800001DF RecordLayout_4 0 CompuMethod_15 0 65535 /end CHARACTERISTIC
/begin CHARACTERISTIC CoolP_Min "Minimum allowable input, indicating short or open circuit" VALUE 0x800001E1 RecordLayout_4 0 CompuMethod_15 0 65535 /end CHARACTERISTIC
/begin CHARACTERISTIC CoolP_new "Override result of linear sensor characterization, in engineering units" VALUE 0x800001E3 RecordLayout_2 0 CompuMethod_143 -1E+17 1E+17 /end CHARACTERISTIC
/begin CHARACTERISTIC CoolP_ovr "" VALUE 0x800001E7 RecordLayout_3 0 CompuMethod_12 0 1 /end CHARACTERISTIC
/begin CHARACTERISTIC CoolPTbl "" CURVE 0x80000200 RecordLayout_2 0 CompuMethod_2 -1E+17 1E+17
 /begin AXIS_DESCR COM_AXIS CoolP_ADC CompuMethod_5 12 0 65535 AXIS_PTS_REF CoolPIdxArr /end AXIS_DESCR
/end CHARACTERISTIC
/begin CHARACTERISTIC COOLT_Default "This is the initial default value should the sensor be in fault on key-up.  Otherwise the sensors outputs the last value prior to faulting" VALUE 0x80000230 RecordLayout_2 0 CompuMethod_144 -1E+17 1E+17 /end CHARACTERISTIC
/begin CHARACTERISTIC COOLT_FiltConst "Filter time constant" VALUE 0x80000234 RecordLayout_2 0 CompuMethod_8 -1E+17 1E+17 /end CHARACTERISTIC
/begin CHARACTERISTIC COOLT_Max "Maximum allowable input, indicating short or open circuit" VALUE 0x80000238 RecordLayout_4 0 CompuMethod_15 0 65535 /end CHARACTERISTIC
/begin CHARACTERISTIC COOLT_Min "Minimum allowable input, indicating short or open circuit" VALUE 0x8000023A RecordLayout_4 0 CompuMethod_15 0 65535 /end CHARACTERISTIC
/begin CHARACTERISTIC COOLT_new "Override result of linear sensor characterization, in engineering units" VALUE 0x8000023C RecordLayout_2 0 CompuMethod_144 -1E+17 1E+17 /end CHARACTERISTIC
/begin CHARACTERISTIC COOLT_ovr "" VALUE 0x80000240 RecordLayout_3 0 CompuMethod_12 0 1 /end CHARACTERISTIC
/begin CHARACTERISTIC COOLTTbl "" CURVE 0x80000265 RecordLayout_2 0 CompuMethod_2 -1E+17 1E+17
 /begin AXIS_DESCR COM_AXIS COOLT_ADC CompuMethod_5 18 0 65535 AXIS_PTS_REF COOLTIdxArr /end AXIS_DESCR
/end CHARACTERISTIC
/begin CHARACTERISTIC DRVP_Default "This is the initial default value should the sensor be in fault on key-up.  Otherwise the sensors outputs the last value prior to faulting" VALUE 0x800002AD RecordLayout_2 0 CompuMethod_145 -1E+17 1E+17 /end CHARACTERISTIC
/begin CHARACTERISTIC DRVP_FiltConst "Filter time constant" VALUE 0x800002B1 RecordLayout_2 0 CompuMethod_8 -1E+17 1E+17 /end CHARACTERISTIC
/begin CHARACTERISTIC DRVP_InHi "Maximum input value" VALUE 0x800002B5 RecordLayout_2 0 CompuMethod_9 -1E+17 1E+17 /end CHARACTERISTIC
/begin CHARACTERISTIC DRVP_InHiFlt "Maximum allowable input, indicating short or open circuit" VALUE 0x800002B9 RecordLayout_2 0 CompuMethod_10 -1E+17 1E+17 /end CHARACTERISTIC
/begin CHARACTERISTIC DRVP_InLo "Minimum input value" VALUE 0x800002BD RecordLayout_2 0 CompuMethod_9 -1E+17 1E+17 /end CHARACTERISTIC
/begin CHARACTERISTIC DRVP_InLoFlt "Minimum allowable input, indicating short or open circuit" VALUE 0x800002C1 RecordLayout_2 0 CompuMethod_10 -1E+17 1E+17 /end CHARACTERISTIC
/begin CHARACTERISTIC DRVP_new "Override result of linear sensor characterization, in engineering units" VALUE 0x800002C5 RecordLayout_2 0 CompuMethod_145 -1E+17 1E+17 /end CHARACTERISTIC
/begin CHARACTERISTIC DRVP_OutHi "Maximum output value" VALUE 0x800002C9 RecordLayout_2 0 CompuMethod_146 -1E+17 1E+17 /end CHARACTERISTIC
/begin CHARACTERISTIC DRVP_OutLo "Minimum output value" VALUE 0x800002CD RecordLayout_2 0 CompuMethod_146 -1E+17 1E+17 /end CHARACTERISTIC
/begin CHARACTERISTIC DRVP_ovr "" VALUE 0x800002D1 RecordLayout_3 0 CompuMethod_12 0 1 /end CHARACTERISTIC
/begin CHARACTERISTIC ECUP_Default "This is the initial default value should the sensor be in fault on key-up.  Otherwise the sensors outputs the last value prior to faulting" VALUE 0x800002D2 RecordLayout_2 0 CompuMethod_145 -1E+17 1E+17 /end CHARACTERISTIC
/begin CHARACTERISTIC ECUP_FiltConst "Filter time constant" VALUE 0x800002D6 RecordLayout_2 0 CompuMethod_8 -1E+17 1E+17 /end CHARACTERISTIC
/begin CHARACTERISTIC ECUP_InHi "Maximum input value" VALUE 0x800002DA RecordLayout_2 0 CompuMethod_9 -1E+17 1E+17 /end CHARACTERISTIC
/begin CHARACTERISTIC ECUP_InHiFlt "Maximum allowable input, indicating short or open circuit" VALUE 0x800002DE RecordLayout_2 0 CompuMethod_10 -1E+17 1E+17 /end CHARACTERISTIC
/begin CHARACTERISTIC ECUP_InLo "Minimum input value" VALUE 0x800002E2 RecordLayout_2 0 CompuMethod_9 -1E+17 1E+17 /end CHARACTERISTIC
/begin CHARACTERISTIC ECUP_InLoFlt "Minimum allowable input, indicating short or open circuit" VALUE 0x800002E6 RecordLayout_2 0 CompuMethod_10 -1E+17 1E+17 /end CHARACTERISTIC
/begin CHARACTERISTIC ECUP_new "Override result of linear sensor characterization, in engineering units" VALUE 0x800002EA RecordLayout_2 0 CompuMethod_145 -1E+17 1E+17 /end CHARACTERISTIC
/begin CHARACTERISTIC ECUP_OutHi "Maximum output value" VALUE 0x800002EE RecordLayout_2 0 CompuMethod_146 -1E+17 1E+17 /end CHARACTERISTIC
/begin CHARACTERISTIC ECUP_OutLo "Minimum output value" VALUE 0x800002F2 RecordLayout_2 0 CompuMethod_146 -1E+17 1E+17 /end CHARACTERISTIC
/begin CHARACTERISTIC ECUP_ovr "" VALUE 0x800002F6 RecordLayout_3 0 CompuMethod_12 0 1 /end CHARACTERISTIC
/begin CHARACTERISTIC ECUP_Threshold "ADC voltage threshold above which ECU is considered powered" VALUE 0x800002F7 RecordLayout_4 0 CompuMethod_147 0 1023 /end CHARACTERISTIC
/begin CHARACTERISTIC EncoderNumCylinders "Number of cylinders" VALUE 0x800002F9 RecordLayout_3 0 CompuMethod_1 1 8 /end CHARACTERISTIC
/begin CHARACTERISTIC EncoderTDCAngles "TDC angle of each cylinder in degrees after TDC1" VAL_BLK 0x800002FA RecordLayout_8 0 CompuMethod_150 0 720 MATRIX_DIM 8 1 1 /end CHARACTERISTIC
/begin CHARACTERISTIC EncoderTDCOffset "TDC offset of crank sensor, in degrees before TDC1.  Used to align sensor with crank angle." VALUE 0x8000030A RecordLayout_2 0 CompuMethod_151 0 720 /end CHARACTERISTIC
/begin CHARACTERISTIC ETC_Imax "" VALUE 0x8000030E RecordLayout_2 0 CompuMethod_2 -1E+17 1E+17 /end CHARACTERISTIC
/begin CHARACTERISTIC ETC_Imin "" VALUE 0x80000312 RecordLayout_2 0 CompuMethod_2 -1E+17 1E+17 /end CHARACTERISTIC
/begin CHARACTERISTIC ETC_Ki "" VALUE 0x80000316 RecordLayout_2 0 CompuMethod_2 -1E+17 1E+17 /end CHARACTERISTIC
/begin CHARACTERISTIC ETC_Kp "" VALUE 0x8000031A RecordLayout_2 0 CompuMethod_2 -1E+17 1E+17 /end CHARACTERISTIC
/begin CHARACTERISTIC ETC_max "" VALUE 0x8000031E RecordLayout_2 0 CompuMethod_2 -1E+17 1E+17 /end CHARACTERISTIC
/begin CHARACTERISTIC ETC_min "" VALUE 0x80000322 RecordLayout_2 0 CompuMethod_2 -1E+17 1E+17 /end CHARACTERISTIC
/begin CHARACTERISTIC ETCFreq "" VALUE 0x80000326 RecordLayout_2 0 CompuMethod_2 -1E+17 1E+17 /end CHARACTERISTIC
/begin CHARACTERISTIC ETCPosA_Default "This is the initial default value should the sensor be in fault on key-up.  Otherwise the sensors outputs the last value prior to faulting" VALUE 0x8000032A RecordLayout_2 0 CompuMethod_153 -1E+17 1E+17 /end CHARACTERISTIC
/begin CHARACTERISTIC ETCPosA_FiltConst "Filter time constant" VALUE 0x8000032E RecordLayout_2 0 CompuMethod_8 -1E+17 1E+17 /end CHARACTERISTIC
/begin CHARACTERISTIC ETCPosA_Max "Maximum allowable input, indicating short or open circuit" VALUE 0x80000332 RecordLayout_4 0 CompuMethod_15 0 65535 /end CHARACTERISTIC
/begin CHARACTERISTIC ETCPosA_Min "Minimum allowable input, indicating short or open circuit" VALUE 0x80000334 RecordLayout_4 0 CompuMethod_15 0 65535 /end CHARACTERISTIC
/begin CHARACTERISTIC ETCPosA_new "Override result of linear sensor characterization, in engineering units" VALUE 0x80000336 RecordLayout_2 0 CompuMethod_153 -1E+17 1E+17 /end CHARACTERISTIC
/begin CHARACTERISTIC ETCPosA_ovr "" VALUE 0x8000033A RecordLayout_3 0 CompuMethod_12 0 1 /end CHARACTERISTIC
/begin CHARACTERISTIC ETCPosATbl "" CURVE 0x80000343 RecordLayout_2 0 CompuMethod_2 -1E+17 1E+17
 /begin AXIS_DESCR COM_AXIS ETCPosA_ADC CompuMethod_5 4 0 65535 AXIS_PTS_REF ETCPosAIdxArr /end AXIS_DESCR
/end CHARACTERISTIC
/begin CHARACTERISTIC ETCPosB_Default "This is the initial default value should the sensor be in fault on key-up.  Otherwise the sensors outputs the last value prior to faulting" VALUE 0x80000353 RecordLayout_2 0 CompuMethod_14 -1E+17 1E+17 /end CHARACTERISTIC
/begin CHARACTERISTIC ETCPosB_FiltConst "Filter time constant" VALUE 0x80000357 RecordLayout_2 0 CompuMethod_8 -1E+17 1E+17 /end CHARACTERISTIC
/begin CHARACTERISTIC ETCPosB_Max "Maximum allowable input, indicating short or open circuit" VALUE 0x8000035B RecordLayout_4 0 CompuMethod_15 0 65535 /end CHARACTERISTIC
/begin CHARACTERISTIC ETCPosB_Min "Minimum allowable input, indicating short or open circuit" VALUE 0x8000035D RecordLayout_4 0 CompuMethod_15 0 65535 /end CHARACTERISTIC
/begin CHARACTERISTIC ETCPosB_new "Override result of linear sensor characterization, in engineering units" VALUE 0x8000035F RecordLayout_2 0 CompuMethod_14 -1E+17 1E+17 /end CHARACTERISTIC
/begin CHARACTERISTIC ETCPosB_ovr "" VALUE 0x80000363 RecordLayout_3 0 CompuMethod_12 0 1 /end CHARACTERISTIC
/begin CHARACTERISTIC ETCPosBTbl "" CURVE 0x8000037C RecordLayout_2 0 CompuMethod_2 -1E+17 1E+17
 /begin AXIS_DESCR COM_AXIS ETCPosB_ADC CompuMethod_5 12 0 65535 AXIS_PTS_REF ETCPosBIdxArr /end AXIS_DESCR
/end CHARACTERISTIC
/begin CHARACTERISTIC ExT1_Default "This is the initial default value should the sensor be in fault on key-up.  Otherwise the sensors outputs the last value prior to faulting" VALUE 0x800003AC RecordLayout_2 0 CompuMethod_144 -1E+17 1E+17 /end CHARACTERISTIC
/begin CHARACTERISTIC ExT1_FiltConst "Filter time constant" VALUE 0x800003B0 RecordLayout_2 0 CompuMethod_8 -1E+17 1E+17 /end CHARACTERISTIC
/begin CHARACTERISTIC ExT1_Max "Maximum allowable input, indicating short or open circuit" VALUE 0x800003B4 RecordLayout_4 0 CompuMethod_15 0 65535 /end CHARACTERISTIC
/begin CHARACTERISTIC ExT1_Min "Minimum allowable input, indicating short or open circuit" VALUE 0x800003B6 RecordLayout_4 0 CompuMethod_15 0 65535 /end CHARACTERISTIC
/begin CHARACTERISTIC ExT1_new "Override result of linear sensor characterization, in engineering units" VALUE 0x800003B8 RecordLayout_2 0 CompuMethod_144 -1E+17 1E+17 /end CHARACTERISTIC
/begin CHARACTERISTIC ExT1_ovr "" VALUE 0x800003BC RecordLayout_3 0 CompuMethod_12 0 1 /end CHARACTERISTIC
/begin CHARACTERISTIC ExT1Tbl "" CURVE 0x800003E1 RecordLayout_2 0 CompuMethod_2 -1E+17 1E+17
 /begin AXIS_DESCR COM_AXIS ExT1_ADC CompuMethod_5 18 0 65535 AXIS_PTS_REF ExT1IdxArr /end AXIS_DESCR
/end CHARACTERISTIC
/begin CHARACTERISTIC ExT2_Default "This is the initial default value should the sensor be in fault on key-up.  Otherwise the sensors outputs the last value prior to faulting" VALUE 0x80000429 RecordLayout_2 0 CompuMethod_144 -1E+17 1E+17 /end CHARACTERISTIC
/begin CHARACTERISTIC ExT2_FiltConst "Filter time constant" VALUE 0x8000042D RecordLayout_2 0 CompuMethod_8 -1E+17 1E+17 /end CHARACTERISTIC
/begin CHARACTERISTIC ExT2_Max "Maximum allowable input, indicating short or open circuit" VALUE 0x80000431 RecordLayout_4 0 CompuMethod_15 0 65535 /end CHARACTERISTIC
/begin CHARACTERISTIC ExT2_Min "Minimum allowable input, indicating short or open circuit" VALUE 0x80000433 RecordLayout_4 0 CompuMethod_15 0 65535 /end CHARACTERISTIC
/begin CHARACTERISTIC ExT2_new "Override result of linear sensor characterization, in engineering units" VALUE 0x80000435 RecordLayout_2 0 CompuMethod_144 -1E+17 1E+17 /end CHARACTERISTIC
/begin CHARACTERISTIC ExT2_ovr "" VALUE 0x80000439 RecordLayout_3 0 CompuMethod_12 0 1 /end CHARACTERISTIC
/begin CHARACTERISTIC ExT2Tbl "" CURVE 0x8000045E RecordLayout_2 0 CompuMethod_2 -1E+17 1E+17
 /begin AXIS_DESCR COM_AXIS ExT2_ADC CompuMethod_5 18 0 65535 AXIS_PTS_REF ExT2IdxArr /end AXIS_DESCR
/end CHARACTERISTIC
/begin CHARACTERISTIC FGNDTaskStackMargin "When the available FGNDTask stack space drops below this threshold, the application performs a safety stop" VALUE 0x800007B3 RecordLayout_4 0 CompuMethod_19 0 3072 /end CHARACTERISTIC
/begin CHARACTERISTIC HeapMargin "When the available heap drops below this threshold, the application performs a safety stop" VALUE 0x80000862 RecordLayout_4 0 CompuMethod_19 0 4096 /end CHARACTERISTIC
/begin CHARACTERISTIC IdleCPU_Fault_Margin "" VALUE 0x8000086D RecordLayout_4 0 CompuMethod_160 0 100 /end CHARACTERISTIC
/begin CHARACTERISTIC IgnitionDeg "" VALUE 0x80000CE3 RecordLayout_2 0 CompuMethod_164 -5.72958E+18 5.72958E+18 /end CHARACTERISTIC
/begin CHARACTERISTIC IntendedIdleSpeed_rpm "-" VALUE 0x80001A66 RecordLayout_2 0 CompuMethod_170 -9.5493E+17 9.5493E+17 /end CHARACTERISTIC
/begin CHARACTERISTIC InterruptTaskStackMargin "When the available InterruptTask stack space drops below this threshold, the application performs a safety stop" VALUE 0x80001A6A RecordLayout_4 0 CompuMethod_19 0 1536 /end CHARACTERISTIC
/begin CHARACTERISTIC MainAppTaskStackMargin "When the available MainAppTask stack space drops below this threshold, the application performs a safety stop" VALUE 0x80001B01 RecordLayout_4 0 CompuMethod_19 0 2048 /end CHARACTERISTIC
/begin CHARACTERISTIC MatlabVersionTxt "MATLAB version used to build the application." ASCII 0x4000046A RecordLayout_1 0 CompuMethod_2 0 255 NUMBER 80 MATRIX_DIM 80 1 1 READ_ONLY /end CHARACTERISTIC
/begin CHARACTERISTIC MotoCoderVersionTxt "MotoCoder version used to build the application." ASCII 0x400004BD RecordLayout_1 0 CompuMethod_2 0 255 NUMBER 6 MATRIX_DIM 6 1 1 READ_ONLY /end CHARACTERISTIC
/begin CHARACTERISTIC MotoHawkBuildGUID "GUID identifying the MotoHawk build session" ASCII 0x400004C3 RecordLayout_1 0 CompuMethod_2 0 255 NUMBER 80 MATRIX_DIM 80 1 1 READ_ONLY /end CHARACTERISTIC
/begin CHARACTERISTIC MotoHawkModelGUID "GUID identifying the MotoHawk model" ASCII 0x40000513 RecordLayout_1 0 CompuMethod_2 0 255 NUMBER 80 MATRIX_DIM 80 1 1 READ_ONLY /end CHARACTERISTIC
/begin CHARACTERISTIC MotoHawkModelName "Simulink model name used for the MotoHawk build" ASCII 0x40000563 RecordLayout_1 0 CompuMethod_2 0 255 NUMBER 80 MATRIX_DIM 80 1 1 READ_ONLY /end CHARACTERISTIC
/begin CHARACTERISTIC MotoHawkTokenGUID "GUID identifying the MotoTron token inserted during the build.  May be empty if no token was available" ASCII 0x400005B7 RecordLayout_1 0 CompuMethod_2 0 255 NUMBER 80 MATRIX_DIM 80 1 1 READ_ONLY /end CHARACTERISTIC
/begin CHARACTERISTIC MotoHawkVersionTxt "MotoHawk version used to build the application." ASCII 0x40000607 RecordLayout_1 0 CompuMethod_2 0 255 NUMBER 50 MATRIX_DIM 50 1 1 READ_ONLY /end CHARACTERISTIC
/begin CHARACTERISTIC MPRD_KeepAlive "When enabled, keeps the MPRD output on and keeps the processor alive" VALUE 0x80001B09 RecordLayout_3 0 CompuMethod_178 0 1 /end CHARACTERISTIC
/begin CHARACTERISTIC PartNumber "Module Part Number" ASCII 0x4000067F RecordLayout_1 0 CompuMethod_2 0 255 NUMBER 40 MATRIX_DIM 40 1 1 READ_ONLY /end CHARACTERISTIC
/begin CHARACTERISTIC ProcessorReboot "Reboots the processor when set." VALUE 0x80001F93 RecordLayout_3 0 CompuMethod_184 0 1 /end CHARACTERISTIC
/begin CHARACTERISTIC PseudoRPM "" VALUE 0x80001F94 RecordLayout_4 0 CompuMethod_5 0 65535 /end CHARACTERISTIC
/begin CHARACTERISTIC SHUTDOWNTaskStackMargin "When the available SHUTDOWNTask stack space drops below this threshold, the application performs a safety stop" VALUE 0x80001F99 RecordLayout_4 0 CompuMethod_19 0 1024 /end CHARACTERISTIC
/begin CHARACTERISTIC StarvationTimerMargin "When the available Starvation Time drops below this threshold, the application performs a safety stop" VALUE 0x80001FAB RecordLayout_7 0 CompuMethod_186 0 4294970 /end CHARACTERISTIC
/*~~~~~~~~~ 6.3.17 AXIS_PTS ~~~~~~~~~*/
/begin AXIS_PTS APPIdxArr "" 0x800000A1 APP_ADC RecordLayout_5 0 CompuMethod_5 4 0 65535 DEPOSIT ABSOLUTE /end AXIS_PTS
/begin AXIS_PTS CC_FFIdxArr "" 0x800000CE CC_FFIn RecordLayout_6 0 CompuMethod_29 9 -1E+17 1E+17 DEPOSIT ABSOLUTE /end AXIS_PTS
/begin AXIS_PTS CC_KiIdxArr "" 0x8000011E CC_KiIn RecordLayout_6 0 CompuMethod_31 7 -1E+17 1E+17 DEPOSIT ABSOLUTE /end AXIS_PTS
/begin AXIS_PTS CC_KpIdxArr "" 0x80000156 CC_KpIn RecordLayout_6 0 CompuMethod_31 7 -1E+17 1E+17 DEPOSIT ABSOLUTE /end AXIS_PTS
/begin AXIS_PTS CoolPIdxArr "" 0x800001E8 CoolP_ADC RecordLayout_5 0 CompuMethod_5 12 0 65535 DEPOSIT ABSOLUTE /end AXIS_PTS
/begin AXIS_PTS COOLTIdxArr "" 0x80000241 COOLT_ADC RecordLayout_5 0 CompuMethod_5 18 0 65535 DEPOSIT ABSOLUTE /end AXIS_PTS
/begin AXIS_PTS ETCPosAIdxArr "" 0x8000033B ETCPosA_ADC RecordLayout_5 0 CompuMethod_5 4 0 65535 DEPOSIT ABSOLUTE /end AXIS_PTS
/begin AXIS_PTS ETCPosBIdxArr "" 0x80000364 ETCPosB_ADC RecordLayout_5 0 CompuMethod_5 12 0 65535 DEPOSIT ABSOLUTE /end AXIS_PTS
/begin AXIS_PTS ExT1IdxArr "" 0x800003BD ExT1_ADC RecordLayout_5 0 CompuMethod_5 18 0 65535 DEPOSIT ABSOLUTE /end AXIS_PTS
/begin AXIS_PTS ExT2IdxArr "" 0x8000043A ExT2_ADC RecordLayout_5 0 CompuMethod_5 18 0 65535 DEPOSIT ABSOLUTE /end AXIS_PTS
/*~~~~~~~~~ 6.3.106 RECORD_LAYOUTs ~~~~~~~~~*/
/begin RECORD_LAYOUT RecordLayout_1 FNC_VALUES 1 UBYTE ROW_DIR DIRECT /end RECORD_LAYOUT
/begin RECORD_LAYOUT RecordLayout_2 FNC_VALUES 1 FLOAT32_IEEE ROW_DIR DIRECT /end RECORD_LAYOUT
/begin RECORD_LAYOUT RecordLayout_3 FNC_VALUES 1 UBYTE ROW_DIR DIRECT /end RECORD_LAYOUT
/begin RECORD_LAYOUT RecordLayout_4 FNC_VALUES 1 UWORD ROW_DIR DIRECT /end RECORD_LAYOUT
/begin RECORD_LAYOUT RecordLayout_5 AXIS_PTS_X 1 UWORD /* IndexIncr */ INDEX_INCR /* Addressing */ DIRECT /end RECORD_LAYOUT
/begin RECORD_LAYOUT RecordLayout_6 AXIS_PTS_X 1 FLOAT32_IEEE /* IndexIncr */ INDEX_INCR /* Addressing */ DIRECT /end RECORD_LAYOUT
/begin RECORD_LAYOUT RecordLayout_7 FNC_VALUES 1 ULONG ROW_DIR DIRECT /end RECORD_LAYOUT
/begin RECORD_LAYOUT RecordLayout_8 FNC_VALUES 1 SWORD ROW_DIR DIRECT /end RECORD_LAYOUT
/*~~~~~~~~~ 6.3.31 COMPU_METHODs ~~~~~~~~~*/
/begin COMPU_METHOD CompuMethod_1 "" RAT_FUNC "%3.0" "" COEFFS 0 1 0 0 0 1 /end COMPU_METHOD
/begin COMPU_METHOD CompuMethod_2 "" RAT_FUNC "%6.2" "" COEFFS 0 1 0 0 0 1 /end COMPU_METHOD
/begin COMPU_METHOD CompuMethod_3 "" RAT_FUNC "%10.0" "ID" COEFFS 0 1 0 0 0 1 /end COMPU_METHOD
/begin COMPU_METHOD CompuMethod_4 "" TAB_VERB "%3.0" "" COMPU_TAB_REF CompuVtab_1 /end COMPU_METHOD
/begin COMPU_METHOD CompuMethod_5 "" RAT_FUNC "%5.0" "" COEFFS 0 1 0 0 0 1 /end COMPU_METHOD
/begin COMPU_METHOD CompuMethod_6 "" RAT_FUNC "%6.2" "kg/s" COEFFS 0 1 0 0 0 1 /end COMPU_METHOD
/begin COMPU_METHOD CompuMethod_7 "" RAT_FUNC "%8.0" "ADC" COEFFS 0 1 0 0 0 1 /end COMPU_METHOD
/begin COMPU_METHOD CompuMethod_8 "" RAT_FUNC "%6.2" "sec" COEFFS 0 1 0 0 0 1 /end COMPU_METHOD
/begin COMPU_METHOD CompuMethod_9 "" RAT_FUNC "%9.4" "ADC" COEFFS 0 1 0 0 0 1 /end COMPU_METHOD
/begin COMPU_METHOD CompuMethod_10 "" RAT_FUNC "%6.2" "ADC" COEFFS 0 1 0 0 0 1 /end COMPU_METHOD
/begin COMPU_METHOD CompuMethod_11 "" RAT_FUNC "%9.4" "kg/s" COEFFS 0 1 0 0 0 1 /end COMPU_METHOD
/begin COMPU_METHOD CompuMethod_12 "" TAB_VERB "%1.0" "" COMPU_TAB_REF CompuVtab_2 /end COMPU_METHOD
/begin COMPU_METHOD CompuMethod_13 "" RAT_FUNC "%1.0" "" COEFFS 0 1 0 0 0 1 /end COMPU_METHOD
/begin COMPU_METHOD CompuMethod_14 "" RAT_FUNC "%6.2" "%" COEFFS 0 1 0 0 0 1 /end COMPU_METHOD
/begin COMPU_METHOD CompuMethod_15 "" RAT_FUNC "%5.0" "ADC" COEFFS 0 1 0 0 0 1 /end COMPU_METHOD
/begin COMPU_METHOD CompuMethod_16 "" RAT_FUNC "%6.2" "idx.frac" COEFFS 0 1 0 0 0 0.00195313 /end COMPU_METHOD
/begin COMPU_METHOD CompuMethod_17 "" TAB_VERB "%3.0" "" COMPU_TAB_REF CompuVtab_3 /end COMPU_METHOD
/begin COMPU_METHOD CompuMethod_18 "" RAT_FUNC "%6.2" "%" COEFFS 0 1 0 0 0 0.0015259 /end COMPU_METHOD
/begin COMPU_METHOD CompuMethod_19 "" RAT_FUNC "%5.0" "bytes" COEFFS 0 1 0 0 0 1 /end COMPU_METHOD
/begin COMPU_METHOD CompuMethod_20 "" RAT_FUNC "%8.0" "bytes" COEFFS 0 1 0 0 0 1 /end COMPU_METHOD
/begin COMPU_METHOD CompuMethod_21 "" TAB_VERB "%1.0" "" COMPU_TAB_REF CompuVtab_4 /end COMPU_METHOD
/begin COMPU_METHOD CompuMethod_22 "" TAB_VERB "%3.0" "" COMPU_TAB_REF CompuVtab_5 /end COMPU_METHOD
/begin COMPU_METHOD CompuMethod_23 "" TAB_VERB "%3.0" "" COMPU_TAB_REF CompuVtab_6 /end COMPU_METHOD
/begin COMPU_METHOD CompuMethod_24 "" TAB_VERB "%5.0" "" COMPU_TAB_REF CompuVtab_7 /end COMPU_METHOD
/begin COMPU_METHOD CompuMethod_25 "" TAB_VERB "%5.0" "" COMPU_TAB_REF CompuVtab_8 /end COMPU_METHOD
/begin COMPU_METHOD CompuMethod_26 "" TAB_VERB "%5.0" "" COMPU_TAB_REF CompuVtab_9 /end COMPU_METHOD
/begin COMPU_METHOD CompuMethod_27 "" TAB_VERB "%4.0" "" COMPU_TAB_REF CompuVtab_10 /end COMPU_METHOD
/begin COMPU_METHOD CompuMethod_28 "" RAT_FUNC "%6.2" "Gain /kph" COEFFS 0 1 0 0 0 1 /end COMPU_METHOD
/begin COMPU_METHOD CompuMethod_29 "" RAT_FUNC "%6.2" "Speed [kph]" COEFFS 0 1 0 0 0 1 /end COMPU_METHOD
/begin COMPU_METHOD CompuMethod_30 "" RAT_FUNC "%6.2" "Gain /kph/sec" COEFFS 0 1 0 0 0 1 /end COMPU_METHOD
/begin COMPU_METHOD CompuMethod_31 "" RAT_FUNC "%6.2" "Speed Error [kph]" COEFFS 0 1 0 0 0 1 /end COMPU_METHOD
/begin COMPU_METHOD CompuMethod_32 "" RAT_FUNC "%21.9" "Gain /kph" COEFFS 0 1 0 0 0 1 /end COMPU_METHOD
/begin COMPU_METHOD CompuMethod_33 "" RAT_FUNC "%6.2" "mph or kph depending upon feedback signal" COEFFS 0 1 0 0 0 1 /end COMPU_METHOD
/begin COMPU_METHOD CompuMethod_34 "" TAB_VERB "%3.0" "" COMPU_TAB_REF CompuVtab_11 /end COMPU_METHOD
/begin COMPU_METHOD CompuMethod_35 "" TAB_VERB "%3.0" "" COMPU_TAB_REF CompuVtab_12 /end COMPU_METHOD
/begin COMPU_METHOD CompuMethod_36 "" RAT_FUNC "%6.2" "mph or kph/sec" COEFFS 0 1 0 0 0 1 /end COMPU_METHOD
/begin COMPU_METHOD CompuMethod_37 "" TAB_VERB "%1.0" "" COMPU_TAB_REF CompuVtab_13 /end COMPU_METHOD
/begin COMPU_METHOD CompuMethod_38 "" TAB_VERB "%1.0" "" COMPU_TAB_REF CompuVtab_14 /end COMPU_METHOD
/begin COMPU_METHOD CompuMethod_39 "" TAB_VERB "%1.0" "" COMPU_TAB_REF CompuVtab_15 /end COMPU_METHOD
/begin COMPU_METHOD CompuMethod_40 "" TAB_VERB "%1.0" "" COMPU_TAB_REF CompuVtab_16 /end COMPU_METHOD
/begin COMPU_METHOD CompuMethod_41 "" RAT_FUNC "%8.0" "" COEFFS 0 1 0 0 0 1 /end COMPU_METHOD
/begin COMPU_METHOD CompuMethod_42 "" TAB_VERB "%1.0" "" COMPU_TAB_REF CompuVtab_17 /end COMPU_METHOD
/begin COMPU_METHOD CompuMethod_43 "" TAB_VERB "%1.0" "" COMPU_TAB_REF CompuVtab_18 /end COMPU_METHOD
/begin COMPU_METHOD CompuMethod_44 "" TAB_VERB "%1.0" "" COMPU_TAB_REF CompuVtab_19 /end COMPU_METHOD
/begin COMPU_METHOD CompuMethod_45 "" TAB_VERB "%1.0" "" COMPU_TAB_REF CompuVtab_20 /end COMPU_METHOD
/begin COMPU_METHOD CompuMethod_46 "" TAB_VERB "%1.0" "" COMPU_TAB_REF CompuVtab_21 /end COMPU_METHOD
/begin COMPU_METHOD CompuMethod_47 "" TAB_VERB "%1.0" "" COMPU_TAB_REF CompuVtab_22 /end COMPU_METHOD
/begin COMPU_METHOD CompuMethod_48 "" TAB_VERB "%1.0" "" COMPU_TAB_REF CompuVtab_23 /end COMPU_METHOD
/begin COMPU_METHOD CompuMethod_49 "" TAB_VERB "%1.0" "" COMPU_TAB_REF CompuVtab_24 /end COMPU_METHOD
/begin COMPU_METHOD CompuMethod_50 "" TAB_VERB "%1.0" "" COMPU_TAB_REF CompuVtab_25 /end COMPU_METHOD
/begin COMPU_METHOD CompuMethod_51 "" TAB_VERB "%1.0" "" COMPU_TAB_REF CompuVtab_26 /end COMPU_METHOD
/begin COMPU_METHOD CompuMethod_52 "" TAB_VERB "%1.0" "" COMPU_TAB_REF CompuVtab_27 /end COMPU_METHOD
/begin COMPU_METHOD CompuMethod_53 "" TAB_VERB "%1.0" "" COMPU_TAB_REF CompuVtab_28 /end COMPU_METHOD
/begin COMPU_METHOD CompuMethod_54 "" TAB_VERB "%1.0" "" COMPU_TAB_REF CompuVtab_29 /end COMPU_METHOD
/begin COMPU_METHOD CompuMethod_55 "" TAB_VERB "%1.0" "" COMPU_TAB_REF CompuVtab_30 /end COMPU_METHOD
/begin COMPU_METHOD CompuMethod_56 "" TAB_VERB "%1.0" "" COMPU_TAB_REF CompuVtab_31 /end COMPU_METHOD
/begin COMPU_METHOD CompuMethod_57 "" TAB_VERB "%1.0" "" COMPU_TAB_REF CompuVtab_32 /end COMPU_METHOD
/begin COMPU_METHOD CompuMethod_58 "" TAB_VERB "%1.0" "" COMPU_TAB_REF CompuVtab_33 /end COMPU_METHOD
/begin COMPU_METHOD CompuMethod_59 "" TAB_VERB "%1.0" "" COMPU_TAB_REF CompuVtab_34 /end COMPU_METHOD
/begin COMPU_METHOD CompuMethod_60 "" TAB_VERB "%1.0" "" COMPU_TAB_REF CompuVtab_35 /end COMPU_METHOD
/begin COMPU_METHOD CompuMethod_61 "" TAB_VERB "%1.0" "" COMPU_TAB_REF CompuVtab_36 /end COMPU_METHOD
/begin COMPU_METHOD CompuMethod_62 "" TAB_VERB "%1.0" "" COMPU_TAB_REF CompuVtab_37 /end COMPU_METHOD
/begin COMPU_METHOD CompuMethod_63 "" TAB_VERB "%1.0" "" COMPU_TAB_REF CompuVtab_38 /end COMPU_METHOD
/begin COMPU_METHOD CompuMethod_64 "" TAB_VERB "%1.0" "" COMPU_TAB_REF CompuVtab_39 /end COMPU_METHOD
/begin COMPU_METHOD CompuMethod_65 "" TAB_VERB "%1.0" "" COMPU_TAB_REF CompuVtab_40 /end COMPU_METHOD
/begin COMPU_METHOD CompuMethod_66 "" TAB_VERB "%1.0" "" COMPU_TAB_REF CompuVtab_41 /end COMPU_METHOD
/begin COMPU_METHOD CompuMethod_67 "" TAB_VERB "%1.0" "" COMPU_TAB_REF CompuVtab_42 /end COMPU_METHOD
/begin COMPU_METHOD CompuMethod_68 "" TAB_VERB "%1.0" "" COMPU_TAB_REF CompuVtab_43 /end COMPU_METHOD
/begin COMPU_METHOD CompuMethod_69 "" TAB_VERB "%1.0" "" COMPU_TAB_REF CompuVtab_44 /end COMPU_METHOD
/begin COMPU_METHOD CompuMethod_70 "" TAB_VERB "%1.0" "" COMPU_TAB_REF CompuVtab_45 /end COMPU_METHOD
/begin COMPU_METHOD CompuMethod_71 "" TAB_VERB "%1.0" "" COMPU_TAB_REF CompuVtab_46 /end COMPU_METHOD
/begin COMPU_METHOD CompuMethod_72 "" TAB_VERB "%1.0" "" COMPU_TAB_REF CompuVtab_47 /end COMPU_METHOD
/begin COMPU_METHOD CompuMethod_73 "" TAB_VERB "%1.0" "" COMPU_TAB_REF CompuVtab_48 /end COMPU_METHOD
/begin COMPU_METHOD CompuMethod_74 "" TAB_VERB "%1.0" "" COMPU_TAB_REF CompuVtab_49 /end COMPU_METHOD
/begin COMPU_METHOD CompuMethod_75 "" TAB_VERB "%1.0" "" COMPU_TAB_REF CompuVtab_50 /end COMPU_METHOD
/begin COMPU_METHOD CompuMethod_76 "" TAB_VERB "%1.0" "" COMPU_TAB_REF CompuVtab_51 /end COMPU_METHOD
/begin COMPU_METHOD CompuMethod_77 "" TAB_VERB "%1.0" "" COMPU_TAB_REF CompuVtab_52 /end COMPU_METHOD
/begin COMPU_METHOD CompuMethod_78 "" TAB_VERB "%1.0" "" COMPU_TAB_REF CompuVtab_53 /end COMPU_METHOD
/begin COMPU_METHOD CompuMethod_79 "" TAB_VERB "%1.0" "" COMPU_TAB_REF CompuVtab_54 /end COMPU_METHOD
/begin COMPU_METHOD CompuMethod_80 "" TAB_VERB "%1.0" "" COMPU_TAB_REF CompuVtab_55 /end COMPU_METHOD
/begin COMPU_METHOD CompuMethod_81 "" TAB_VERB "%1.0" "" COMPU_TAB_REF CompuVtab_56 /end COMPU_METHOD
/begin COMPU_METHOD CompuMethod_82 "" TAB_VERB "%1.0" "" COMPU_TAB_REF CompuVtab_57 /end COMPU_METHOD
/begin COMPU_METHOD CompuMethod_83 "" TAB_VERB "%1.0" "" COMPU_TAB_REF CompuVtab_58 /end COMPU_METHOD
/begin COMPU_METHOD CompuMethod_84 "" TAB_VERB "%1.0" "" COMPU_TAB_REF CompuVtab_59 /end COMPU_METHOD
/begin COMPU_METHOD CompuMethod_85 "" TAB_VERB "%1.0" "" COMPU_TAB_REF CompuVtab_60 /end COMPU_METHOD
/begin COMPU_METHOD CompuMethod_86 "" TAB_VERB "%1.0" "" COMPU_TAB_REF CompuVtab_61 /end COMPU_METHOD
/begin COMPU_METHOD CompuMethod_87 "" TAB_VERB "%1.0" "" COMPU_TAB_REF CompuVtab_62 /end COMPU_METHOD
/begin COMPU_METHOD CompuMethod_88 "" TAB_VERB "%1.0" "" COMPU_TAB_REF CompuVtab_63 /end COMPU_METHOD
/begin COMPU_METHOD CompuMethod_89 "" TAB_VERB "%1.0" "" COMPU_TAB_REF CompuVtab_64 /end COMPU_METHOD
/begin COMPU_METHOD CompuMethod_90 "" TAB_VERB "%1.0" "" COMPU_TAB_REF CompuVtab_65 /end COMPU_METHOD
/begin COMPU_METHOD CompuMethod_91 "" TAB_VERB "%1.0" "" COMPU_TAB_REF CompuVtab_66 /end COMPU_METHOD
/begin COMPU_METHOD CompuMethod_92 "" TAB_VERB "%1.0" "" COMPU_TAB_REF CompuVtab_67 /end COMPU_METHOD
/begin COMPU_METHOD CompuMethod_93 "" TAB_VERB "%1.0" "" COMPU_TAB_REF CompuVtab_68 /end COMPU_METHOD
/begin COMPU_METHOD CompuMethod_94 "" TAB_VERB "%1.0" "" COMPU_TAB_REF CompuVtab_69 /end COMPU_METHOD
/begin COMPU_METHOD CompuMethod_95 "" TAB_VERB "%1.0" "" COMPU_TAB_REF CompuVtab_70 /end COMPU_METHOD
/begin COMPU_METHOD CompuMethod_96 "" TAB_VERB "%1.0" "" COMPU_TAB_REF CompuVtab_71 /end COMPU_METHOD
/begin COMPU_METHOD CompuMethod_97 "" TAB_VERB "%1.0" "" COMPU_TAB_REF CompuVtab_72 /end COMPU_METHOD
/begin COMPU_METHOD CompuMethod_98 "" TAB_VERB "%1.0" "" COMPU_TAB_REF CompuVtab_73 /end COMPU_METHOD
/begin COMPU_METHOD CompuMethod_99 "" TAB_VERB "%1.0" "" COMPU_TAB_REF CompuVtab_74 /end COMPU_METHOD
/begin COMPU_METHOD CompuMethod_100 "" TAB_VERB "%1.0" "" COMPU_TAB_REF CompuVtab_75 /end COMPU_METHOD
/begin COMPU_METHOD CompuMethod_101 "" TAB_VERB "%1.0" "" COMPU_TAB_REF CompuVtab_76 /end COMPU_METHOD
/begin COMPU_METHOD CompuMethod_102 "" TAB_VERB "%1.0" "" COMPU_TAB_REF CompuVtab_77 /end COMPU_METHOD
/begin COMPU_METHOD CompuMethod_103 "" TAB_VERB "%1.0" "" COMPU_TAB_REF CompuVtab_78 /end COMPU_METHOD
/begin COMPU_METHOD CompuMethod_104 "" TAB_VERB "%1.0" "" COMPU_TAB_REF CompuVtab_79 /end COMPU_METHOD
/begin COMPU_METHOD CompuMethod_105 "" TAB_VERB "%1.0" "" COMPU_TAB_REF CompuVtab_80 /end COMPU_METHOD
/begin COMPU_METHOD CompuMethod_106 "" TAB_VERB "%1.0" "" COMPU_TAB_REF CompuVtab_81 /end COMPU_METHOD
/begin COMPU_METHOD CompuMethod_107 "" TAB_VERB "%1.0" "" COMPU_TAB_REF CompuVtab_82 /end COMPU_METHOD
/begin COMPU_METHOD CompuMethod_108 "" TAB_VERB "%1.0" "" COMPU_TAB_REF CompuVtab_83 /end COMPU_METHOD
/begin COMPU_METHOD CompuMethod_109 "" TAB_VERB "%1.0" "" COMPU_TAB_REF CompuVtab_84 /end COMPU_METHOD
/begin COMPU_METHOD CompuMethod_110 "" TAB_VERB "%1.0" "" COMPU_TAB_REF CompuVtab_85 /end COMPU_METHOD
/begin COMPU_METHOD CompuMethod_111 "" TAB_VERB "%1.0" "" COMPU_TAB_REF CompuVtab_86 /end COMPU_METHOD
/begin COMPU_METHOD CompuMethod_112 "" TAB_VERB "%1.0" "" COMPU_TAB_REF CompuVtab_87 /end COMPU_METHOD
/begin COMPU_METHOD CompuMethod_113 "" TAB_VERB "%1.0" "" COMPU_TAB_REF CompuVtab_88 /end COMPU_METHOD
/begin COMPU_METHOD CompuMethod_114 "" TAB_VERB "%1.0" "" COMPU_TAB_REF CompuVtab_89 /end COMPU_METHOD
/begin COMPU_METHOD CompuMethod_115 "" TAB_VERB "%1.0" "" COMPU_TAB_REF CompuVtab_90 /end COMPU_METHOD
/begin COMPU_METHOD CompuMethod_116 "" TAB_VERB "%1.0" "" COMPU_TAB_REF CompuVtab_91 /end COMPU_METHOD
/begin COMPU_METHOD CompuMethod_117 "" TAB_VERB "%1.0" "" COMPU_TAB_REF CompuVtab_92 /end COMPU_METHOD
/begin COMPU_METHOD CompuMethod_118 "" TAB_VERB "%1.0" "" COMPU_TAB_REF CompuVtab_93 /end COMPU_METHOD
/begin COMPU_METHOD CompuMethod_119 "" TAB_VERB "%1.0" "" COMPU_TAB_REF CompuVtab_94 /end COMPU_METHOD
/begin COMPU_METHOD CompuMethod_120 "" TAB_VERB "%1.0" "" COMPU_TAB_REF CompuVtab_95 /end COMPU_METHOD
/begin COMPU_METHOD CompuMethod_121 "" TAB_VERB "%1.0" "" COMPU_TAB_REF CompuVtab_96 /end COMPU_METHOD
/begin COMPU_METHOD CompuMethod_122 "" TAB_VERB "%1.0" "" COMPU_TAB_REF CompuVtab_97 /end COMPU_METHOD
/begin COMPU_METHOD CompuMethod_123 "" TAB_VERB "%1.0" "" COMPU_TAB_REF CompuVtab_98 /end COMPU_METHOD
/begin COMPU_METHOD CompuMethod_124 "" TAB_VERB "%1.0" "" COMPU_TAB_REF CompuVtab_99 /end COMPU_METHOD
/begin COMPU_METHOD CompuMethod_125 "" TAB_VERB "%1.0" "" COMPU_TAB_REF CompuVtab_100 /end COMPU_METHOD
/begin COMPU_METHOD CompuMethod_126 "" TAB_VERB "%1.0" "" COMPU_TAB_REF CompuVtab_101 /end COMPU_METHOD
/begin COMPU_METHOD CompuMethod_127 "" TAB_VERB "%1.0" "" COMPU_TAB_REF CompuVtab_102 /end COMPU_METHOD
/begin COMPU_METHOD CompuMethod_128 "" TAB_VERB "%1.0" "" COMPU_TAB_REF CompuVtab_103 /end COMPU_METHOD
/begin COMPU_METHOD CompuMethod_129 "" TAB_VERB "%1.0" "" COMPU_TAB_REF CompuVtab_104 /end COMPU_METHOD
/begin COMPU_METHOD CompuMethod_130 "" TAB_VERB "%1.0" "" COMPU_TAB_REF CompuVtab_105 /end COMPU_METHOD
/begin COMPU_METHOD CompuMethod_131 "" TAB_VERB "%1.0" "" COMPU_TAB_REF CompuVtab_106 /end COMPU_METHOD
/begin COMPU_METHOD CompuMethod_132 "" TAB_VERB "%1.0" "" COMPU_TAB_REF CompuVtab_107 /end COMPU_METHOD
/begin COMPU_METHOD CompuMethod_133 "" TAB_VERB "%1.0" "" COMPU_TAB_REF CompuVtab_108 /end COMPU_METHOD
/begin COMPU_METHOD CompuMethod_134 "" TAB_VERB "%1.0" "" COMPU_TAB_REF CompuVtab_109 /end COMPU_METHOD
/begin COMPU_METHOD CompuMethod_135 "" TAB_VERB "%1.0" "" COMPU_TAB_REF CompuVtab_110 /end COMPU_METHOD
/begin COMPU_METHOD CompuMethod_136 "" TAB_VERB "%1.0" "" COMPU_TAB_REF CompuVtab_111 /end COMPU_METHOD
/begin COMPU_METHOD CompuMethod_137 "" TAB_VERB "%1.0" "" COMPU_TAB_REF CompuVtab_112 /end COMPU_METHOD
/begin COMPU_METHOD CompuMethod_138 "" TAB_VERB "%1.0" "" COMPU_TAB_REF CompuVtab_113 /end COMPU_METHOD
/begin COMPU_METHOD CompuMethod_139 "" TAB_VERB "%1.0" "" COMPU_TAB_REF CompuVtab_114 /end COMPU_METHOD
/begin COMPU_METHOD CompuMethod_140 "" TAB_VERB "%1.0" "" COMPU_TAB_REF CompuVtab_115 /end COMPU_METHOD
/begin COMPU_METHOD CompuMethod_141 "" TAB_VERB "%1.0" "" COMPU_TAB_REF CompuVtab_116 /end COMPU_METHOD
/begin COMPU_METHOD CompuMethod_142 "" TAB_VERB "%1.0" "" COMPU_TAB_REF CompuVtab_117 /end COMPU_METHOD
/begin COMPU_METHOD CompuMethod_143 "" RAT_FUNC "%6.2" "psia" COEFFS 0 1 0 0 0 1 /end COMPU_METHOD
/begin COMPU_METHOD CompuMethod_144 "" RAT_FUNC "%6.2" "C" COEFFS 0 1 0 0 0 1 /end COMPU_METHOD
/begin COMPU_METHOD CompuMethod_145 "" RAT_FUNC "%6.2" "Vdc" COEFFS 0 1 0 0 0 1 /end COMPU_METHOD
/begin COMPU_METHOD CompuMethod_146 "" RAT_FUNC "%9.4" "Vdc" COEFFS 0 1 0 0 0 1 /end COMPU_METHOD
/begin COMPU_METHOD CompuMethod_147 "" RAT_FUNC "%5.0" "ADC_counts" COEFFS 0 1 0 0 0 1 /end COMPU_METHOD
/begin COMPU_METHOD CompuMethod_148 "" TAB_VERB "%3.0" "" COMPU_TAB_REF CompuVtab_118 /end COMPU_METHOD
/begin COMPU_METHOD CompuMethod_149 "" TAB_VERB "%3.0" "" COMPU_TAB_REF CompuVtab_119 /end COMPU_METHOD
/begin COMPU_METHOD CompuMethod_150 "" RAT_FUNC "%5.0" "degCA" COEFFS 0 1 0 0 0 0.0625 /end COMPU_METHOD
/begin COMPU_METHOD CompuMethod_151 "" RAT_FUNC "%6.2" "degCA" COEFFS 0 1 0 0 0 1 /end COMPU_METHOD
/begin COMPU_METHOD CompuMethod_152 "" RAT_FUNC "%3.0" "cyl#" COEFFS 0 1 -1 0 0 1 /end COMPU_METHOD
/begin COMPU_METHOD CompuMethod_153 "" RAT_FUNC "%6.2" "deg" COEFFS 0 1 0 0 0 1 /end COMPU_METHOD
/begin COMPU_METHOD CompuMethod_154 "" TAB_VERB "%3.0" "" COMPU_TAB_REF CompuVtab_120 /end COMPU_METHOD
/begin COMPU_METHOD CompuMethod_160 "" RAT_FUNC "%5.0" "" COEFFS 0 1 0 0 0 0.0015259 /end COMPU_METHOD
/begin COMPU_METHOD CompuMethod_164 "" RAT_FUNC "%6.2" "" COEFFS 0 1 0 0 0 57.2958 /end COMPU_METHOD
/begin COMPU_METHOD CompuMethod_170 "" RAT_FUNC "%6.2" "rad/s" COEFFS 0 1 0 0 0 9.5493 /end COMPU_METHOD
/begin COMPU_METHOD CompuMethod_176 "" RAT_FUNC "%18.9" "" COEFFS 0 1 0 0 0 1 /end COMPU_METHOD
/begin COMPU_METHOD CompuMethod_177 "" RAT_FUNC "%8.0" "seconds" COEFFS 0 1 0 0 0 1 /end COMPU_METHOD
/begin COMPU_METHOD CompuMethod_178 "" TAB_VERB "%1.0" "" COMPU_TAB_REF CompuVtab_127 /end COMPU_METHOD
/begin COMPU_METHOD CompuMethod_182 "" RAT_FUNC "%9.0" "bytes" COEFFS 0 1 0 0 0 1 /end COMPU_METHOD
/begin COMPU_METHOD CompuMethod_184 "" TAB_VERB "%1.0" "" COMPU_TAB_REF CompuVtab_132 /end COMPU_METHOD
/begin COMPU_METHOD CompuMethod_186 "" RAT_FUNC "%8.0" "ms" COEFFS 0 1 0 0 0 0.001 /end COMPU_METHOD
/*~~~~~~~~~ 6.3.34 COMPU_VTABs ~~~~~~~~~*/
/begin COMPU_VTAB CompuVtab_1 "" TAB_VERB 29 8 "PCM" 9 "ECM" 10 "PCM80" 11 "VCM" 13 "PCM128" 14 "ISDL 555" 15 "ISDL" 15 "DLM565-24" 17 "SECM" 18 "uCHI" 19 "ECM48" 20 "AIM" 21 "FIRE48" 22 "TVM48" 23 "Axiom Eval" 24 "Indy 05" 25 "PCM0902" 26 "PCM0901" 27 "Lowrance LMF-200" 28 "Peiker" 29 "M3A" 30 "Kohler Doolittle" 31 "PIM" 32 "Unused" 33 "Bedrock" 34 "SECM" 35 "uCHI" 36 "Tenneco AT" 37 "Woodward DPF" /end COMPU_VTAB
/begin COMPU_VTAB CompuVtab_2 "" TAB_VERB 2 0 "Pass-Through" 1 "Override" /end COMPU_VTAB
/begin COMPU_VTAB CompuVtab_3 "" TAB_VERB 8 0 "Paused Before Application Initialization (Step 1)" 1 "Paused Before OpenApplication (Step 2)" 2 "Paused Before Trigger_STARTUP_EVENT_12583p0004 (Step 3)" 3 "Paused Before Trigger_STARTUP_EVENT_12654p0004 (Step 4)" 4 "Paused Before Trigger_STARTUP_EVENT_12725p0004 (Step 5)" 5 "Paused After Application Initialization" 6 "Run" 7 "-" /end COMPU_VTAB
/begin COMPU_VTAB CompuVtab_4 "" TAB_VERB 2 0 "Disabled" 1 "Enabled" /end COMPU_VTAB
/begin COMPU_VTAB CompuVtab_5 "" TAB_VERB 7 0 "Pause Before Application Initialization (Step 1)" 1 "Paused Before OpenApplication (Step 2)" 2 "Paused Before Trigger_STARTUP_EVENT_12583p0004 (Step 3)" 3 "Paused Before Trigger_STARTUP_EVENT_12654p0004 (Step 4)" 4 "Paused Before Trigger_STARTUP_EVENT_12725p0004 (Step 5)" 5 "Pause After Application Initialization" 6 "Do Not Pause On Startup" /end COMPU_VTAB
/begin COMPU_VTAB CompuVtab_6 "" TAB_VERB 5 0 "Initializing" 1 "Running Normally" 2 "Stopped" 3 "Paused" 4 "Save Cals, Shutdown Power, and Reset" /end COMPU_VTAB
/begin COMPU_VTAB CompuVtab_7 "" TAB_VERB 11 0 "-" 1 "App Monitor Notification Stop" 2 "Application Stopped (User Command)" 3 "Starvation timer margin violation" 4 "Heap margin violation" 5 "Idle stack margin violation" 6 "Interrupt stack margin violation" 8 "ApplicationInterruptTask stack margin violation" 9 "BGNDTask stack margin violation" 10 "SHUTDOWNTask stack margin violation" 11 "FGNDTask stack margin violation" /end COMPU_VTAB
/begin COMPU_VTAB CompuVtab_8 "" TAB_VERB 1 0 "-" /end COMPU_VTAB
/begin COMPU_VTAB CompuVtab_9 "" TAB_VERB 38 0 "Normal Operation" 1 "Task Kernel API Usage" 2 "Bad Attribute Data" 3 "Operation timed out" 4 "Operation aborted" 5 "Access from an ISR" 6 "Illegal Handle" 7 "Out of free store memory" 8 "The supplied task information is not valid." 9 "Missing Attribute" 10 "Insufficient FW resource" 11 "TPU Mask incompatible with the eTPU" 12 "Resource Busy" 13 "Data Unavailable" 14 "Function Not Supported" 15 "Flash is not blank" 16 "Flash Prog Voltage Unavailable" 17 "Memory verify" 18 "Uncreated Resource access" 19 "Illegal address" 20 "Hardware overrun" 21 "Alignment" 22 "Hardware timeout" 23 "TPU Function not in mask" 24 "TPU coprocessor not succesfully opened" 25 "Required dependants were not located" 26 "SPI Bus Integrity check failed." 27 "Insufficient param ram for TPU primitive" 28 "Dependent ASIC not created" 29 "Resource Not Capable." 30 "Software overrun" 31 "A Write attempted failed but OK to continue" 32 "Heap free-list distroyed; found while allocating" 33 "Heap freeing already freed or distroyed block" 34 "Heap freeing block outside of pool" 35 "Heap free list crashed; found while reallocating" 36 "An operation to the host operating system failed" 37 "Data Alignment" /end COMPU_VTAB
/begin COMPU_VTAB CompuVtab_10 "" TAB_VERB 7 0 "Calibratable Development Module" 1 "Non-Calibratable Production Module" 2 "Software Dev Module (with RAM overlay only)" 3 "Software Dev Module (with Trace Pod & RAM)" 4 "Calibratable Development Module with Censorship disabled" 5 "Non-Calibratable Production Module with Censorship disabled" 6 "Module with a daughter board whose purpose is to aid in calibration" /end COMPU_VTAB
/begin COMPU_VTAB CompuVtab_11 "" TAB_VERB 4 0 "Off" 1 "Armed" 2 "ResumableOff" 3 "On" /end COMPU_VTAB
/begin COMPU_VTAB CompuVtab_12 "" TAB_VERB 8 0 "Off / disabled" 1 "Hold" 2 "Accelerate" 3 "Decelerate / coast" 4 "Resume" 5 "Set" 6 "Accelerator override" 7 "Not available" /end COMPU_VTAB
/begin COMPU_VTAB CompuVtab_13 "" TAB_VERB 2 0 "Calibration Locked" 1 "Calibration Unlocked" /end COMPU_VTAB
/begin COMPU_VTAB CompuVtab_14 "" TAB_VERB 2 0 "Data Acquisition Locked" 1 "Data Acquisition Unlocked" /end COMPU_VTAB
/begin COMPU_VTAB CompuVtab_15 "" TAB_VERB 2 0 "Programming Locked" 1 "Programming Unlocked" /end COMPU_VTAB
/begin COMPU_VTAB CompuVtab_16 "" TAB_VERB 2 0 "Not Connected" 1 "Connected" /end COMPU_VTAB
/begin COMPU_VTAB CompuVtab_17 "" TAB_VERB 2 0 "niihil14/Foreground/Plant/Sensors /Non-Linear Sensor Characterization (tbl)1/Override/OldValue" 1 "-" /end COMPU_VTAB
/begin COMPU_VTAB CompuVtab_18 "" TAB_VERB 2 0 "niihil14/Foreground/Plant/Sensors /Linear Sensor Characterization (Hi//Lo)1/Override/NewValue" 1 "-" /end COMPU_VTAB
/begin COMPU_VTAB CompuVtab_19 "" TAB_VERB 2 0 "niihil14/Foreground/Plant/ Actuators/Ignition/motohawk_override_abs/NewValue" 1 "-" /end COMPU_VTAB
/begin COMPU_VTAB CompuVtab_20 "" TAB_VERB 2 0 "niihil14/Foreground/Plant/Sensors /Linear Sensor Characterization (Hi//Lo)1/Override/OldValue" 1 "-" /end COMPU_VTAB
/begin COMPU_VTAB CompuVtab_21 "" TAB_VERB 2 0 "niihil14/Foreground/Plant/ Actuators/Ignition/motohawk_override_abs/OldValue" 1 "-" /end COMPU_VTAB
/begin COMPU_VTAB CompuVtab_22 "" TAB_VERB 2 0 "niihil14/Foreground/Plant/ Actuators/Ignition/motohawk_override_abs1/NewValue" 1 "-" /end COMPU_VTAB
/begin COMPU_VTAB CompuVtab_23 "" TAB_VERB 2 0 "niihil14/Foreground/Plant/Sensors /Non-Linear Sensor Characterization (tbl)10/Override/NewValue" 1 "-" /end COMPU_VTAB
/begin COMPU_VTAB CompuVtab_24 "" TAB_VERB 2 0 "niihil14/Foreground/Plant/Sensors /Non-Linear Sensor Characterization (tbl)10/Override/OldValue" 1 "-" /end COMPU_VTAB
/begin COMPU_VTAB CompuVtab_25 "" TAB_VERB 2 0 "niihil14/Foreground/Plant/Sensors /Linear Sensor Characterization (Hi//Lo)2/Override/NewValue" 1 "-" /end COMPU_VTAB
/begin COMPU_VTAB CompuVtab_26 "" TAB_VERB 2 0 "niihil14/Foreground/Plant/Sensors /Linear Sensor Characterization (Hi//Lo)2/Override/OldValue" 1 "-" /end COMPU_VTAB
/begin COMPU_VTAB CompuVtab_27 "" TAB_VERB 2 0 "niihil14/Foreground/Plant/ Actuators/Ignition/motohawk_override_abs1/OldValue" 1 "-" /end COMPU_VTAB
/begin COMPU_VTAB CompuVtab_28 "" TAB_VERB 2 0 "niihil14/Foreground/Plant/Sensors /Linear Sensor Characterization (Hi//Lo)3/Override/NewValue" 1 "-" /end COMPU_VTAB
/begin COMPU_VTAB CompuVtab_29 "" TAB_VERB 2 0 "niihil14/Foreground/Plant/ Actuators/Injection/motohawk_override_abs/NewValue" 1 "-" /end COMPU_VTAB
/begin COMPU_VTAB CompuVtab_30 "" TAB_VERB 2 0 "niihil14/Foreground" 1 "-" /end COMPU_VTAB
/begin COMPU_VTAB CompuVtab_31 "" TAB_VERB 2 0 "niihil14/Foreground/Plant/Sensors /Linear Sensor Characterization (Hi//Lo)3/Override/OldValue" 1 "-" /end COMPU_VTAB
/begin COMPU_VTAB CompuVtab_32 "" TAB_VERB 2 0 "niihil14/Foreground/Plant/ Actuators/Injection/motohawk_override_abs/OldValue" 1 "-" /end COMPU_VTAB
/begin COMPU_VTAB CompuVtab_33 "" TAB_VERB 2 0 "niihil14/Foreground/Plant/ Actuators/Fuel Pump/motohawk_override_abs/NewValue" 1 "-" /end COMPU_VTAB
/begin COMPU_VTAB CompuVtab_34 "" TAB_VERB 2 0 "niihil14/Foreground/Plant/Sensors /Linear Sensor Characterization (Hi//Lo)4/Override/NewValue" 1 "-" /end COMPU_VTAB
/begin COMPU_VTAB CompuVtab_35 "" TAB_VERB 2 0 "niihil14/Foreground/Plant/ Actuators/MIL/motohawk_override_abs/NewValue" 1 "-" /end COMPU_VTAB
/begin COMPU_VTAB CompuVtab_36 "" TAB_VERB 2 0 "niihil14/Foreground/Plant/ Actuators/Fuel Pump/motohawk_override_abs/OldValue" 1 "-" /end COMPU_VTAB
/begin COMPU_VTAB CompuVtab_37 "" TAB_VERB 2 0 "niihil14/Foreground/Plant/Sensors /Linear Sensor Characterization (Hi//Lo)4/Override/OldValue" 1 "-" /end COMPU_VTAB
/begin COMPU_VTAB CompuVtab_38 "" TAB_VERB 2 0 "niihil14/Foreground/Plant/ Actuators/MIL/motohawk_override_abs/OldValue" 1 "-" /end COMPU_VTAB
/begin COMPU_VTAB CompuVtab_39 "" TAB_VERB 2 0 "niihil14/Foreground/Plant/ Actuators/H1/motohawk_override_abs/NewValue" 1 "-" /end COMPU_VTAB
/begin COMPU_VTAB CompuVtab_40 "" TAB_VERB 2 0 "niihil14/Foreground/Plant/Sensors /Non-Linear Sensor Characterization (tbl)/Override/NewValue" 1 "-" /end COMPU_VTAB
/begin COMPU_VTAB CompuVtab_41 "" TAB_VERB 2 0 "niihil14/Foreground/Plant/Sensors /Engine Speed/motohawk_model_probe_eval_f" 1 "-" /end COMPU_VTAB
/begin COMPU_VTAB CompuVtab_42 "" TAB_VERB 2 0 "niihil14/Foreground/Plant/ Actuators/H1/motohawk_override_abs/OldValue" 1 "-" /end COMPU_VTAB
/begin COMPU_VTAB CompuVtab_43 "" TAB_VERB 2 0 "niihil14/Foreground/Plant/Sensors /Non-Linear Sensor Characterization (tbl)/Override/OldValue" 1 "-" /end COMPU_VTAB
/begin COMPU_VTAB CompuVtab_44 "" TAB_VERB 2 0 "niihil14/Foreground/Plant/Sensors /Linear Sensor Characterization (Hi//Lo)/Override/NewValue" 1 "-" /end COMPU_VTAB
/begin COMPU_VTAB CompuVtab_45 "" TAB_VERB 2 0 "niihil14/Foreground/Plant/ Actuators/IAC/motohawk_override_abs/NewValue" 1 "-" /end COMPU_VTAB
/begin COMPU_VTAB CompuVtab_46 "" TAB_VERB 2 0 "niihil14/Foreground/Plant/Sensors /Non-Linear Sensor Characterization (tbl)1/Override/NewValue" 1 "-" /end COMPU_VTAB
/begin COMPU_VTAB CompuVtab_47 "" TAB_VERB 2 0 "niihil14/Foreground/Plant/Sensors /Linear Sensor Characterization (Hi//Lo)/Override/OldValue" 1 "-" /end COMPU_VTAB
/begin COMPU_VTAB CompuVtab_48 "" TAB_VERB 2 0 "niihil14/Foreground/Plant/ Actuators/IAC/motohawk_override_abs/OldValue" 1 "-" /end COMPU_VTAB
/begin COMPU_VTAB CompuVtab_49 "" TAB_VERB 2 0 "niihil14/Foreground/Plant/Sensors /Non-Linear Sensor Characterization (tbl)3/Override/NewValue" 1 "-" /end COMPU_VTAB
/begin COMPU_VTAB CompuVtab_50 "" TAB_VERB 2 0 "niihil14/Foreground/Plant/Sensors /Non-Linear Sensor Characterization (tbl)3/Override/OldValue" 1 "-" /end COMPU_VTAB
/begin COMPU_VTAB CompuVtab_51 "" TAB_VERB 2 0 "niihil14/Foreground/Plant/Sensors /Non-Linear Sensor Characterization (tbl)2/Override/NewValue" 1 "-" /end COMPU_VTAB
/begin COMPU_VTAB CompuVtab_52 "" TAB_VERB 2 0 "niihil14/Foreground/Plant/Sensors /Non-Linear Sensor Characterization (tbl)4/Override/NewValue" 1 "-" /end COMPU_VTAB
/begin COMPU_VTAB CompuVtab_53 "" TAB_VERB 2 0 "niihil14/Foreground/Plant/Sensors /Non-Linear Sensor Characterization (tbl)2/Override/OldValue" 1 "-" /end COMPU_VTAB
/begin COMPU_VTAB CompuVtab_54 "" TAB_VERB 2 0 "niihil14/Foreground/Plant/Sensors /Non-Linear Sensor Characterization (tbl)15/Override/NewValue" 1 "-" /end COMPU_VTAB
/begin COMPU_VTAB CompuVtab_55 "" TAB_VERB 2 0 "niihil14/Foreground/Plant/Sensors /Non-Linear Sensor Characterization (tbl)4/Override/OldValue" 1 "-" /end COMPU_VTAB
/begin COMPU_VTAB CompuVtab_56 "" TAB_VERB 2 0 "niihil14/Foreground/Plant/Sensors /Non-Linear Sensor Characterization (tbl)20/Override/NewValue" 1 "-" /end COMPU_VTAB
/begin COMPU_VTAB CompuVtab_57 "" TAB_VERB 2 0 "niihil14/Foreground/Plant/Sensors /Non-Linear Sensor Characterization (tbl)15/Override/OldValue" 1 "-" /end COMPU_VTAB
/begin COMPU_VTAB CompuVtab_58 "" TAB_VERB 2 0 "niihil14/Foreground/Plant/Sensors /Non-Linear Sensor Characterization (tbl)20/Override/OldValue" 1 "-" /end COMPU_VTAB
/begin COMPU_VTAB CompuVtab_59 "" TAB_VERB 2 0 "niihil14/Foreground/Plant/Sensors /Non-Linear Sensor Characterization (tbl)16/Override/NewValue" 1 "-" /end COMPU_VTAB
/begin COMPU_VTAB CompuVtab_60 "" TAB_VERB 2 0 "niihil14/Foreground/Plant/Sensors /Non-Linear Sensor Characterization (tbl)21/Override/NewValue" 1 "-" /end COMPU_VTAB
/begin COMPU_VTAB CompuVtab_61 "" TAB_VERB 2 0 "niihil14/Foreground/Plant/Sensors /Non-Linear Sensor Characterization (tbl)16/Override/OldValue" 1 "-" /end COMPU_VTAB
/begin COMPU_VTAB CompuVtab_62 "" TAB_VERB 2 0 "niihil14/Foreground/Plant/Sensors /Non-Linear Sensor Characterization (tbl)11/Override/NewValue" 1 "-" /end COMPU_VTAB
/begin COMPU_VTAB CompuVtab_63 "" TAB_VERB 2 0 "niihil14/Foreground/Plant/Sensors /Non-Linear Sensor Characterization (tbl)21/Override/OldValue" 1 "-" /end COMPU_VTAB
/begin COMPU_VTAB CompuVtab_64 "" TAB_VERB 2 0 "niihil14/Foreground/Plant/Sensors /Non-Linear Sensor Characterization (tbl)17/Override/NewValue" 1 "-" /end COMPU_VTAB
/begin COMPU_VTAB CompuVtab_65 "" TAB_VERB 2 0 "niihil14/Foreground/Plant/Sensors /Non-Linear Sensor Characterization (tbl)11/Override/OldValue" 1 "-" /end COMPU_VTAB
/begin COMPU_VTAB CompuVtab_66 "" TAB_VERB 2 0 "niihil14/Foreground/Plant/Sensors /Non-Linear Sensor Characterization (tbl)22/Override/NewValue" 1 "-" /end COMPU_VTAB
/begin COMPU_VTAB CompuVtab_67 "" TAB_VERB 2 0 "niihil14/Foreground/Plant/Sensors /Non-Linear Sensor Characterization (tbl)17/Override/OldValue" 1 "-" /end COMPU_VTAB
/begin COMPU_VTAB CompuVtab_68 "" TAB_VERB 2 0 "niihil14/Foreground/Plant/Sensors /Non-Linear Sensor Characterization (tbl)12/Override/NewValue" 1 "-" /end COMPU_VTAB
/begin COMPU_VTAB CompuVtab_69 "" TAB_VERB 2 0 "niihil14/Foreground/Plant/Sensors /Non-Linear Sensor Characterization (tbl)22/Override/OldValue" 1 "-" /end COMPU_VTAB
/begin COMPU_VTAB CompuVtab_70 "" TAB_VERB 2 0 "niihil14/Foreground/Plant/Sensors /Non-Linear Sensor Characterization (tbl)18/Override/NewValue" 1 "-" /end COMPU_VTAB
/begin COMPU_VTAB CompuVtab_71 "" TAB_VERB 2 0 "niihil14/Foreground/Plant/Sensors /Non-Linear Sensor Characterization (tbl)12/Override/OldValue" 1 "-" /end COMPU_VTAB
/begin COMPU_VTAB CompuVtab_72 "" TAB_VERB 2 0 "niihil14/Foreground/Plant/Sensors /Non-Linear Sensor Characterization (tbl)23/Override/NewValue" 1 "-" /end COMPU_VTAB
/begin COMPU_VTAB CompuVtab_73 "" TAB_VERB 2 0 "niihil14/Foreground/Plant/Sensors /Non-Linear Sensor Characterization (tbl)18/Override/OldValue" 1 "-" /end COMPU_VTAB
/begin COMPU_VTAB CompuVtab_74 "" TAB_VERB 2 0 "niihil14/Foreground/Plant/Sensors /Non-Linear Sensor Characterization (tbl)13/Override/NewValue" 1 "-" /end COMPU_VTAB
/begin COMPU_VTAB CompuVtab_75 "" TAB_VERB 2 0 "niihil14/Foreground/Plant/Sensors /Non-Linear Sensor Characterization (tbl)23/Override/OldValue" 1 "-" /end COMPU_VTAB
/begin COMPU_VTAB CompuVtab_76 "" TAB_VERB 2 0 "niihil14/Foreground/Plant/Sensors /Non-Linear Sensor Characterization (tbl)19/Override/NewValue" 1 "-" /end COMPU_VTAB
/begin COMPU_VTAB CompuVtab_77 "" TAB_VERB 2 0 "niihil14/Foreground/Plant/Sensors /Non-Linear Sensor Characterization (tbl)13/Override/OldValue" 1 "-" /end COMPU_VTAB
/begin COMPU_VTAB CompuVtab_78 "" TAB_VERB 2 0 "niihil14/Foreground/Plant/Sensors /Non-Linear Sensor Characterization (tbl)19/Override/OldValue" 1 "-" /end COMPU_VTAB
/begin COMPU_VTAB CompuVtab_79 "" TAB_VERB 2 0 "niihil14/Foreground/Plant/Sensors /Non-Linear Sensor Characterization (tbl)14/Override/NewValue" 1 "-" /end COMPU_VTAB
/begin COMPU_VTAB CompuVtab_80 "" TAB_VERB 2 0 "niihil14/Foreground/Plant/Sensors /Non-Linear Sensor Characterization (tbl)14/Override/OldValue" 1 "-" /end COMPU_VTAB
/begin COMPU_VTAB CompuVtab_81 "" TAB_VERB 2 0 "niihil14/OS/Main Power Relay/Background/Post Shutdown two ticks before MPRD off" 1 "-" /end COMPU_VTAB
/begin COMPU_VTAB CompuVtab_82 "" TAB_VERB 2 0 "niihil14/OS/Main Power Relay/Background/Post Shutdown two ticks before MPRD off/Post Shutdown two ticks before MPRD off" 1 "-" /end COMPU_VTAB
/begin COMPU_VTAB CompuVtab_83 "" TAB_VERB 2 0 "niihil14/OS/CCP CAN Protocol1/CCP CAN Protocol External Trig1/CCP Command Driver/While new CCP Command" 1 "-" /end COMPU_VTAB
/begin COMPU_VTAB CompuVtab_84 "" TAB_VERB 2 0 "niihil14/OS/Main Power Relay/Background/Processor Reboot" 1 "-" /end COMPU_VTAB
/begin COMPU_VTAB CompuVtab_85 "" TAB_VERB 2 0 "niihil14/OS/CCP CAN Protocol1/CCP CAN Protocol External Trig1/CCP Command Driver/While new CCP Command/Adjust ID" 1 "-" /end COMPU_VTAB
/begin COMPU_VTAB CompuVtab_86 "" TAB_VERB 2 0 "niihil14/Foreground/Plant/Sensors /Non-Linear Sensor Characterization (tbl)8/Override/NewValue" 1 "-" /end COMPU_VTAB
/begin COMPU_VTAB CompuVtab_87 "" TAB_VERB 2 0 "niihil14/OS/Main Power Relay/Background/Save NV Vars one tick before MPRD off" 1 "-" /end COMPU_VTAB
/begin COMPU_VTAB CompuVtab_88 "" TAB_VERB 2 0 "niihil14/OS/CCP CAN Protocol1/CCP CAN Protocol External Trig1/CCP Daq Processing" 1 "-" /end COMPU_VTAB
/begin COMPU_VTAB CompuVtab_89 "" TAB_VERB 2 0 "niihil14/Foreground/Plant/Sensors /Non-Linear Sensor Characterization (tbl)8/Override/OldValue" 1 "-" /end COMPU_VTAB
/begin COMPU_VTAB CompuVtab_90 "" TAB_VERB 2 0 "niihil14/OS/Main Power Relay/Background/Save NV Vars one tick before MPRD off/Save NV Vars one tick before MPRD off" 1 "-" /end COMPU_VTAB
/begin COMPU_VTAB CompuVtab_91 "" TAB_VERB 2 0 "niihil14/OS/CCP CAN Protocol2/CCP CAN Protocol External Trig1/CCP Command Driver" 1 "-" /end COMPU_VTAB
/begin COMPU_VTAB CompuVtab_92 "" TAB_VERB 2 0 "niihil14/Foreground/Plant/Sensors /Non-Linear Sensor Characterization (tbl)9/Override/NewValue" 1 "-" /end COMPU_VTAB
/begin COMPU_VTAB CompuVtab_93 "" TAB_VERB 2 0 "niihil14/OS/Main Power Relay/Background/Shutdown power on ECU565-128" 1 "-" /end COMPU_VTAB
/begin COMPU_VTAB CompuVtab_94 "" TAB_VERB 2 0 "niihil14/OS/CCP CAN Protocol2/CCP CAN Protocol External Trig1/CCP Command Driver/While new CCP Command" 1 "-" /end COMPU_VTAB
/begin COMPU_VTAB CompuVtab_95 "" TAB_VERB 2 0 "niihil14/Foreground/Plant/Sensors /Non-Linear Sensor Characterization (tbl)9/Override/OldValue" 1 "-" /end COMPU_VTAB
/begin COMPU_VTAB CompuVtab_96 "" TAB_VERB 2 0 "niihil14/OS/CCP CAN Protocol2/CCP CAN Protocol External Trig1/CCP Command Driver/While new CCP Command/Adjust ID" 1 "-" /end COMPU_VTAB
/begin COMPU_VTAB CompuVtab_97 "" TAB_VERB 2 0 "niihil14/Housekeeping" 1 "-" /end COMPU_VTAB
/begin COMPU_VTAB CompuVtab_98 "" TAB_VERB 2 0 "niihil14/OS/CCP CAN Protocol2/CCP CAN Protocol External Trig1/CCP Daq Processing" 1 "-" /end COMPU_VTAB
/begin COMPU_VTAB CompuVtab_99 "" TAB_VERB 2 0 "niihil14/OS/CCP CAN Protocol/CCP CAN Protocol External Trig1/CCP Command Driver" 1 "-" /end COMPU_VTAB
/begin COMPU_VTAB CompuVtab_100 "" TAB_VERB 2 0 "niihil14/Foreground/Plant/Sensors /Non-Linear Sensor Characterization (tbl)5/Override/NewValue" 1 "-" /end COMPU_VTAB
/begin COMPU_VTAB CompuVtab_101 "" TAB_VERB 2 0 "niihil14/OS/Main Power Relay/Background" 1 "-" /end COMPU_VTAB
/begin COMPU_VTAB CompuVtab_102 "" TAB_VERB 2 0 "niihil14/OS/CCP CAN Protocol/CCP CAN Protocol External Trig1/CCP Command Driver/While new CCP Command" 1 "-" /end COMPU_VTAB
/begin COMPU_VTAB CompuVtab_103 "" TAB_VERB 2 0 "niihil14/Foreground/Plant/Sensors /Non-Linear Sensor Characterization (tbl)5/Override/OldValue" 1 "-" /end COMPU_VTAB
/begin COMPU_VTAB CompuVtab_104 "" TAB_VERB 2 0 "niihil14/OS/Main Power Relay/Background/Display Variable Event Function-Call/Clear" 1 "-" /end COMPU_VTAB
/begin COMPU_VTAB CompuVtab_105 "" TAB_VERB 2 0 "niihil14/OS/CCP CAN Protocol/CCP CAN Protocol External Trig1/CCP Command Driver/While new CCP Command/Adjust ID" 1 "-" /end COMPU_VTAB
/begin COMPU_VTAB CompuVtab_106 "" TAB_VERB 2 0 "niihil14/Foreground/Plant/Sensors /Non-Linear Sensor Characterization (tbl)6/Override/NewValue" 1 "-" /end COMPU_VTAB
/begin COMPU_VTAB CompuVtab_107 "" TAB_VERB 2 0 "niihil14/OS/Main Power Relay/Background/Display Variable Event Function-Call1/Clear" 1 "-" /end COMPU_VTAB
/begin COMPU_VTAB CompuVtab_108 "" TAB_VERB 2 0 "niihil14/OS/CCP CAN Protocol/CCP CAN Protocol External Trig1/CCP Daq Processing" 1 "-" /end COMPU_VTAB
/begin COMPU_VTAB CompuVtab_109 "" TAB_VERB 2 0 "niihil14/Foreground/Plant/Sensors /Non-Linear Sensor Characterization (tbl)6/Override/OldValue" 1 "-" /end COMPU_VTAB
/begin COMPU_VTAB CompuVtab_110 "" TAB_VERB 2 0 "niihil14/OS/CCP CAN Protocol1/CCP CAN Protocol External Trig1/CCP Command Driver" 1 "-" /end COMPU_VTAB
/begin COMPU_VTAB CompuVtab_111 "" TAB_VERB 2 0 "niihil14/Foreground/Plant/Sensors /Non-Linear Sensor Characterization (tbl)7/Override/NewValue" 1 "-" /end COMPU_VTAB
/begin COMPU_VTAB CompuVtab_112 "" TAB_VERB 2 0 "niihil14/Foreground/Plant/Sensors /Non-Linear Sensor Characterization (tbl)7/Override/OldValue" 1 "-" /end COMPU_VTAB
/begin COMPU_VTAB CompuVtab_113 "" TAB_VERB 2 0 "niihil14/OS/Main Power Relay/Background/Shutdown power on ECU565-128/Shutdown power on ECU565-128" 1 "-" /end COMPU_VTAB
/begin COMPU_VTAB CompuVtab_114 "" TAB_VERB 2 0 "niihil14/OS/Main Power Relay/Background/motohawk_override_abs/NewValue" 1 "-" /end COMPU_VTAB
/begin COMPU_VTAB CompuVtab_115 "" TAB_VERB 2 0 "niihil14/OS/Main Power Relay/Background/motohawk_override_abs/OldValue" 1 "-" /end COMPU_VTAB
/begin COMPU_VTAB CompuVtab_116 "" TAB_VERB 2 0 "niihil14/OS/Main Power Relay/Background/motohawk_restore_nvmem" 1 "-" /end COMPU_VTAB
/begin COMPU_VTAB CompuVtab_117 "" TAB_VERB 2 0 "niihil14/OS/Main Power Relay/Background/motohawk_store_nvmem" 1 "-" /end COMPU_VTAB
/begin COMPU_VTAB CompuVtab_118 "" TAB_VERB 9 0 "OK" 1 "Crank Sync Fault" 2 "Reverse Rotation" 3 "No Crank Edges" 4 "No CAM Edges" 5 "CAM Sync Fault" 6 "Encoder Sync Error on Slave" 7 "Reverse Rotation on Slave" 8 "Slave Encoder Loss" /end COMPU_VTAB
/begin COMPU_VTAB CompuVtab_119 "" TAB_VERB 8 0 "-" 1 "Zero Speed" 2 "Position Unknown" 3 "Crank Sync - CAM Unknown" 4 "Crank Sync - CAM Sync" 5 "Crank Sync - Master Only" 6 "Crank Sync - Slave Only" 7 "Crank Sync - Master + Slave" /end COMPU_VTAB
/begin COMPU_VTAB CompuVtab_120 "" TAB_VERB 61 0 "APP_RangeHigh" 1 "APP_RangeLow" 2 "Airflow2_RangeHigh" 3 "Airflow2_RangeLow" 4 "Airflow3_RangeHigh" 5 "Airflow3_RangeLow" 6 "Airflow_RangeHigh" 7 "Airflow_RangeLow" 8 "CCVS_Stale" 9 "COOLT_RangeHigh" 10 "COOLT_RangeLow" 11 "CoolP_RangeHigh" 12 "CoolP_RangeLow" 13 "DRVP_RangeHigh" 14 "DRVP_RangeLow" 15 "ECUP_RangeHigh" 16 "ECUP_RangeLow" 17 "ETCPosA_RangeHigh" 18 "ETCPosA_RangeLow" 19 "ETCPosB_RangeHigh" 20 "ETCPosB_RangeLow" 21 "ExT1_RangeHigh" 22 "ExT1_RangeLow" 23 "ExT2_RangeHigh" 24 "ExT2_RangeLow" 25 "FUELT_RangeHigh" 26 "FUELT_RangeLow" 27 "FuelP_RangeHigh" 28 "FuelP_RangeLow" 29 "IMP_RangeHigh" 30 "IMP_RangeLow" 31 "IMT_RangeHigh" 32 "IMT_RangeLow" 33 "Idle_CPU" 34 "O2A_RangeHigh" 35 "O2A_RangeLow" 36 "O2B_RangeHigh" 37 "O2B_RangeLow" 38 "O2C_RangeHigh" 39 "O2C_RangeLow" 40 "O2D_RangeHigh" 41 "O2D_RangeLow" 42 "OilP_RangeHigh" 43 "OilP_RangeLow" 44 "Pcyl1_RangeHigh" 45 "Pcyl1_RangeLow" 46 "Pcyl2_RangeHigh" 47 "Pcyl2_RangeLow" 48 "Pcyl3_RangeHigh" 49 "Pcyl3_RangeLow" 50 "Pcyl4_RangeHigh" 51 "Pcyl4_RangeLow" 52 "Pcyl5_RangeHigh" 53 "Pcyl5_RangeLow" 54 "Pcyl6_RangeHigh" 55 "Pcyl6_RangeLow" 56 "Pcyl7_RangeHigh" 57 "Pcyl7_RangeLow" 58 "Pcyl8_RangeHigh" 59 "Pcyl8_RangeLow" 60 "(None)" /end COMPU_VTAB
/begin COMPU_VTAB CompuVtab_127 "" TAB_VERB 2 0 "Disable on low ECUP" 1 "Keep alive" /end COMPU_VTAB
/begin COMPU_VTAB CompuVtab_132 "" TAB_VERB 2 0 "Run" 1 "Reboot" /end COMPU_VTAB
/*~~~~~~~~~ 6.3.65 FUNCTIONs ~~~~~~~~~*/
/begin FUNCTION Version ""
 /begin DEF_CHARACTERISTIC SwIdTxt CalIdTxt SwRevisionTxt FriendlyName CompilerVersion MatlabVersionTxt MotoCoderVersionTxt MotoHawkBuildGUID MotoHawkModelGUID MotoHawkModelName MotoHawkTokenGUID MotoHawkVersionTxt /end DEF_CHARACTERISTIC
 /begin OUT_MEASUREMENT project_id ProductID MotoHawkModelSecondsInUse /end OUT_MEASUREMENT
/end FUNCTION
/begin FUNCTION System ""
 /begin SUB_FUNCTION Version Tool_Interface Module Debug Performance Memory CCP System_Config Code_Coverage Main_Power_Relay Encoder NonVolatile_Storage Status /end SUB_FUNCTION
/end FUNCTION
/begin FUNCTION Tool_Interface ""
 /begin OUT_MEASUREMENT table_0_rev table_1_rev table_2_rev Protocol_KeySuite_Rev EriRev table_3_rev table_4_rev table_5_rev table_6_rev table_7_rev MotProgRev /end OUT_MEASUREMENT
/end FUNCTION
/begin FUNCTION Module "" /begin DEF_CHARACTERISTIC SerialNumber ModelNumber PartNumber /end DEF_CHARACTERISTIC
 /begin OUT_MEASUREMENT BootVerMaj BootVerMin EcuHwMaj EcuHwMin ApplicationCompatibilityArr Capability /end OUT_MEASUREMENT
/end FUNCTION
/begin FUNCTION Airflow_1 "" /begin OUT_MEASUREMENT Airflow Airflow_ADC Airflow_Raw /end OUT_MEASUREMENT /begin SUB_FUNCTION Airflow_Config Airflow_Override /end SUB_FUNCTION /end FUNCTION
/begin FUNCTION Airflow "" /begin SUB_FUNCTION Airflow_1 Airflow3 /end SUB_FUNCTION /end FUNCTION
/begin FUNCTION Sensors ""
 /begin SUB_FUNCTION Airflow Airflow2 APP CoolP COOLT DRVP ECUP ETCPosA ETCPosB ExT1 ExT2 FuelP FUELT IMP IMT O2A O2B O2C O2D OilP Pcyl1 Pcyl2 Pcyl3 Pcyl4 Pcyl5 Pcyl6 Pcyl7 Pcyl8 /end SUB_FUNCTION
/end FUNCTION
/begin FUNCTION Airflow_Config ""
 /begin DEF_CHARACTERISTIC Airflow_Default Airflow_FiltConst Airflow_InHi Airflow_InHiFlt Airflow_InLo Airflow_InLoFlt Airflow_OutHi Airflow_OutLo /end DEF_CHARACTERISTIC
/end FUNCTION
/begin FUNCTION Airflow_Override "" /begin DEF_CHARACTERISTIC Airflow_new Airflow_ovr /end DEF_CHARACTERISTIC /end FUNCTION
/begin FUNCTION Airflow2_1 "" /begin OUT_MEASUREMENT Airflow2 Airflow2_ADC Airflow2_Raw /end OUT_MEASUREMENT /begin SUB_FUNCTION Airflow2_Config Airflow2_Override /end SUB_FUNCTION /end FUNCTION
/begin FUNCTION Airflow2 "" /begin SUB_FUNCTION Airflow2_1 /end SUB_FUNCTION /end FUNCTION
/begin FUNCTION Airflow2_Config ""
 /begin DEF_CHARACTERISTIC Airflow2_Default Airflow2_FiltConst Airflow2_InHi Airflow2_InHiFlt Airflow2_InLo Airflow2_InLoFlt Airflow2_OutHi Airflow2_OutLo /end DEF_CHARACTERISTIC
/end FUNCTION
/begin FUNCTION Airflow2_Override "" /begin DEF_CHARACTERISTIC Airflow2_new Airflow2_ovr /end DEF_CHARACTERISTIC /end FUNCTION
/begin FUNCTION Airflow3 "" /begin OUT_MEASUREMENT Airflow3 Airflow3_ADC Airflow3_Raw /end OUT_MEASUREMENT /begin SUB_FUNCTION Airflow3_Config Airflow3_Override /end SUB_FUNCTION /end FUNCTION
/begin FUNCTION Airflow3_Config ""
 /begin DEF_CHARACTERISTIC Airflow3_Default Airflow3_FiltConst Airflow3_InHi Airflow3_InHiFlt Airflow3_InLo Airflow3_InLoFlt Airflow3_OutHi Airflow3_OutLo /end DEF_CHARACTERISTIC
/end FUNCTION
/begin FUNCTION Airflow3_Override "" /begin DEF_CHARACTERISTIC Airflow3_new Airflow3_ovr /end DEF_CHARACTERISTIC /end FUNCTION
/begin FUNCTION Housekeeping "" /begin DEF_CHARACTERISTIC IdleCPU_Fault_Margin /end DEF_CHARACTERISTIC
 /begin OUT_MEASUREMENT AllFaults.APP_RangeHigh._ AllFaults.APP_RangeLow._ AllFaults.Airflow2_RangeHigh._ AllFaults.Airflow2_RangeLow._ AllFaults.Airflow3_RangeHigh._ AllFaults.Airflow3_RangeLow._ AllFaults.Airflow_RangeHigh._ AllFaults.Airflow_RangeLow._ AllFaults.CCVS_Stale._ AllFaults.COOLT_RangeHigh._ AllFaults.COOLT_RangeLow._ AllFaults.CoolP_RangeHigh._ AllFaults.CoolP_RangeLow._ AllFaults.DRVP_RangeHigh._ AllFaults.DRVP_RangeLow._ AllFaults.ECUP_RangeHigh._ AllFaults.ECUP_RangeLow._ AllFaults.ETCPosA_RangeHigh._ AllFaults.ETCPosA_RangeLow._ AllFaults.ETCPosB_RangeHigh._ AllFaults.ETCPosB_RangeLow._ AllFaults.ExT1_RangeHigh._ AllFaults.ExT1_RangeLow._ AllFaults.ExT2_RangeHigh._ AllFaults.ExT2_RangeLow._ AllFaults.FUELT_RangeHigh._ AllFaults.FUELT_RangeLow._ AllFaults.FuelP_RangeHigh._ AllFaults.FuelP_RangeLow._ AllFaults.IMP_RangeHigh._ AllFaults.IMP_RangeLow._ AllFaults.IMT_RangeHigh._ AllFaults.IMT_RangeLow._ AllFaults.Idle_CPU._ AllFaults.O2A_RangeHigh._ AllFaults.O2A_RangeLow._ AllFaults.O2B_RangeHigh._ AllFaults.O2B_RangeLow._ AllFaults.O2C_RangeHigh._ AllFaults.O2C_RangeLow._ AllFaults.O2D_RangeHigh._ AllFaults.O2D_RangeLow._ AllFaults.OilP_RangeHigh._ AllFaults.OilP_RangeLow._ AllFaults.Pcyl1_RangeHigh._ AllFaults.Pcyl1_RangeLow._ AllFaults.Pcyl2_RangeHigh._ AllFaults.Pcyl2_RangeLow._ AllFaults.Pcyl3_RangeHigh._ AllFaults.Pcyl3_RangeLow._ AllFaults.Pcyl4_RangeHigh._ AllFaults.Pcyl4_RangeLow._ AllFaults.Pcyl5_RangeHigh._ AllFaults.Pcyl5_RangeLow._ AllFaults.Pcyl6_RangeHigh._ AllFaults.Pcyl6_RangeLow._ AllFaults.Pcyl7_RangeHigh._ AllFaults.Pcyl7_RangeLow._ AllFaults.Pcyl8_RangeHigh._ AllFaults.Pcyl8_RangeLow._ /end OUT_MEASUREMENT
/end FUNCTION
/begin FUNCTION niihil14 "" /begin SUB_FUNCTION Housekeeping Foreground /end SUB_FUNCTION /end FUNCTION
/begin FUNCTION APP "" /begin DEF_CHARACTERISTIC APPTbl /end DEF_CHARACTERISTIC /begin OUT_MEASUREMENT APP APP_ADC APP_Raw APPIdx /end OUT_MEASUREMENT /begin SUB_FUNCTION APP_Config APP_Override /end SUB_FUNCTION /end FUNCTION
/begin FUNCTION APP_Config "" /begin DEF_CHARACTERISTIC APP_Default APP_FiltConst APP_Max APP_Min /end DEF_CHARACTERISTIC /end FUNCTION
/begin FUNCTION APP_Override "" /begin DEF_CHARACTERISTIC APP_new APP_ovr /end DEF_CHARACTERISTIC /end FUNCTION
/begin FUNCTION Application_Monitor "" /begin DEF_CHARACTERISTIC ApplicationStatus /end DEF_CHARACTERISTIC
 /begin OUT_MEASUREMENT ApplicationInitStatus ApplicationStopReason ApplicationStopReasonAppLink /end OUT_MEASUREMENT
/end FUNCTION
/begin FUNCTION Debug ""
 /begin SUB_FUNCTION Application_Monitor Application_Monitor_Config CAN Memory_1 /end SUB_FUNCTION
/end FUNCTION
/begin FUNCTION Performance ""
 /begin OUT_MEASUREMENT ApplicationInterruptTaskCPU BGNDTaskCPU CPUIdlePcnt FGNDTaskCPU SHUTDOWNTaskCPU /end OUT_MEASUREMENT
 /begin SUB_FUNCTION ISR /end SUB_FUNCTION
/end FUNCTION
/begin FUNCTION Application_Monitor_Config ""
 /begin DEF_CHARACTERISTIC ApplicationInterruptTaskStackMargin ApplicationMonitorEnable ApplicationPausePoint BGNDTaskStackMargin FGNDTaskStackMargin HeapMargin InterruptTaskStackMargin MainAppTaskStackMargin SHUTDOWNTaskStackMargin StarvationTimerMargin /end DEF_CHARACTERISTIC
/end FUNCTION
/begin FUNCTION Memory ""
 /begin OUT_MEASUREMENT ApplicationInterruptTaskStackMinBytesFree BGNDTaskStackMinBytesFree FGNDTaskStackMinBytesFree IdleStackMinBytesFree InterruptStackMinBytesFree KernelStackMinBytesFree PeakHeapBytesUsed SHUTDOWNTaskStackMinBytesFree /end OUT_MEASUREMENT
/end FUNCTION
/begin FUNCTION CAN ""
 /begin DEF_CHARACTERISTIC CAN_1_TransmitOverrun CAN_2_TransmitOverrun CAN_3_TransmitOverrun /end DEF_CHARACTERISTIC
/end FUNCTION
/begin FUNCTION CC_FF_Adapt "" /begin DEF_CHARACTERISTIC CC_AdaptK /end DEF_CHARACTERISTIC /end FUNCTION
/begin FUNCTION CC_APP_Request "" /begin DEF_CHARACTERISTIC CC_FFTbl CC_Imax CC_Imin CC_KiTbl CC_KpTbl CC_max CC_min /end DEF_CHARACTERISTIC
 /begin OUT_MEASUREMENT CC_effort CC_Error_kph CC_FF CC_FFeffort CC_FFIdx CC_FFIn CC_Ieffort CC_Ki CC_KiIdx CC_KiIn CC_Kp CC_KpIdx CC_KpIn CC_Peffort /end OUT_MEASUREMENT
 /begin SUB_FUNCTION CC_FF_Adapt /end SUB_FUNCTION
/end FUNCTION
/begin FUNCTION Cruise_Control "" /begin DEF_CHARACTERISTIC CC_ButtonHeldTime CC_MaxSpd CC_MinSpd CC_SpeedChange /end DEF_CHARACTERISTIC
 /begin OUT_MEASUREMENT CC_Mode CC_PublishedMode CC_TargetSpeed CCVS_CC_Brake CCVS_CC_Clutch CCVS_CC_Dec CCVS_CC_Inc CCVS_CC_Off CCVS_CC_On CCVS_CC_Resume CCVS_CC_Set CCVS_roadspeed /end OUT_MEASUREMENT
 /begin SUB_FUNCTION CC_APP_Request CCVS_Rx CCVS_Tx /end SUB_FUNCTION
/end FUNCTION
/begin FUNCTION MainContoller "" /begin DEF_CHARACTERISTIC IgnitionDeg /end DEF_CHARACTERISTIC /begin OUT_MEASUREMENT SelectedAPP /end OUT_MEASUREMENT
 /begin SUB_FUNCTION Cruise_Control Injection Ignition LIG_APP_Request ThrottleControl /end SUB_FUNCTION
/end FUNCTION
/begin FUNCTION Controller_1 "" /begin DEF_CHARACTERISTIC IntendedIdleSpeed_rpm /end DEF_CHARACTERISTIC
 /begin OUT_MEASUREMENT MainControllerIn.Pedal_[0_1]._ MainControllerIn.N_[rad_s]._ MainControllerIn.MAF_[kg_s]._ MainControllerIn.Nidle_[rad_s]._ MainControllerIn.IILambda_[_]._ MainControllerIn.Vbatt_[V]._ MainControllerIn.Pfuel_[Pa]._ MainControllerIn.Pman_[Pa]._ MainControllerIn.MaxKnock[_]._ MainControllerOut.Ign_ANg_[rad_btdc]._ MainControllerOut.Inj_Time_[s]._ MainControllerOut.Ign_Ang_[rad_dbtdc]._ MainControllerOut.ThrottleAng_[deg]._ /end OUT_MEASUREMENT
 /begin SUB_FUNCTION MainContoller MAF_Source /end SUB_FUNCTION
/end FUNCTION
/begin FUNCTION Controller "" /begin SUB_FUNCTION Controller_1 Characterization Virtual_Sensors /end SUB_FUNCTION /end FUNCTION
/begin FUNCTION Foreground "" /begin SUB_FUNCTION Controller Plant /end SUB_FUNCTION /end FUNCTION
/begin FUNCTION CCP1 "" /begin DEF_CHARACTERISTIC CCP1_StationAddr CCP1RxID CCP1RxIDMask CCP1TxID /end DEF_CHARACTERISTIC
 /begin OUT_MEASUREMENT CCP_CCP1_Access CCP_CCP1_Access.CCP_CCP1_CAL CCP_CCP1_Access.CCP_CCP1_DAQ CCP_CCP1_Access.CCP_CCP1_PGM CCP_CCP1_ConnectionStatus /end OUT_MEASUREMENT
/end FUNCTION
/begin FUNCTION CCP "" /begin SUB_FUNCTION CCP1 CCP2 CCP3 /end SUB_FUNCTION /end FUNCTION
/begin FUNCTION CCP2 "" /begin DEF_CHARACTERISTIC CCP2_StationAddr CCP2RxID CCP2RxIDMask CCP2TxID /end DEF_CHARACTERISTIC
 /begin OUT_MEASUREMENT CCP_CCP2_Access CCP_CCP2_Access.CCP_CCP2_CAL CCP_CCP2_Access.CCP_CCP2_DAQ CCP_CCP2_Access.CCP_CCP2_PGM CCP_CCP2_ConnectionStatus /end OUT_MEASUREMENT
/end FUNCTION
/begin FUNCTION CCP3 "" /begin DEF_CHARACTERISTIC CCP3_StationAddr CCP3RxID CCP3RxIDMask CCP3TxID /end DEF_CHARACTERISTIC
 /begin OUT_MEASUREMENT CCP_CCP3_Access CCP_CCP3_Access.CCP_CCP3_CAL CCP_CCP3_Access.CCP_CCP3_DAQ CCP_CCP3_Access.CCP_CCP3_PGM CCP_CCP3_ConnectionStatus /end OUT_MEASUREMENT
/end FUNCTION
/begin FUNCTION CCVS_Rx "" /begin DEF_CHARACTERISTIC CCVSTimout /end DEF_CHARACTERISTIC /begin OUT_MEASUREMENT CCVS_Age /end OUT_MEASUREMENT /end FUNCTION
/begin FUNCTION CCVS_Tx "" /begin DEF_CHARACTERISTIC CCVS_SourceAddress /end DEF_CHARACTERISTIC /end FUNCTION
/begin FUNCTION Communication_Config "" /begin DEF_CHARACTERISTIC CityID_CAN_1 CityID_CAN_2 CityID_CAN_3 /end DEF_CHARACTERISTIC /end FUNCTION
/begin FUNCTION System_Config "" /begin SUB_FUNCTION Communication_Config /end SUB_FUNCTION /end FUNCTION
/begin FUNCTION Code_Coverage ""
 /begin OUT_MEASUREMENT CodeCoverParent000 CodeCoverParent000.CodeCover000029 CodeCoverParent000.CodeCover000018 CodeCoverParent000.CodeCover000007 CodeCoverParent000.CodeCover000019 CodeCoverParent000.CodeCover000008 CodeCoverParent000.CodeCover000009 CodeCoverParent000.CodeCover000030 CodeCoverParent000.CodeCover000031 CodeCoverParent000.CodeCover000020 CodeCoverParent000.CodeCover000021 CodeCoverParent000.CodeCover000010 CodeCoverParent000.CodeCover000022 CodeCoverParent000.CodeCover000011 CodeCoverParent000.CodeCover000000 CodeCoverParent000.CodeCover000023 CodeCoverParent000.CodeCover000012 CodeCoverParent000.CodeCover000001 CodeCoverParent000.CodeCover000024 CodeCoverParent000.CodeCover000013 CodeCoverParent000.CodeCover000002 CodeCoverParent000.CodeCover000025 CodeCoverParent000.CodeCover000014 CodeCoverParent000.CodeCover000003 CodeCoverParent000.CodeCover000026 CodeCoverParent000.CodeCover000015 CodeCoverParent000.CodeCover000004 CodeCoverParent000.CodeCover000027 CodeCoverParent000.CodeCover000016 CodeCoverParent000.CodeCover000005 CodeCoverParent000.CodeCover000028 CodeCoverParent000.CodeCover000017 CodeCoverParent000.CodeCover000006 CodeCoverParent001 CodeCoverParent001.CodeCover000060 CodeCoverParent001.CodeCover000061 CodeCoverParent001.CodeCover000050 CodeCoverParent001.CodeCover000062 CodeCoverParent001.CodeCover000051 CodeCoverParent001.CodeCover000040 CodeCoverParent001.CodeCover000063 CodeCoverParent001.CodeCover000052 CodeCoverParent001.CodeCover000041 CodeCoverParent001.CodeCover000053 CodeCoverParent001.CodeCover000042 CodeCoverParent001.CodeCover000054 CodeCoverParent001.CodeCover000043 CodeCoverParent001.CodeCover000032 CodeCoverParent001.CodeCover000055 CodeCoverParent001.CodeCover000044 CodeCoverParent001.CodeCover000033 CodeCoverParent001.CodeCover000056 CodeCoverParent001.CodeCover000045 CodeCoverParent001.CodeCover000034 CodeCoverParent001.CodeCover000057 CodeCoverParent001.CodeCover000046 CodeCoverParent001.CodeCover000035 CodeCoverParent001.CodeCover000058 CodeCoverParent001.CodeCover000047 CodeCoverParent001.CodeCover000036 CodeCoverParent001.CodeCover000059 CodeCoverParent001.CodeCover000048 CodeCoverParent001.CodeCover000037 CodeCoverParent001.CodeCover000049 CodeCoverParent001.CodeCover000038 CodeCoverParent001.CodeCover000039 CodeCoverParent002 CodeCoverParent002.CodeCover000090 CodeCoverParent002.CodeCover000091 CodeCoverParent002.CodeCover000080 CodeCoverParent002.CodeCover000092 CodeCoverParent002.CodeCover000081 CodeCoverParent002.CodeCover000070 CodeCoverParent002.CodeCover000093 CodeCoverParent002.CodeCover000082 CodeCoverParent002.CodeCover000071 CodeCoverParent002.CodeCover000094 CodeCoverParent002.CodeCover000083 CodeCoverParent002.CodeCover000072 CodeCoverParent002.CodeCover000095 CodeCoverParent002.CodeCover000084 CodeCoverParent002.CodeCover000073 CodeCoverParent002.CodeCover000085 CodeCoverParent002.CodeCover000074 CodeCoverParent002.CodeCover000086 CodeCoverParent002.CodeCover000075 CodeCoverParent002.CodeCover000064 CodeCoverParent002.CodeCover000087 CodeCoverParent002.CodeCover000076 CodeCoverParent002.CodeCover000065 CodeCoverParent002.CodeCover000088 CodeCoverParent002.CodeCover000077 CodeCoverParent002.CodeCover000066 CodeCoverParent002.CodeCover000089 CodeCoverParent002.CodeCover000078 CodeCoverParent002.CodeCover000067 CodeCoverParent002.CodeCover000079 CodeCoverParent002.CodeCover000068 CodeCoverParent002.CodeCover000069 CodeCoverParent003 CodeCoverParent003.CodeCover000096 CodeCoverParent003.CodeCover000097 CodeCoverParent003.CodeCover000098 CodeCoverParent003.CodeCover000099 CodeCoverParent003.CodeCover000100 /end OUT_MEASUREMENT
/end FUNCTION
/begin FUNCTION CoolP "" /begin DEF_CHARACTERISTIC CoolPTbl /end DEF_CHARACTERISTIC /begin OUT_MEASUREMENT CoolP CoolP_ADC CoolP_Raw CoolPIdx /end OUT_MEASUREMENT /begin SUB_FUNCTION CoolP_Config CoolP_Override /end SUB_FUNCTION /end FUNCTION
/begin FUNCTION CoolP_Config "" /begin DEF_CHARACTERISTIC CoolP_Default CoolP_FiltConst CoolP_Max CoolP_Min /end DEF_CHARACTERISTIC /end FUNCTION
/begin FUNCTION CoolP_Override "" /begin DEF_CHARACTERISTIC CoolP_new CoolP_ovr /end DEF_CHARACTERISTIC /end FUNCTION
/begin FUNCTION COOLT "" /begin DEF_CHARACTERISTIC COOLTTbl /end DEF_CHARACTERISTIC /begin OUT_MEASUREMENT COOLT COOLT_ADC COOLT_Raw COOLTIdx /end OUT_MEASUREMENT /begin SUB_FUNCTION COOLT_Config COOLT_Override /end SUB_FUNCTION /end FUNCTION
/begin FUNCTION COOLT_Config "" /begin DEF_CHARACTERISTIC COOLT_Default COOLT_FiltConst COOLT_Max COOLT_Min /end DEF_CHARACTERISTIC /end FUNCTION
/begin FUNCTION COOLT_Override "" /begin DEF_CHARACTERISTIC COOLT_new COOLT_ovr /end DEF_CHARACTERISTIC /end FUNCTION
/begin FUNCTION DRVP "" /begin OUT_MEASUREMENT DRVP DRVP_ADC DRVP_Raw /end OUT_MEASUREMENT /begin SUB_FUNCTION DRVP_Config DRVP_Override /end SUB_FUNCTION /end FUNCTION
/begin FUNCTION DRVP_Config ""
 /begin DEF_CHARACTERISTIC DRVP_Default DRVP_FiltConst DRVP_InHi DRVP_InHiFlt DRVP_InLo DRVP_InLoFlt DRVP_OutHi DRVP_OutLo /end DEF_CHARACTERISTIC
/end FUNCTION
/begin FUNCTION DRVP_Override "" /begin DEF_CHARACTERISTIC DRVP_new DRVP_ovr /end DEF_CHARACTERISTIC /end FUNCTION
/begin FUNCTION ECUP "" /begin OUT_MEASUREMENT ECUP ECUP_ADC ECUP_Raw /end OUT_MEASUREMENT /begin SUB_FUNCTION ECUP_Config ECUP_Override /end SUB_FUNCTION /end FUNCTION
/begin FUNCTION ECUP_Config ""
 /begin DEF_CHARACTERISTIC ECUP_Default ECUP_FiltConst ECUP_InHi ECUP_InHiFlt ECUP_InLo ECUP_InLoFlt ECUP_OutHi ECUP_OutLo /end DEF_CHARACTERISTIC
/end FUNCTION
/begin FUNCTION ECUP_Override "" /begin DEF_CHARACTERISTIC ECUP_new ECUP_ovr /end DEF_CHARACTERISTIC /end FUNCTION
/begin FUNCTION Main_Power_Relay_Config "" /begin DEF_CHARACTERISTIC ECUP_Threshold /end DEF_CHARACTERISTIC /end FUNCTION
/begin FUNCTION Main_Power_Relay "" /begin DEF_CHARACTERISTIC MPRD_KeepAlive ProcessorReboot /end DEF_CHARACTERISTIC /begin OUT_MEASUREMENT MPRD /end OUT_MEASUREMENT /begin SUB_FUNCTION Main_Power_Relay_Config MPRD_Override /end SUB_FUNCTION /end FUNCTION
/begin FUNCTION Engine_Speed "" /begin DEF_CHARACTERISTIC PseudoRPM /end DEF_CHARACTERISTIC /begin OUT_MEASUREMENT EncoderFault EncoderFaultCount EncoderState RPM RPMInst /end OUT_MEASUREMENT /end FUNCTION
/begin FUNCTION Sensors_1 "" /begin SUB_FUNCTION Engine_Speed Knock /end SUB_FUNCTION /end FUNCTION
/begin FUNCTION Plant "" /begin SUB_FUNCTION Sensors_1 Actuators /end SUB_FUNCTION /end FUNCTION
/begin FUNCTION Encoder_Config "" /begin DEF_CHARACTERISTIC EncoderNumCylinders EncoderTDCAngles EncoderTDCOffset /end DEF_CHARACTERISTIC /end FUNCTION
/begin FUNCTION Encoder "" /begin OUT_MEASUREMENT EncoderTDCOrder /end OUT_MEASUREMENT /begin SUB_FUNCTION Encoder_Config /end SUB_FUNCTION /end FUNCTION
/begin FUNCTION ETC_Position "" /begin DEF_CHARACTERISTIC ETC_Imax ETC_Imin ETC_Ki ETC_Kp ETC_max ETC_min /end DEF_CHARACTERISTIC /begin OUT_MEASUREMENT ETC_effort ETC_Ieffort ETC_Peffort TPS_Error_pcnt /end OUT_MEASUREMENT /end FUNCTION
/begin FUNCTION Characterization "" /begin SUB_FUNCTION ETC_Position Ignition_Angle /end SUB_FUNCTION /end FUNCTION
/begin FUNCTION H1 "" /begin DEF_CHARACTERISTIC ETCFreq /end DEF_CHARACTERISTIC /begin OUT_MEASUREMENT H1DC /end OUT_MEASUREMENT /begin SUB_FUNCTION H1DC_Override /end SUB_FUNCTION /end FUNCTION
/begin FUNCTION Actuators "" /begin SUB_FUNCTION H1 Fuel_Pump IAC Ignition_1 Injection_1 MIL Tach /end SUB_FUNCTION /end FUNCTION
/begin FUNCTION ETCPosA "" /begin DEF_CHARACTERISTIC ETCPosATbl /end DEF_CHARACTERISTIC /begin OUT_MEASUREMENT ETCPosA ETCPosA_ADC ETCPosA_Raw ETCPosAIdx /end OUT_MEASUREMENT /begin SUB_FUNCTION ETCPosA_Config ETCPosA_Override /end SUB_FUNCTION /end FUNCTION
/begin FUNCTION ETCPosA_Config "" /begin DEF_CHARACTERISTIC ETCPosA_Default ETCPosA_FiltConst ETCPosA_Max ETCPosA_Min /end DEF_CHARACTERISTIC /end FUNCTION
/begin FUNCTION ETCPosA_Override "" /begin DEF_CHARACTERISTIC ETCPosA_new ETCPosA_ovr /end DEF_CHARACTERISTIC /end FUNCTION
/begin FUNCTION ETCPosB "" /begin DEF_CHARACTERISTIC ETCPosBTbl /end DEF_CHARACTERISTIC /begin OUT_MEASUREMENT ETCPosB ETCPosB_ADC ETCPosB_Raw ETCPosBIdx /end OUT_MEASUREMENT /begin SUB_FUNCTION ETCPosB_Config ETCPosB_Override /end SUB_FUNCTION /end FUNCTION
/begin FUNCTION ETCPosB_Config "" /begin DEF_CHARACTERISTIC ETCPosB_Default ETCPosB_FiltConst ETCPosB_Max ETCPosB_Min /end DEF_CHARACTERISTIC /end FUNCTION
/begin FUNCTION ETCPosB_Override "" /begin DEF_CHARACTERISTIC ETCPosB_new ETCPosB_ovr /end DEF_CHARACTERISTIC /end FUNCTION
/begin FUNCTION ExT1 "" /begin DEF_CHARACTERISTIC ExT1Tbl /end DEF_CHARACTERISTIC /begin OUT_MEASUREMENT ExT1 ExT1_ADC ExT1_Raw ExT1Idx /end OUT_MEASUREMENT /begin SUB_FUNCTION ExT1_Config ExT1_Override /end SUB_FUNCTION /end FUNCTION
/begin FUNCTION ExT1_Config "" /begin DEF_CHARACTERISTIC ExT1_Default ExT1_FiltConst ExT1_Max ExT1_Min /end DEF_CHARACTERISTIC /end FUNCTION
/begin FUNCTION ExT1_Override "" /begin DEF_CHARACTERISTIC ExT1_new ExT1_ovr /end DEF_CHARACTERISTIC /end FUNCTION
/begin FUNCTION ExT2 "" /begin DEF_CHARACTERISTIC ExT2Tbl /end DEF_CHARACTERISTIC /begin OUT_MEASUREMENT ExT2 ExT2_ADC ExT2_Raw ExT2Idx /end OUT_MEASUREMENT /begin SUB_FUNCTION ExT2_Config ExT2_Override /end SUB_FUNCTION /end FUNCTION
/begin FUNCTION ExT2_Config "" /begin DEF_CHARACTERISTIC ExT2_Default ExT2_FiltConst ExT2_Max ExT2_Min /end DEF_CHARACTERISTIC /end FUNCTION
/begin FUNCTION ExT2_Override "" /begin DEF_CHARACTERISTIC ExT2_new ExT2_ovr /end DEF_CHARACTERISTIC /end FUNCTION
/begin FUNCTION Action_Reasons ""
 /begin OUT_MEASUREMENT FaultActionReason._.DisableFuel FaultActionReason._.DisableIAC FaultActionReason._.DisableSpark FaultActionReason._.DisableThrottle FaultActionReason._.IlluminateMIL /end OUT_MEASUREMENT
/end FUNCTION
/end MODULE
/end PROJECT
